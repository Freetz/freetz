## make/sudo/Config.in
```kconfig
config FREETZ_PACKAGE_SUDO
	bool "sudo 1.7.10 (binary only)"
	select FREETZ_LIB_libcrypt
	select FREETZ_LIB_libutil
	default n
	help
		Sudo (su "do") allows a system administrator to delegate authority to
		give certain users (or groups of users) the ability to run some (or
		all) commands as root or another user while providing an audit trail of
		the commands and their arguments.
		WWW: http://www.courtesan.com/sudo/
```

## make/sundtek-rtspd/Config.in
```kconfig
config FREETZ_PACKAGE_SUNDTEK_RTSPD
	bool "Include Sundtek Streaming Server (rtspd)"
	depends on FREETZ_PACKAGE_SUNDTEK && !FREETZ_PACKAGE_SUNDTEK_VERSION_2013

config FREETZ_PACKAGE_SUNDTEK_RTSPD_FORCE_DOWNLOAD
	bool "Force update on each build"
	depends on FREETZ_PACKAGE_SUNDTEK_RTSPD
	default y
	help
		Download the latest version of rtspd each time Freetz is built.
```

## make/sundtek/Config.in
```kconfig
config FREETZ_PACKAGE_SUNDTEK
	bool "Sundtek DVB driver 130210.134617/170310.204343/210803.071224"
	depends on FREETZ_KERNEL_VERSION_2_6_19_MIN
	depends on !FREETZ_TARGET_ARCH_X86
	depends on !FREETZ_SEPARATE_AVM_UCLIBC
	select FREETZ_LIB_libdl       if FREETZ_TARGET_UCLIBC_HAS_multiple_libs
	select FREETZ_LIB_libpthread  if FREETZ_TARGET_UCLIBC_HAS_multiple_libs
	select FREETZ_LIB_librt       if FREETZ_TARGET_UCLIBC_HAS_multiple_libs && FREETZ_TARGET_ARCH_MIPS && FREETZ_TARGET_ARCH_BE
	default n
	help
		Sundtek closed-source linux driver daemon & client.
		To use this driver you have to run:
		export LD_PRELOAD=/usr/lib/libsundtekmediaclient.so

if FREETZ_PACKAGE_SUNDTEK

	choice
		prompt "Version"
		default FREETZ_PACKAGE_SUNDTEK_VERSION_2017
		default FREETZ_PACKAGE_SUNDTEK_VERSION_2021

		config FREETZ_PACKAGE_SUNDTEK_VERSION_2013
		bool "130210.134617"
		depends on !FREETZ_SEPARATE_AVM_UCLIBC

		config FREETZ_PACKAGE_SUNDTEK_VERSION_2017
		bool "170310.204343"
		depends on !FREETZ_SEPARATE_AVM_UCLIBC

		config FREETZ_PACKAGE_SUNDTEK_VERSION_2021
		bool "210803.071224"

		config FREETZ_PACKAGE_SUNDTEK_VERSION_LATEST
		bool "latest available"
	endchoice

	config FREETZ_PACKAGE_SUNDTEK_ARCH
		string
		default "openwrtarm4"    if FREETZ_TARGET_ARCH_ARM
		default "openwrtmipsr2"  if FREETZ_TARGET_ARCH_MIPS && FREETZ_TARGET_ARCH_BE && (FREETZ_TARGET_UCLIBC_0_9_28 || FREETZ_TARGET_UCLIBC_0_9_29 || FREETZ_TARGET_UCLIBC_0_9_32)
		default "openwrtmipsr3"  if FREETZ_TARGET_ARCH_MIPS && FREETZ_TARGET_ARCH_BE && (FREETZ_TARGET_UCLIBC_0_9_33 || FREETZ_TARGET_UCLIBC_1_0_14)
		default "mipselbcm"      if FREETZ_TARGET_ARCH_MIPS && FREETZ_TARGET_ARCH_LE

	comment "Note: Try using older version if you experience any problems"
		depends on FREETZ_KERNEL_VERSION_2_6_19_MAX && !FREETZ_PACKAGE_SUNDTEK_VERSION_2013

	comment "CAUTION: Use 'replace kernel' to avoid memory leaks!"
		depends on FREETZ_KERNEL_VERSION_2_6_19 && !FREETZ_REPLACE_KERNEL

endif # FREETZ_PACKAGE_SUNDTEK
```

## make/synce-dccm/Config.in
```kconfig
config FREETZ_PACKAGE_SYNCE_DCCM
	bool "SynCE dccm 0.9.1"
	select FREETZ_LIB_libsynce
	default n
	help
		SynCE is a framework to sync WinCE devices
```

## make/synce-serial/Config.in
```kconfig
config FREETZ_PACKAGE_SYNCE_SERIAL
	bool "SynCE serial 0.10.0 (binary only)"
	depends on FREETZ_REPLACE_KERNEL
	select FREETZ_PACKAGE_PPPD
	select FREETZ_PACKAGE_SYNCE_DCCM
	default n
	help
		SynCE is a framework to sync WinCE devices
```

## make/syslogd-cgi/Config.in
```kconfig
config FREETZ_PACKAGE_SYSLOGD_CGI
	bool "Syslogd CGI 0.2.3"
	default y
	help
		Configuration frontend to syslogd
```

## make/target-tester/Config.in
```kconfig
config FREETZ_PACKAGE_TARGET_TESTER
#	bool "target-tester"
	bool
	default n
	help
		This package is intended to be used by freetz' developers only.
		It allows to compile and run configure-tests which need
		to be run on target in a less complicated way (compared to completely manual one).
		Note: Simply modify target-tester.c or replace it with code
		taken from configure script.
```

## make/tcp_wrappers/Config.in
```kconfig
config FREETZ_PACKAGE_TCP_WRAPPERS
	bool "tcp_wrappers 7.6 (binary only)"
	default n
	help
		TCP Wrapper is a host-based Networking ACL system, used to filter
		network access to Internet Protocol servers on (Unix-like)
		operating systems such as Linux or BSD. It allows host or
		subnetwork IP addresses, names and/or ident query replies, to be
		used as tokens on which to filter for access control purposes.
```

## make/tcpdump/Config.in
```kconfig
config FREETZ_PACKAGE_TCPDUMP
	bool "Tcpdump 4.1.1 (binary only)"
	select FREETZ_LIB_libpcap
	default n
	help
		Network monitoring and data acquisition tool

config FREETZ_PACKAGE_TCPDUMP_MINI
	bool "build minimal version"
	depends on FREETZ_PACKAGE_TCPDUMP
	default n
	help
		By enabling this option tcpdump will be built without
		runtime recognition and parsing capabilities for a whole
		lot of protocols and services. It will save 98KB of 
		compressed squashfs.
```

## make/telefon/Config.in
```kconfig
config DS_PACKAGE_TELEFON
	bool "telefon 0.3"
	depends on DS_HAS_PHONE && \
	           (DS_LANG_DE || ! DS_SELECTED_LANG_ONLY)
	default n
	help
	    Generic telefon wrapper
```

## make/tesseract/Config.in
```kconfig
config FREETZ_PACKAGE_TESSERACT
	bool "Tesseract OCR 3.02.02 (binary only)"
	select FREETZ_PACKAGE_TESSERACT_tesseract
	select FREETZ_PACKAGE_TESSERACT_ENG
	default n
	help
		Tesseract is an Open Source OCR engine

		Note:
		 Tesseract including languages files is a huge package and requires
		 a lot of RAM at run-time. It is NOT recommended to use it on boxes
		 having less than 64MB RAM.

comment "You need a box with at least 64MB RAM to run Tesseract"
	depends on FREETZ_PACKAGE_TESSERACT

menu "Languages"
	depends on FREETZ_PACKAGE_TESSERACT

	config FREETZ_PACKAGE_TESSERACT_ENG
		bool "English"

	config FREETZ_PACKAGE_TESSERACT_DEU
		bool "German"
endmenu

config FREETZ_PACKAGE_TESSERACT_tesseract
	bool "tesseract"
	depends on FREETZ_PACKAGE_TESSERACT
	select FREETZ_LIB_libtesseract

config FREETZ_PACKAGE_TESSERACT_ambiguous_words
	bool "ambiguous_words"
	depends on FREETZ_PACKAGE_TESSERACT
	select FREETZ_LIB_libtesseract

config FREETZ_PACKAGE_TESSERACT_classifier_tester
	bool "classifier_tester"
	depends on FREETZ_PACKAGE_TESSERACT
	select FREETZ_LIB_libtesseract

config FREETZ_PACKAGE_TESSERACT_cntraining
	bool "cntraining"
	depends on FREETZ_PACKAGE_TESSERACT
	select FREETZ_LIB_libtesseract

config FREETZ_PACKAGE_TESSERACT_combine_tessdata
	bool "combine_tessdata"
	depends on FREETZ_PACKAGE_TESSERACT
	select FREETZ_LIB_libtesseract

config FREETZ_PACKAGE_TESSERACT_dawg2wordlist
	bool "dawg2wordlist"
	depends on FREETZ_PACKAGE_TESSERACT
	select FREETZ_LIB_libtesseract

config FREETZ_PACKAGE_TESSERACT_mftraining
	bool "mftraining"
	depends on FREETZ_PACKAGE_TESSERACT
	select FREETZ_LIB_libtesseract

config FREETZ_PACKAGE_TESSERACT_shapeclustering
	bool "shapeclustering"
	depends on FREETZ_PACKAGE_TESSERACT
	select FREETZ_LIB_libtesseract

config FREETZ_PACKAGE_TESSERACT_unicharset_extractor
	bool "unicharset_extractor"
	depends on FREETZ_PACKAGE_TESSERACT
	select FREETZ_LIB_libtesseract

config FREETZ_PACKAGE_TESSERACT_wordlist2dawg
	bool "wordlist2dawg"
	depends on FREETZ_PACKAGE_TESSERACT
	select FREETZ_LIB_libtesseract
```
