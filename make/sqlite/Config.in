## make/sqlite/Config.in
```kconfig
config FREETZ_PACKAGE_SQLITE
	bool "SQLite (v3.x) database engine (CLI)"
	select FREETZ_LIB_libsqlite3
	default n
	help
		SQLite is a small C library that implements a self-contained, embeddable,
		zero-configuration SQL database engine.

config FREETZ_PACKAGE_SQLITE_WITH_READLINE
	bool "build with readline support"
	depends on FREETZ_PACKAGE_SQLITE
	select FREETZ_LIB_libreadline
	select FREETZ_LIB_libncurses
	default n
	help
		This option causes command line client to be built with readline and history support.
```

## make/squashfs-tools/Config.in
```kconfig
config FREETZ_PACKAGE_SQUASHFS_TOOLS
	bool "squashfs-tools 3.4"
	depends on FREETZ_TYPE_7490
	select FREETZ_LIB_libm
	select FREETZ_LIB_libpthread
	select FREETZ_LIB_libz
	default n
	help
		mksquashfs and unsquashfs are small utilities to handle
		(inspect and create) SquashFS formatted filesystem images.
		Due to missing LZMA support this package is only suitable
		for 7490 yet.
```

## make/squashfs3/Config.in
```kconfig
config FREETZ_PACKAGE_SQUASHFS3
	bool "squashfs-tools 3.4"
	depends on FREETZ_KERNEL_VERSION_2_6_28_MIN
	select FREETZ_LIB_libm       if !FREETZ_PACKAGE_SQUASHFS4_ALL_STAT && FREETZ_TARGET_UCLIBC_HAS_multiple_libs
	select FREETZ_LIB_libpthread if !FREETZ_PACKAGE_SQUASHFS4_ALL_STAT && FREETZ_TARGET_UCLIBC_HAS_multiple_libs
	select FREETZ_LIB_libz       if  FREETZ_PACKAGE_SQUASHFS4_ALL_DYN
	default n
	help
		mksquashfs and unsquashfs are small utilities to handle
		(inspect and create) SquashFS formatted filesystem images.

choice
	depends on FREETZ_PACKAGE_SQUASHFS3
	prompt "Link"
	default FREETZ_PACKAGE_SQUASHFS3_ALL_DYN

	config FREETZ_PACKAGE_SQUASHFS3_ALL_DYN
		bool "all libraries dynamically"

	config FREETZ_PACKAGE_SQUASHFS3_COMP_STAT
		bool "compression libraries statically"

	config FREETZ_PACKAGE_SQUASHFS3_ALL_STAT
		bool "all libraries statically"
endchoice
```

## make/squashfs4-be/Config.in
```kconfig
config FREETZ_PACKAGE_SQUASHFS4_BE
	bool "squashfs-tools 4.3 (AVM-BE)"
	depends on FREETZ_KERNEL_VERSION_2_6_28_MIN
	select FREETZ_LIB_libm        if !FREETZ_PACKAGE_SQUASHFS4_BE_ALL_STAT && FREETZ_TARGET_UCLIBC_HAS_multiple_libs
	select FREETZ_LIB_libpthread  if !FREETZ_PACKAGE_SQUASHFS4_BE_ALL_STAT && FREETZ_TARGET_UCLIBC_HAS_multiple_libs
	select FREETZ_LIB_libz        if  FREETZ_PACKAGE_SQUASHFS4_BE_ALL_DYN && FREETZ_PACKAGE_SQUASHFS4_BE_LEGACY
	select FREETZ_LIB_liblzma     if  FREETZ_PACKAGE_SQUASHFS4_BE_ALL_DYN
	default n
	help
		This package provides unsquashfs/mksquashfs utilities modified
		to be able to expand/create images in AVM-BE format.

		AVM-BE is not an official name, it's a name given by the user
		community to a non-standard SquashFS format used by AVM since
		Fritz!OS Labor 6.35 - ths first kernel 3.10.73 based Fritz!OS
		version.

config FREETZ_PACKAGE_SQUASHFS4_BE_LEGACY
	depends on FREETZ_PACKAGE_SQUASHFS4_BE
	bool "with SquashFS-1/2/3 support"
	default n
	help
		Enables support (unsquashfs only) for legacy SquashFS-1/2/3 formats
		including a special header-less/LZMA1-compressed format used by AVM
		on many boxes.

choice
	depends on FREETZ_PACKAGE_SQUASHFS4_BE
	prompt "Link"
	default FREETZ_PACKAGE_SQUASHFS4_BE_ALL_DYN

	config FREETZ_PACKAGE_SQUASHFS4_BE_ALL_DYN
		bool "all libraries dynamically"

	config FREETZ_PACKAGE_SQUASHFS4_BE_COMP_STAT
		bool "compression libraries statically"

	config FREETZ_PACKAGE_SQUASHFS4_BE_ALL_STAT
		bool "all libraries statically"
endchoice
```

## make/squashfs4-le/Config.in
```kconfig
config FREETZ_PACKAGE_SQUASHFS4_LE
	bool "squashfs-tools 4.3 (AVM-LE)"
	depends on FREETZ_KERNEL_VERSION_2_6_28_MIN
	select FREETZ_LIB_libm        if !FREETZ_PACKAGE_SQUASHFS4_LE_ALL_STAT && FREETZ_TARGET_UCLIBC_HAS_multiple_libs
	select FREETZ_LIB_libpthread  if !FREETZ_PACKAGE_SQUASHFS4_LE_ALL_STAT && FREETZ_TARGET_UCLIBC_HAS_multiple_libs
	select FREETZ_LIB_libz        if  FREETZ_PACKAGE_SQUASHFS4_LE_ALL_DYN && FREETZ_PACKAGE_SQUASHFS4_LE_LEGACY
	select FREETZ_LIB_liblzma     if  FREETZ_PACKAGE_SQUASHFS4_LE_ALL_DYN
	default n
	help
		This package provides unsquashfs/mksquashfs utilities modified
		to be able to expand/create images in AVM-LE format.

		AVM-LE is the format used by AVM to pack the filesystem of some
		cable boxes, e.g. 6490, 6590 (x86 core only).

		The only difference of this format to the original LE format
		is that the value of the mkfs_time superblock field is equal
		to the bytes_used field.

config FREETZ_PACKAGE_SQUASHFS4_LE_LEGACY
	depends on FREETZ_PACKAGE_SQUASHFS4_LE
	bool "with SquashFS-1/2/3 support"
	default n
	help
		Enables support (unsquashfs only) for legacy SquashFS-1/2/3 formats
		including a special header-less/LZMA1-compressed format used by AVM
		on many boxes.

choice
	depends on FREETZ_PACKAGE_SQUASHFS4_LE
	prompt "Link"
	default FREETZ_PACKAGE_SQUASHFS4_LE_ALL_DYN

	config FREETZ_PACKAGE_SQUASHFS4_LE_ALL_DYN
		bool "all libraries dynamically"

	config FREETZ_PACKAGE_SQUASHFS4_LE_COMP_STAT
		bool "compression libraries statically"

	config FREETZ_PACKAGE_SQUASHFS4_LE_ALL_STAT
		bool "all libraries statically"
endchoice
```

## make/squashfs4-tools/Config.in
```kconfig
config FREETZ_PACKAGE_SQUASHFS4_TOOLS
	bool "squashfs-tools 4.3 - with AVM-BE support"
	depends on FREETZ_TYPE_7490
	select FREETZ_LIB_libm        if !FREETZ_PACKAGE_SQUASHFS4_TOOLS_ALL_STAT
	select FREETZ_LIB_libpthread  if !FREETZ_PACKAGE_SQUASHFS4_TOOLS_ALL_STAT
	select FREETZ_LIB_liblzma     if  FREETZ_PACKAGE_SQUASHFS4_TOOLS_ALL_DYN
	default n
	help
		As of now this package provides only unsquashfs utility modified
		to be able to expand BE images for AVM's 3.10.73 kernel based systems

choice
	depends on FREETZ_PACKAGE_SQUASHFS4_TOOLS
	prompt "Link"
	default FREETZ_PACKAGE_SQUASHFS4_TOOLS_ALL_DYN

	config FREETZ_PACKAGE_SQUASHFS4_TOOLS_ALL_DYN
		bool "all libraries dynamically"

	config FREETZ_PACKAGE_SQUASHFS4_TOOLS_COMP_DYN
		bool "compression libraries statically"

	config FREETZ_PACKAGE_SQUASHFS4_TOOLS_ALL_STAT
		bool "all libraries statically"
endchoice
```

## make/squashfs4/Config.in
```kconfig
config FREETZ_PACKAGE_SQUASHFS4
	bool "squashfs-tools 4.3 - with AVM-BE support"
	depends on FREETZ_TYPE_7490
	select FREETZ_LIB_libm        if !FREETZ_PACKAGE_SQUASHFS4_ALL_STAT
	select FREETZ_LIB_libpthread  if !FREETZ_PACKAGE_SQUASHFS4_ALL_STAT
	select FREETZ_LIB_libz        if  FREETZ_PACKAGE_SQUASHFS4_ALL_DYN && FREETZ_PACKAGE_SQUASHFS4_LEGACY
	select FREETZ_LIB_liblzma     if  FREETZ_PACKAGE_SQUASHFS4_ALL_DYN
	default n
	help
		This package provides unsquashfs/mksquashfs utilities modified
		to be able to expand/create images in AVM-BE format.

		AVM-BE is not an official name, it's a name given by the user
		community to a non-standard SquashFS format used by AVM since
		Fritz!OS Labor 6.35 - ths first kernel 3.10.73 based Fritz!OS
		version.

config FREETZ_PACKAGE_SQUASHFS4_LEGACY
	depends on FREETZ_PACKAGE_SQUASHFS4
	bool "with SquashFS-1/2/3 support"
	default n
	help
		Enables support (unsquashfs only) for legacy SquashFS-1/2/3 formats
		including a special header-less/LZMA1-compressed format used by AVM
		on many boxes.

choice
	depends on FREETZ_PACKAGE_SQUASHFS4
	prompt "Link"
	default FREETZ_PACKAGE_SQUASHFS4_ALL_DYN

	config FREETZ_PACKAGE_SQUASHFS4_ALL_DYN
		bool "all libraries dynamically"

	config FREETZ_PACKAGE_SQUASHFS4_COMP_DYN
		bool "compression libraries statically"

	config FREETZ_PACKAGE_SQUASHFS4_ALL_STAT
		bool "all libraries statically"
endchoice
```

## make/squid/Config.in
```kconfig
config FREETZ_PACKAGE_SQUID
	bool "Squid 3.0.STABLE26"
	default n
	depends on FREETZ_KERNEL_VERSION_2
	select FREETZ_LIB_STDCXXLIB
	help
		Squid is a caching proxy for the Web supporting HTTP, HTTPS,
		FTP, and more. It reduces bandwidth and improves response
		times by caching and reusing frequently-requested web pages.
		Squid has extensive access controls and makes a great server
		accelerator.

config FREETZ_PACKAGE_SQUID_TRANSPARENT
	bool "build with transparent proxy support (iptables)"
	depends on FREETZ_PACKAGE_SQUID && \
		FREETZ_KERNEL_VERSION_2_6_19 && \
		FREETZ_SHOW_EXPERT && \
		FREETZ_PACKAGE_IPTABLES_IS_SELECTABLE
	default n

	# Activate group menus for modules and libs before selecting sub-entries
	# Note: no need to select FREETZ_SHOW_EXPERT because
	# FREETZ_PACKAGE_IPTABLES_IS_SELECTABLE (a few lines above) already does
	select FREETZ_PACKAGE_IPTABLES
	select FREETZ_PACKAGE_IPTABLES_KERNEL_MODULES
	select FREETZ_PACKAGE_IPTABLES_SHARED_LIBS

	# Kernel modules
	select FREETZ_MODULE_ip_conntrack
	select FREETZ_MODULE_x_tables
	select FREETZ_MODULE_ip_nat
	select FREETZ_MODULE_ipt_REDIRECT

	# Shared libs
	select FREETZ_LIB_libxt_standard
	select FREETZ_LIB_libxt_tcp
	select FREETZ_LIB_libxt_udp
	select FREETZ_LIB_libxt_conntrack
	select FREETZ_LIB_libipt_REDIRECT

	help
		This option enables transparent Proxy support for SQUID
		and IPTables. Increases size of squid binary aprox. 192KB.
```

## make/sshfs-fuse/Config.in
```kconfig
comment "sshfs-fuse (not available, needs kernel modules)"
	depends on !FREETZ_REPLACE_MODULE_AVAILABLE

comment "sshfs-fuse (not available, needs OpenSSL 1.0 or newer)"
	depends on FREETZ_REPLACE_MODULE_AVAILABLE && !FREETZ_OPENSSL_VERSION_1_MIN

config FREETZ_PACKAGE_SSHFS_FUSE
	bool "sshfs-fuse 2.4 (binary only)"
	depends on FREETZ_REPLACE_MODULE_AVAILABLE && FREETZ_OPENSSL_VERSION_1_MIN
	select FREETZ_PACKAGE_FUSE
	select FREETZ_PACKAGE_DROPBEAR_SERVER_ONLY if FREETZ_PACKAGE_DROPBEAR
	select FREETZ_PACKAGE_OPENSSH
	select FREETZ_PACKAGE_OPENSSH_ssh
	select FREETZ_PACKAGE_OPENSSH_sftp
	select FREETZ_LIB_libgthread_2
	default n
	help
		This is a filesystem client based on the SSH File Transfer Protocol.
		Since most SSH servers already support this protocol it is very easy to set up:
		i.e. on the server side there's nothing to do.
		On the client side mounting the filesystem is as easy as
		logging into the server with ssh.
```

## make/sslh/Config.in
```kconfig
config FREETZ_PACKAGE_SSLH
	bool "sslh 1.18"
	default n
	select FREETZ_LIB_libconfig
	help
		sslh accepts HTTPS, SSH and OpenVPN connections on the same port.
		This makes it possible to connect to an SSH server or an OpenVPN
		on port 443 (e.g. from inside a corporate firewall, which almost
		never block port 443) while still serving HTTPS on that port.
```

## make/strace/Config.in
```kconfig
config FREETZ_PACKAGE_STRACE
	bool "strace 4.23/4.9 (binary only)"
	default n
	select FREETZ_REMOVE_STRACE if FREETZ_AVM_HAS_STRACE
	help
		strace - trace system calls and signals

		strace is a system call tracer, i.e. a debugging tool which prints out
		a trace of all the system calls made by a another process/program.
```

## make/streamripper/Config.in
```kconfig
config FREETZ_PACKAGE_STREAMRIPPER
	bool "Streamripper 1.63.4 (binary only)"
	select FREETZ_LIB_libglib_2
	select FREETZ_LIB_libmad
	default n
	help
	    Record mp3 streams
```

## make/stunnel/Config.in
```kconfig
config FREETZ_PACKAGE_STUNNEL
	bool "Stunnel 4.33"
	select FREETZ_LIB_libcrypto if ! FREETZ_PACKAGE_STUNNEL_STATIC
	select FREETZ_LIB_libssl if ! FREETZ_PACKAGE_STUNNEL_STATIC
	select FREETZ_LIB_libz if ! FREETZ_PACKAGE_STUNNEL_STATIC
	select FREETZ_LIB_libutil if ! FREETZ_PACKAGE_STUNNEL_STATIC
	default n
	help
		Stunnel universal SSL proxy

config FREETZ_PACKAGE_STUNNEL_STATIC
	bool "Statically link libraries"
	depends on FREETZ_PACKAGE_STUNNEL
	default n
	help
		Build stunnel binary with statically linked libraries.
```

## make/subversion/Config.in
```kconfig
config FREETZ_PACKAGE_SUBVERSION_LIBRARIES
	bool

config FREETZ_PACKAGE_SUBVERSION
	bool "Subversion 1.8.19/1.9.12"
	select FREETZ_PACKAGE_SUBVERSION_REMOVE_WEBIF if !FREETZ_PACKAGE_SUBVERSION_SVNSERVE
	select FREETZ_PACKAGE_SUBVERSION_LIBRARIES    if !FREETZ_PACKAGE_SUBVERSION_STATIC
	select FREETZ_BUSYBOX_START_STOP_DAEMON
	select FREETZ_LIB_libapr                      if !FREETZ_PACKAGE_SUBVERSION_STATIC
	select FREETZ_LIB_libaprutil                  if !FREETZ_PACKAGE_SUBVERSION_STATIC
	select FREETZ_LIB_libserf                     if !FREETZ_PACKAGE_SUBVERSION_STATIC
	select FREETZ_LIB_libsqlite3                  if !FREETZ_PACKAGE_SUBVERSION_STATIC
	select FREETZ_LIB_libz                        if !FREETZ_PACKAGE_SUBVERSION_STATIC
	default n
	help
		Subversion, also known as svn, is a version control system much like
		the Concurrent Versions System (CVS). Version control systems allow
		many individuals (who may be distributed geographically) to collaborate
		on a set of files (typically source code). Subversion has all the major
		features of CVS, plus certain new features that CVS users often wish
		they had.

choice
	depends on FREETZ_PACKAGE_SUBVERSION
	prompt "Version"
	default FREETZ_PACKAGE_SUBVERSION_VERSION_1_9

	config FREETZ_PACKAGE_SUBVERSION_VERSION_1_8
		bool "1.8.19"

	config FREETZ_PACKAGE_SUBVERSION_VERSION_1_9
		bool "1.9.12"
endchoice

config FREETZ_PACKAGE_SUBVERSION_WITH_LIBDB
	bool "build with Berkeley-DB support"
	depends on FREETZ_PACKAGE_SUBVERSION
	select FREETZ_LIB_libaprutil_WITH_LIBDB
	default n
	help
		Enables Berkeley-DB support in subversion.

config FREETZ_PACKAGE_SUBVERSION_SVN
	bool "Include svn"
	depends on FREETZ_PACKAGE_SUBVERSION
	default y
	help
		Include svn (subversion client tool) in the image.

config FREETZ_PACKAGE_SUBVERSION_SVNADMIN
	bool "Inlcude svnadmin"
	depends on FREETZ_PACKAGE_SUBVERSION
	default y
	help
		Include svnadmin (subversion repository administration tool) in the image.

config FREETZ_PACKAGE_SUBVERSION_SVNDUMPFILTER
	bool "Include svndumpfilter"
	depends on FREETZ_PACKAGE_SUBVERSION
	default y
	help
		Include svndumpfilter (tool to filter subversion repository dumpfile) in the image.

config FREETZ_PACKAGE_SUBVERSION_SVNLOOK
	bool "Include svnlook"
	depends on FREETZ_PACKAGE_SUBVERSION
	default y
	help
		Include svnlook (subversion repository examination tool) in the image.

config FREETZ_PACKAGE_SUBVERSION_SVNRDUMP
	bool "Include svnrdump"
	depends on FREETZ_PACKAGE_SUBVERSION
	default y
	help
		Include svnrdump (subversion remote repository dumper and loader utility) in the image.

config FREETZ_PACKAGE_SUBVERSION_SVNSERVE
	bool "Include svnserve"
	depends on FREETZ_PACKAGE_SUBVERSION
	default y
	help
		Include svnserve (server for the 'svn' repository access method) in the image.

config FREETZ_PACKAGE_SUBVERSION_SVNSYNC
	bool "Inlcude svnsync"
	depends on FREETZ_PACKAGE_SUBVERSION
	default y
	help
		Include svnsync (repository synchronization tool) in the image.

config FREETZ_PACKAGE_SUBVERSION_SVNVERSION
	bool "Include svnversion"
	depends on FREETZ_PACKAGE_SUBVERSION
	default y
	help
		Include svnversion (tool to produce a compact version number for a working copy) in the image.

config FREETZ_PACKAGE_SUBVERSION_STATIC
	bool "Link statically"
	depends on FREETZ_PACKAGE_SUBVERSION
	default n
	help
		Activating this switch causes all libraries subversion tools
		depend on to be linked in statically.

config FREETZ_PACKAGE_SUBVERSION_APACHE_MODULES
	bool "apache modules"
	depends on FREETZ_PACKAGE_SUBVERSION && !FREETZ_PACKAGE_SUBVERSION_STATIC \
		&& FREETZ_PACKAGE_APACHE2 && !FREETZ_PACKAGE_APACHE2_COMPILEINMODS
	select FREETZ_PACKAGE_SUBVERSION_mod_dav_svn

config FREETZ_PACKAGE_SUBVERSION_mod_authz_svn
	bool "mod_authz_svn"
	depends on FREETZ_PACKAGE_SUBVERSION_APACHE_MODULES
	default n
	help
		Subversion path-based authorization module for Apache

config FREETZ_PACKAGE_SUBVERSION_mod_dav_svn
	bool "mod_dav_svn"
	depends on FREETZ_PACKAGE_SUBVERSION_APACHE_MODULES
	default n
	help
		Subversion plug-in for the Apache DAV module

config FREETZ_PACKAGE_SUBVERSION_mod_dontdothat
	bool "mod_dontdothat"
	depends on FREETZ_PACKAGE_SUBVERSION_APACHE_MODULES
	default n
	help
		Module to block certain kinds of Apache Subversion requests

config FREETZ_PACKAGE_SUBVERSION_REMOVE_WEBIF
	bool "remove webinterface"
	depends on FREETZ_PACKAGE_SUBVERSION
	default n
	help
		This option removes the webinterface
```
