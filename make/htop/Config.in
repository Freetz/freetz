## make/iptraf/Config.in
```kconfig
config FREETZ_PACKAGE_IPTRAF
	bool "Iptraf 3.0.1 (binary only)"
	select FREETZ_LIB_libncurses
	select FREETZ_LIB_libpanel
	default n
	help
	IPTraf is a console-based network monitoring program for Linux that
	displays information about IP traffic. It returns such information as:
		Current TCP connections
		UDP, ICMP, OSPF, and other types of IP packets
		Packet and byte counts on TCP connections
		IP, TCP, UDP, ICMP, non-IP, and other packet and byte counts
		TCP/UDP counts by ports
		Packet counts by packet sizes
		Packet and byte counts by IP address
		Interface activity
		Flag statuses on TCP packets
		LAN station statistics

config FREETZ_PACKAGE_IPTRAF_RVNAMED
	bool "rvnamed"
	depends on FREETZ_PACKAGE_IPTRAF
	default n
	help
		reverse name resolution daemon for iptraf
```

## make/iputils/Config.in
```kconfig
config FREETZ_PACKAGE_IPUTILS
	depends on FREETZ_TARGET_IPV6_SUPPORT
	bool "iputils' traceroute6 s20071127 (binary only)"
	default n
```

## make/irssi/Config.in
```kconfig
config FREETZ_PACKAGE_IRSSI
	bool "Irssi 0.8.15"
	select FREETZ_LIB_libglib_2
	select FREETZ_LIB_libgmodule_2
	select FREETZ_LIB_libncurses
	default n
	help
		Irssi - the client of the future - is a terminal based IRC client for UNIX
		systems. It also supports SILC and ICB protocols via plugins. Features:
		  * Autologging: Irssi will automatically log any channels, queries or
		    special windows that you want.
		  * Formats and Themes: irssi has an easy yet powerful way to customize your
		    client's look and feel.
		  * Configurable keybindings: Irssi allows you to modify the default
		    keybindings and create your own so you can customize your client.
		  * Paste detection: Irssi tries to detect when you are pasting large amounts
		    of text, by looking at the speed that characters are entered; if such
		    pasting is detected [TAB]-characters are sent as-is instead of being
		    tab-completed and eventually ending up in a wrong destination window.

config FREETZ_PACKAGE_IRSSI_WITH_PROXY
	bool "Irssi proxy"
	depends on FREETZ_PACKAGE_IRSSI
	default n
	help
		Irssi-proxy is a plugin which allows to bind a port to each IRC server you are
		connected to. The copy of Irssi running the proxy works just as a normal
		client which you can use, but you can also connect one or more clients to it
		to share the connections.

		Using Irssi as a proxy has the major advantage of Irssi's power as an IRC
		client. You never have to worry about losing your connection to IRC.

config FREETZ_PACKAGE_IRSSI_WITH_BOT
	bool "Irssi bot"
	depends on FREETZ_PACKAGE_IRSSI
	default n

config FREETZ_PACKAGE_IRSSI_WITH_OPENSSL
	bool "Irssi OpenSSL encryption"
	depends on FREETZ_PACKAGE_IRSSI
	select FREETZ_LIB_libcrypto
	default n
	help
		OpenSSL encryption for Irssi
```

## make/jamvm/Config.in
```kconfig
config FREETZ_PACKAGE_JAMVM
	bool "JamVM 1.5.1 (binary only)"
	select FREETZ_PACKAGE_CLASSPATH
	select FREETZ_LIB_libffi
	select FREETZ_LIB_libz
	default n
	help
	    JamVM - extremely small Java VM

		JamVM is a new Java Virtual Machine which conforms to the JVM
		specification version 2 (blue book). In comparison to most other VM's
		(free and commercial) it is extremely small, with a stripped executable
		on PowerPC of only ~160K, and Intel 140K. However, unlike other small
		VMs (e.g. KVM) it is designed to support the full specification, and
		includes support for object finalisation, Soft/Weak/Phantom References,
		class-unloading, the Java Native Interface (JNI) and the Reflection API.

		Class Libraries: JamVM is designed to use the GNU Classpath Java class
		library. A number of classes are reference classes which must be
		modified for a particular VM. These are provided along with JamVM (see
		INSTALL). JamVM should always work with the latest development snapshot
		of Classpath (currently 0.93). It should also work with the latest
		version direct from CVS, and the upcoming 0.94 snapshot (but check the
		Classpath mailing lists for possible patches). Later snapshots of
		Classpath may also work, if no modifications have been made to the VM
		interface.
		
		Note, JamVM will not work with the class library from Sun or IBM's
		Virtual Machines.

# Include here a cleaner menu structure
source make/classpath/Config.in

config FREETZ_LIB_libffi
	bool "ffi-sable (libffi.so)"
	requires FREETZ_PACKAGE_JAMVM
	help
		libffi is a library that really only provides the lowest, machine
		dependent layer of a fully featured foreign function interface. A layer
		must exist above libffi that handles type conversions for values passed
		between the two languages. ffi stands for Foreign Function Interface.
		A foreign function interface is the popular name for the interface that
		allows code written in one language to call code written in another
		language.

		NOTE:
		At the moment, this library is only used by JamVM. If any other package
		should need it, the fixed dependency can be removed and the library be
		put into the general library section of menuconfig.
```

## make/jq/Config.in
```kconfig
config FREETZ_PACKAGE_JQ
	bool "jq - a command-line JSON processor"
	default n
	select FREETZ_LIB_libm if !FREETZ_PACKAGE_JQ_STATIC
	select FREETZ_LIB_libonig if !FREETZ_PACKAGE_JQ_STATIC && FREETZ_PACKAGE_JQ_WITH_RE_SUPPORT
	help
		jq is a command-line JSON processor.

		Because all files together need some room in the image
		file (600-800 KB uncompressed), it's possible to move
		them to an 'external' image, if it's activated at all.

config FREETZ_PACKAGE_JQ_WITH_RE_SUPPORT
	bool "include support for regular expresssions using Oniguruma"
	depends on FREETZ_PACKAGE_JQ && FREETZ_SHOW_EXPERT
	default y
	help
		Support for regular expressions adds 358 KB uncompressed
		(about 105 KB compressed) to the final image (in the
		binary and/or a shared library).
		You may omit RE support here, if you'll not need it.

config FREETZ_PACKAGE_JQ_STATIC
	bool "Build static binary"
	depends on FREETZ_PACKAGE_JQ && FREETZ_SHOW_EXPERT
	default n
	help
		The resulting binary takes ~800 KB (~250 KB compressed)
		on a MIPS-based architecture (-march=34kc).
```

## make/juis_check/Config.in
```kconfig
config FREETZ_PACKAGE_JUIS_CHECK
	bool "juis_check 0.5"
	select FREETZ_BUSYBOX_NC
	select FREETZ_BUSYBOX_NC_110_COMPAT
	default n
	help
		juis_check script from PeterPawn's YourFritz.
```

## make/letsencrypt/Config.in
```kconfig
config FREETZ_PACKAGE_LETSENCRYPT
	bool "LetsEncrypt.sh git"
	select FREETZ_PACKAGE_CABUNDLE
	select FREETZ_BUSYBOX_MKTEMP
	select FREETZ_PACKAGE_BASH
	select FREETZ_PACKAGE_CURL
	select FREETZ_PACKAGE_OPENSSL
	default n
	help
		This generates free Let's Encrypt SSL/TLS Certificates,
		see https://github.com/lukas2511/letsencrypt.sh

choice
	depends on FREETZ_PACKAGE_LETSENCRYPT
	prompt "Version"
	default FREETZ_PACKAGE_LETSENCRYPT_VERSION_CUSTOM

	config FREETZ_PACKAGE_LETSENCRYPT_VERSION_LATEST
		bool "latest"

	config FREETZ_PACKAGE_LETSENCRYPT_VERSION_CUSTOM
		bool "custom"

endchoice

config FREETZ_PACKAGE_LETSENCRYPT_VERSION_COMMIT
	string "Revision"
	depends on FREETZ_PACKAGE_LETSENCRYPT && FREETZ_PACKAGE_LETSENCRYPT_VERSION_CUSTOM
	default "2b50c72b75"
```

## make/lftp/Config.in
```kconfig
config FREETZ_PACKAGE_LFTP
	bool "lftp 4.8.4 (binary only)"
	select FREETZ_LIB_libdl       if !FREETZ_PACKAGE_LFTP_STATIC && FREETZ_TARGET_UCLIBC_HAS_multiple_libs
	select FREETZ_LIB_libncurses  if !FREETZ_PACKAGE_LFTP_STATIC
	select FREETZ_LIB_libreadline if !FREETZ_PACKAGE_LFTP_STATIC
	select FREETZ_LIB_STDCXXLIB   if !FREETZ_PACKAGE_LFTP_STATIC
	select FREETZ_LIB_libutil     if !FREETZ_PACKAGE_LFTP_STATIC && FREETZ_TARGET_UCLIBC_HAS_multiple_libs
	select FREETZ_LIB_libexpat    if !FREETZ_PACKAGE_LFTP_STATIC
	select FREETZ_LIB_libz        if !FREETZ_PACKAGE_LFTP_STATIC
	default n
	help
		LFTP is sophisticated file transfer program with command line interface.
		It supports FTP, HTTP, FISH, SFTP, HTTPS and FTPS protocols.
		GNU Readline library is used for input.

config FREETZ_PACKAGE_LFTP_WITH_SSL
	bool "build with SSL support"
	depends on FREETZ_PACKAGE_LFTP
	select FREETZ_LIB_libcrypto if !FREETZ_PACKAGE_LFTP_STATIC
	select FREETZ_LIB_libssl    if !FREETZ_PACKAGE_LFTP_STATIC
	default n
	help
		This option enables SSL support.

config FREETZ_PACKAGE_LFTP_STATIC
	bool "Link statically"
	depends on FREETZ_PACKAGE_LFTP
	default n
	help
		Build lftp binary with statically linked libraries.
```

## make/libs/Config.in
```kconfig
menu "C++"

config FREETZ_LIB_STDCXXLIB
	bool
	select FREETZ_LIB_libuClibc__ if FREETZ_STDCXXLIB_USE_UCLIBCXX
	select FREETZ_LIB_libstdc__ if FREETZ_STDCXXLIB_USE_GNULIBSTDCXX
	default n

config FREETZ_LIB_STDCXXLIB_WITH_WCHAR
	bool
	select FREETZ_LIB_libuClibc__WITH_WCHAR if FREETZ_STDCXXLIB_USE_UCLIBCXX
	default n

source make/libs/libstdcxx/Config.in
source make/libs/uclibcxx/Config.in

endmenu


menu "Crypto & SSL"

comment "Math -----------------------------------"

source make/libs/gmp/Config.in
source make/libs/mpfr/Config.in
source make/libs/mpc/Config.in

comment "GnuPG ----------------------------------"

source make/libs/libgpg-error/Config.in
source make/libs/libgcrypt/Config.in

comment "SSL ------------------------------------"

source make/libs/cyassl/Config.in
source make/libs/matrixssl/Config.in
source make/libs/polarssl/Config.in
source make/libs/openssl/Config.in
source make/libs/libavmhmac/Config.in

comment "GnuTLS ---------------------------------"

source make/gnutls/Config.in.libs
source make/libs/libtasn1/Config.in

endmenu

menu "Data compression"

source make/libs/lzo/Config.in
source make/libs/zlib/Config.in

endmenu

source make/e2fsprogs/Config.in.libs

menu "GLib"

source make/libs/glib/Config.in
source make/libs/glib2/Config.in

endmenu

menu "Graphics & fonts"

source make/libs/freetype/Config.in
source make/libs/libart_lgpl/Config.in
source make/libs/libexif/Config.in
source make/libs/jpeg/Config.in
source make/libs/libpng/Config.in
source make/libs/gd/Config.in
source make/libs/openjpeg/Config.in
source make/netpbm/Config.in.libs

endmenu

menu Multimedia

source make/ffmpeg/Config.in.libs

menu Ogg/Vorbis

source make/libs/libogg/Config.in
source make/libs/libvorbis/Config.in

endmenu

source make/libs/flac/Config.in
source make/libs/libid3tag/Config.in
source make/libs/libmad/Config.in
source make/libs/taglib/Config.in

endmenu

menu "ncurses"

source make/libs/ncurses/Config.in

endmenu

menu "Readline"

source make/libs/readline/Config.in

endmenu

menu "uClibc"

source make/libs/uclibc/Config.in

endmenu

menu "XML/XSLT"

source make/libs/expat/Config.in
source make/libs/libxml2/Config.in
source make/xsltproc/Config.in.libs

endmenu

source make/libs/apr/Config.in
source make/libs/apr-util/Config.in
source make/libs/db/Config.in
source make/libs/bluez-libs/Config.in
source make/libs/libcapi/Config.in
source make/libs/libgcc_s/Config.in
source make/libs/libconfig/Config.in
source make/curl/Config.in.libs
source make/libs/libdaemon/Config.in
source make/libs/devmapper/Config.in
source make/libs/libdnet/Config.in
source make/libs/libelf/Config.in
source make/libs/libevent/Config.in
source make/libs/libffi-sable/Config.in
source make/libs/libfreetz/Config.in
source make/libs/libftdi/Config.in
source make/fuse/Config.in.libs
source make/libs/libiconv/Config.in
source make/libs/gettext/Config.in
source make/libs/js/Config.in
source make/libs/libtool/Config.in
source make/lua/Config.in.libs
source make/libs/neon/Config.in
source make/libs/libnet/Config.in
source make/ntfs/Config.in.libs
source make/libs/openobex/Config.in
source make/libs/liboping/Config.in
source make/libs/libosip2/Config.in
source make/libs/libpcap/Config.in
source make/libs/pcre/Config.in
source make/libs/pjproject/Config.in
source make/libs/popt/Config.in
source make/libs/protobuf-c/Config.in
source make/rrdtool/Config.in.libs
source make/slang/Config.in.libs
source make/sqlite/Config.in.libs
source make/libs/libsynce/Config.in
source make/libs/sysfsutils/Config.in
source make/libs/libusb/Config.in
source make/libs/libusb1/Config.in
source make/libs/linux-atm/Config.in
source make/libs/wxWidgets/Config.in
```

## make/libs/apr-util/Config.in
```kconfig
config FREETZ_LIB_libaprutil
	select FREETZ_LIB_libapr
	select FREETZ_LIB_libexpat
	select FREETZ_LIB_libsqlite3
	bool "Apache Portable Runtime Utility Library (libaprutil-1.so)"
	default n
	help
		APR Util is a utilities library implemented on top of APR, providing
		database access, xml parsing, and other useful functionality.

config FREETZ_LIB_libaprutil_WITH_LIBDB
	select FREETZ_LIB_libdb
	bool "Build with Berkeley-DB support" if FREETZ_LIB_libaprutil
	default n
	help
		This option enables Berkeley-DB support in libaprutil.
```
