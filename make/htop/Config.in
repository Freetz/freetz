## make/htop/Config.in
```kconfig
config FREETZ_PACKAGE_HTOP
	bool "htop 1.0.3/3.2.0 (binary only)"
	select FREETZ_LIB_libncurses
	select FREETZ_LIB_libm   if FREETZ_TARGET_UCLIBC_HAS_multiple_libs
	select FREETZ_LIB_libdl  if FREETZ_TARGET_UCLIBC_HAS_multiple_libs && !FREETZ_PACKAGE_HTOP_VERSION_ABANDON
	default n
	help
		htop is a more powerful alternative to top, using ncurses.

if FREETZ_PACKAGE_HTOP

	config FREETZ_PACKAGE_HTOP_VERSION_ABANDON
		bool
		default y
		depends on !FREETZ_TARGET_GCC_4_8_MIN

endif # FREETZ_PACKAGE_HTOP
```

## make/httpry/Config.in
```kconfig
config FREETZ_PACKAGE_HTTPRY
	bool "httpry 0.1.8"
	default n
	select FREETZ_LIB_libpcap
	help
		httpry is a specialized packet sniffer designed for displaying
		and logging HTTP traffic. It is not intended to perform analysis
		itself, but to capture, parse, and log the traffic for later
		analysis. It can be run in real-time displaying the traffic as
		it is parsed, or as a daemon process that logs to an output file.
		It is written to be as lightweight and flexible as possible, so
		that it can be easily adaptable to different applications.
		http://dumpsterventures.com/jason/httpry/

config FREETZ_PACKAGE_HTTPRY_REMOVE_WEBIF
	bool "remove webinterface"
	depends on FREETZ_PACKAGE_HTTPRY
	default n
	help
		This option removes the webinterface
```

## make/httptunnel/Config.in
```kconfig
config FREETZ_PACKAGE_HTTPTUNNEL
	bool "httptunnel 3.3 (binary only)"
	default n
	help
		httptunnel is a utility that provides a HTTP tunnel server.
```

## make/iftop/Config.in
```kconfig
config FREETZ_PACKAGE_IFTOP
	bool "iftop 0.17 (binary only)"
	select FREETZ_LIB_libpthread  if FREETZ_TARGET_UCLIBC_HAS_multiple_libs
	select FREETZ_LIB_libncurses
	select FREETZ_LIB_libpcap
	select FREETZ_LIB_libm        if FREETZ_TARGET_UCLIBC_HAS_multiple_libs
	default n
	help
		iftop does for network usage what top(1) does for CPU usage. It listens
		to network traffic on a named interface and displays a table of current
		bandwidth usage by pairs of hosts. Handy for answering the question "why
		is our ADSL link so slow?".
		WWW: http://www.ex-parrot.com/pdw/iftop/
```

## make/igmpproxy/Config.in
```kconfig
config FREETZ_PACKAGE_IGMPPROXY
	bool "igmpproxy 0.1 (binary only)"
	default n
	help
		IGMPproxy is a simple dynamic Multicast Routing Daemon using only
		IGMP signalling.
		It's intended for simple forwarding of Multicast traffic between networks.
```

## make/imagemagick/Config.in
```kconfig
config FREETZ_PACKAGE_IMAGEMAGICK
	bool "ImageMagick 7.0.4-3 (binary only)"
	select FREETZ_LIB_libpthread
	select FREETZ_LIB_libm
	default n
	help
		ImageMagick is a robust collection of tools and libraries to read,
		write, and manipulate an image in many image formats, including popular
		formats like TIFF, JPEG, PNG, PDF, PhotoCD, and GIF. With ImageMagick,
		you can create images dynamically, making it suitable for Web
		applications. You can also resize, rotate, sharpen, color-reduce, or
		add special effects to an image and save your completed work in many
		different image formats. Image processing operations are available from
		the command line as well as through C, C++, and PERL-based programming
		interfaces.

menu "Configuration"
	depends on FREETZ_PACKAGE_IMAGEMAGICK

config FREETZ_PACKAGE_IMAGEMAGICK_freetype
	bool "freetype"
	depends on FREETZ_PACKAGE_IMAGEMAGICK
	default y
	select FREETZ_LIB_libfreetype

config FREETZ_PACKAGE_IMAGEMAGICK_ghostscript_fonts
	bool "Ghostscript fonts"
	depends on FREETZ_PACKAGE_IMAGEMAGICK
	default n
	select FREETZ_PACKAGE_GHOSTSCRIPT_FONTS

config FREETZ_PACKAGE_IMAGEMAGICK_jpeg
	bool "jpeg"
	depends on FREETZ_PACKAGE_IMAGEMAGICK
	default y
	select FREETZ_LIB_libjpeg

config FREETZ_PACKAGE_IMAGEMAGICK_libz
	bool "libz"
	depends on FREETZ_PACKAGE_IMAGEMAGICK
	default y
	select FREETZ_LIB_libz

config FREETZ_PACKAGE_IMAGEMAGICK_png
	bool "png"
	depends on FREETZ_PACKAGE_IMAGEMAGICK
	default y
	select FREETZ_LIB_libpng12

config FREETZ_PACKAGE_IMAGEMAGICK_xml
	bool "xml"
	depends on FREETZ_PACKAGE_IMAGEMAGICK
	default y
	select FREETZ_LIB_libxml2

endmenu

config FREETZ_PACKAGE_IMAGEMAGICK_STATIC
	bool "Create statically linked binaries"
	depends on FREETZ_PACKAGE_IMAGEMAGICK
	default n
	help
		Causes all dependent libraries to be linked in statically.
```

## make/inadyn-mt/Config.in
```kconfig
config FREETZ_PACKAGE_INADYN_MT
	bool "Inadyn-mt 02.28.10"
	select FREETZ_LIB_libpthread if FREETZ_TARGET_UCLIBC_HAS_multiple_libs
	default n
	help
		INADYN-MT - Simple Dynamic DNS client.

		INADYN-MT is a free DynDNS client. It gives the possibility to have your
		own fixed hostname registered on the internet, although your IP might
		be changing. It checks periodically whether the IP address stored by
		the DNS server is the real current IP address of the machine that is
		running INADYN.
```

## make/inadyn-opendns/Config.in
```kconfig
config FREETZ_PACKAGE_INADYN_OPENDNS
	bool "Inadyn-OpenDNS 1.99"
	select FREETZ_LIB_libcurl
	select FREETZ_LIB_libcurl_WITH_SSL
	default n
	help
		INADYN - Simple Dynamic DNS client.

		INADYN is a free DynDNS client. It gives the possibility to have your
		own fixed hostname registered on the internet, although your IP might
		be changing. It checks periodically whether the IP address stored by
		the DNS server is the real current IP address of the machine that is
		running INADYN.

		This is the version published by OpenDNS to support SSL.
```

## make/inadyn/Config.in
```kconfig
config DS_PACKAGE_INADYN
	bool "Inadyn 1.96.2"
	default n
	help
		INADYN - Simple Dynamic DNS client.

		INADYN is a free DynDNS client. It gives the possibility to have your
		own fixed hostname registered on the internet, although your IP might
		be changing. It checks periodically whether the IP address stored by
		the DNS server is the real current IP address of the machine that is
		running INADYN.
```

## make/inetd/Config.in
```kconfig
config FREETZ_PACKAGE_INETD
	bool "Inetd 0.2"
	select FREETZ_BUSYBOX_INETD
	default n
	help
		'Virtual' inetd package. Provides configuration framework for
		inetd. Requires a compatible inetd binary. (at the moment, only
		busybox inetd is supported)

config FREETZ_PACKAGE_INETD_TIME
	bool "Select 'time' server support"
	depends on FREETZ_PACKAGE_INETD
	select FREETZ_BUSYBOX_FEATURE_INETD_SUPPORT_BUILTIN_TIME
	default n
```

## make/inotify-tools/Config.in
```kconfig
config FREETZ_PACKAGE_INOTIFY_TOOLS
	bool "inotify-tools 3.14"
	default n
	help
		inotify-tools - watch file and directory access

		inotify-tools is a C library and a set of command-line programs for
		Linux providing a simple interface to inotify. These programs can be
		used to monitor and act upon filesystem events. The programs are
		written in C and have no dependencies other than a Linux kernel
		supporting inotify.

		inotifywait
		This command simply blocks for inotify events, making it appropriate
		for use in shell scripts. It can watch any set of files and
		directories, and can recursively watch entire directory trees.

		inotifywatch
		inotifywatch collects filesystem usage statistics and outputs counts of
		each inotify event.

		Please read https://freetz.github.io/wiki/packages/inotify_tools for further
		details. Improper usage can lead to reboots.
```

## make/iperf/Config.in
```kconfig
config FREETZ_PACKAGE_IPERF
	bool "iperf 3.9 (binary only)"
	default n
	help
		iPerf3 is a tool for active measurements of the maximum achievable
		bandwidth on IP networks. It supports tuning of various parameters
		related to timing, buffers and protocols (TCP, UDP, SCTP with IPv4
		and IPv6). For each test it reports the bandwidth, loss, and other
		parameters. S. https://github.com/esnet/iperf for more details.

config FREETZ_PACKAGE_IPERF_WITH_OPENSSL
	bool "build with SSL support"
	depends on FREETZ_PACKAGE_IPERF
	select FREETZ_LIB_libcrypto if !FREETZ_PACKAGE_IPERF_STATIC
	default n
	help
		This option enables OpenSSL support in iperf.

config FREETZ_PACKAGE_IPERF_STATIC
	bool "Link statically"
	depends on FREETZ_PACKAGE_IPERF_WITH_OPENSSL
```

## make/ipsec-tools/Config.in
```kconfig
config FREETZ_PACKAGE_IPSEC_TOOLS
	bool "IPsec-tools 0.7.2"
	depends on FREETZ_KERNEL_VERSION_2_6_32_MAX # version 0.7.2 doesn't compile with kernel versions >= 3.x
	depends on FREETZ_REPLACE_KERNEL
	select FREETZ_LIB_libcrypto           if !FREETZ_PACKAGE_IPSEC_TOOLS_STATIC
	select FREETZ_LIB_libutil             if !FREETZ_PACKAGE_IPSEC_TOOLS_STATIC && FREETZ_TARGET_UCLIBC_HAS_multiple_libs
#	select FREETZ_MODULE_ah4
#	select FREETZ_MODULE_esp4
#	select FREETZ_MODULE_xfrm_user
#	select FREETZ_MODULE_af_key
	default n
	help
		IPsec-tools (plainrsa-gen racoon racoonctl setkey)

config FREETZ_PACKAGE_IPSEC_TOOLS_STATIC
	bool "Link statically"
	depends on FREETZ_PACKAGE_IPSEC_TOOLS
	default n
	help
		IPsec-tools need the following shared libraries which can be linked in statically
		by activating this switch:
		- libipsec
		- libracoon (for racoonctl only)
		- libcrypto
		- libutil

config FREETZ_PACKAGE_IPSEC_TOOLS_WITH_LZO
	bool "With lzo Compression"
	depends on FREETZ_PACKAGE_IPSEC_TOOLS
	select FREETZ_LIB_liblzo2 if ! FREETZ_PACKAGE_IPSEC_TOOLS_STATIC
	default n
	help
		Maybe this target gets useful
		LZO2 Compression for VPN Traffic

config FREETZ_PACKAGE_IPSEC_TOOLS_WITH_PLAINRSAGEN
	bool "Include \"plainrsa-gen\" a generator for Plain RSA keys "
	depends on FREETZ_PACKAGE_IPSEC_TOOLS
	default n
	help
		Includes IPsec-tools plainrsa-gen into the image.

config FREETZ_PACKAGE_IPSEC_TOOLS_WITH_RACOONCTL
	bool "Include \"racoonctl\", the racoon administrative control tool "
	depends on FREETZ_PACKAGE_IPSEC_TOOLS
	default n
	help
		Includes IPsec-tools racoonctl into the image.
		racoonctl is used to control racoon operation, if ipsec-tools was configured with adminport support.
		Communication between racoonctl and racoon is done through a UNIX socket.
```

## make/iptables-cgi/Config.in
```kconfig
config FREETZ_PACKAGE_IPTABLES_CGI
	bool "Iptables-CGI 1.1"
	select FREETZ_PACKAGE_IPTABLES_SAVE_RESTORE
	default n

	# Be visible only if iptables is selected
	depends on FREETZ_PACKAGE_IPTABLES

	# select standard set of iptable modules and libs
	select FREETZ_PACKAGE_IPTABLES_STANDARD_MODULES
```
