## make/pkgs/netatalk/Config.in
```kconfig
config FREETZ_PACKAGE_NETATALK
	bool "Netatalk 2.2.5"
	select FREETZ_LIB_libdl       if FREETZ_TARGET_UCLIBC_HAS_multiple_libs
	select FREETZ_LIB_libpthread  if FREETZ_TARGET_UCLIBC_HAS_multiple_libs
	select FREETZ_LIB_libdb
	select FREETZ_PACKAGE_NETATALK_DHX2 if !FREETZ_PACKAGE_NETATALK_DHX
	default n
	help
		Netatalk is a kernel level implementation of the AppleTalk
		Protocol Suite which contains the AppleShare file server (AFP).

if FREETZ_PACKAGE_NETATALK

config FREETZ_PACKAGE_NETATALK_ENABLE_ZEROCONF
	bool "build with zeroconf support"
	select FREETZ_LIB_libdbus
	select FREETZ_PACKAGE_DBUS
	select FREETZ_PACKAGE_AVAHI
	select FREETZ_LIB_libavahi_common
	select FREETZ_LIB_libavahi_client
	default n
	help
		This option enables Zeroconf support for netatalk. Thus enables
		afpd to register its shares via dbus-daemon at avahi-daemon.
		You want to select this option, if you want your afpd shares
		and Time Machine shares being visible on the Apple/Finder and the
		Time Machine Menu.

config FREETZ_PACKAGE_NETATALK_DBD
	bool "build with cnid database repair tool"
	default n
	help
		This option adds the dbd utility, the CNID database and
		volume maintanance and intergrity check utility.

config FREETZ_PACKAGE_NETATALK_DHX
	bool "build with uams_dhx"
	select FREETZ_LIB_libcrypt    if FREETZ_TARGET_UCLIBC_HAS_multiple_libs
	select FREETZ_LIB_libcrypto
	default n
	help
		This option enables the uams_dhx.so module for authentication purposes. See
		http://netatalk.sourceforge.net/2.2/htmldocs/configuration.html#id4167131
		for further details.

config FREETZ_PACKAGE_NETATALK_DHX2
	bool "build with uams_dhx2"
	select FREETZ_LIB_libcrypt    if FREETZ_TARGET_UCLIBC_HAS_multiple_libs
	select FREETZ_LIB_libgcrypt
	select FREETZ_LIB_libgcrypt_WITH_SYMMETRIC_CIPHER_cast5
	default n
	help
		This option enables the uams_dhx2.so module for authentication purposes. See
		http://netatalk.sourceforge.net/2.2/htmldocs/configuration.html#id4167131
		for further details.

endif # FREETZ_PACKAGE_NETATALK
```

## make/pkgs/netcat/Config.in
```kconfig
config FREETZ_PACKAGE_NETCAT
	bool "netcat 0.7.1 (binary only)"
	default n
	help
		A feature-rich network debugging and exploration tool.
```

## make/pkgs/nfs-utils/Config.in
```kconfig
comment "nfs-utils (not available, needs kernel modules)"
	depends on !(FREETZ_AVM_HAS_NFSD_BUILTIN || FREETZ_REPLACE_MODULE_AVAILABLE)

config FREETZ_PACKAGE_NFS_UTILS
	bool "nfs-utils 1.3.4 (binary only)"
	default n
	depends on FREETZ_AVM_HAS_NFSD_BUILTIN || FREETZ_REPLACE_MODULE_AVAILABLE
	select FREETZ_LIB_libtirpc if !FREETZ_TARGET_UCLIBC_SUPPORTS_rpc
	select FREETZ_ADD_ETCSERVICES if !FREETZ_AVM_HAS_ETCSERVICES
	select FREETZ_PACKAGE_TCP_WRAPPERS
	select FREETZ_MODULE_nfsd if !FREETZ_AVM_HAS_NFSD_BUILTIN
	help
		Linux NFS utility package
		Select nfsd-cgi if you want a configuration web interface.
		If this does not work, enable replace-kernel!
```

## make/pkgs/nfsroot/Config.in
```kconfig
comment "NFS-root (not available, needs replace kernel)"
	depends on !FREETZ_REPLACE_KERNEL

config FREETZ_PACKAGE_NFSROOT
	bool "NFS-root 0.1"
	depends on FREETZ_REPLACE_KERNEL
	select FREETZ_MODULE_nfs if !FREETZ_AVM_HAS_NFS_FS_BUILTIN
	default n
	help
		Mount a remote filesystem (fs) from an NFS server and use it as a root fs
		which is fully writable and basically unlimited in size. The Linux kernel will
		still be loaded from your box and during the first phase of the init process
		the SquashFS on the box is still used, but after the NFS-root is mounted, we
		pivot_root into it and it becomes the new root fs. The read-only fs on the box
		can still be accessed under /oldroot, but is absolutely not necessary anymore
		after pivot_root.

		Having said that, it should be clear that the remote folder to be mounted
		should contain everything necessary to run the box. Usually you just create
		a full copy of a target fs (e.g. from build/modified/filesystem or from an
		unpacked firmware image) and start modifying it as needed. The binaries
		(kernel modules, executables, shared libraries) used therein just have to fit
		the kernel installed on the box.

		Note: The mini_fo overlay filesystem will not be used if an NFS-root was
		mounted first (see mini_fo package). Still, both packages can be
		installed at the same time, because mini_fo is still useful if NFS-root
		is decativated.

		Note: This package needs "replace kernel" because a kernel patch is necessary
		to make the 'nfsroot' bootloader environment variable usable for our purpose.
		So, if if "replace kernel" is inactive, you will not see this package in
		menuconfig.

		Note: There currently is no web interface for this package, because an
		NFS-root is an expert thing anyway. The command-line interface and help screen
		of /etc/init.d/rc.nfs makes it pretty easy to (de-)activate and configure the
		functionality of this package. As configuration data are stored in bootloader
		environment rather than in TFFS like for other packages, this package is
		special anyway.
```

## make/pkgs/ngircd/Config.in
```kconfig
config FREETZ_PACKAGE_NGIRCD
	bool "ngircd 22"
	default n
	help
		ngIRCd is an Open Source server for the Internet Relay Chat (IRC), which
		is developed and published under the terms of the GNU General Public
		Licence (URL: http://www.gnu.org/licenses/gpl.html). ngIRCd means "next
		generation IRC daemon", it's written from scratch and not deduced from the
		"grandfather of IRC daemons", the daemon of the IRCNet.
		For documentation see: http://ngircd.barton.de/documentation.php.de

config FREETZ_PACKAGE_NGIRCD_WITH_TCP_WRAPPERS
	bool "Add TCP_WRAPPERS support"
	depends on FREETZ_PACKAGE_NGIRCD
	select FREETZ_PACKAGE_TCP_WRAPPERS if ! FREETZ_PACKAGE_NGIRCD_STATIC
	default n
	help
		This option adds TCP WRAPPERS support to ngircd

config FREETZ_PACKAGE_NGIRCD_WITH_ZLIB
	bool "With zlib Compression"
	depends on FREETZ_PACKAGE_NGIRCD
	select FREETZ_LIB_libz if ! FREETZ_PACKAGE_NGIRCD_STATIC
	default n
	help
		ZLIB Compression for IRC Traffic

config FREETZ_PACKAGE_NGIRCD_WITH_SSL
	bool "build with SSL support"
	depends on FREETZ_PACKAGE_NGIRCD
	select FREETZ_LIB_libcrypto if !FREETZ_PACKAGE_NGIRCD_STATIC
	select FREETZ_LIB_libssl    if !FREETZ_PACKAGE_NGIRCD_STATIC
	select FREETZ_LIB_libdl     if !FREETZ_PACKAGE_NGIRCD_STATIC && FREETZ_TARGET_UCLIBC_HAS_multiple_libs
	default n
	help
		This option enables SSL support for ngircd.

config FREETZ_PACKAGE_NGIRCD_STATIC
	bool "Link statically"
	depends on FREETZ_PACKAGE_NGIRCD
	default n
	help
		Causes all libraries ngircd depends on to be linked in statically.
```

## make/pkgs/onlinechanged-cgi/Config.in
```kconfig
config FREETZ_PACKAGE_ONLINECHANGED_CGI
	bool "Onlinechanged-CGI"
	default n
	help
		When the online-status changes (e.g. a forced re-connect)
		this CGI allows you to specify arbitrary commands which are
		executed at that event. The following different change events
		are considered: initial start of the box, going online (IPv4),
		going onlineipv6 (IPv6), going offline (IPv4) and going
		offlineipv6 (IPv6).
```

## make/pkgs/openconnect/Config.in
```kconfig
config FREETZ_PACKAGE_OPENCONNECT
	bool "OpenConnect 7.04 (binary only)"
	select FREETZ_LIB_libcrypto   if ! FREETZ_PACKAGE_OPENCONNECT_STATIC
	select FREETZ_LIB_libdl       if ! FREETZ_PACKAGE_OPENCONNECT_STATIC && FREETZ_TARGET_UCLIBC_HAS_multiple_libs
	select FREETZ_LIB_libm        if ! FREETZ_PACKAGE_OPENCONNECT_STATIC && FREETZ_TARGET_UCLIBC_HAS_multiple_libs
	select FREETZ_LIB_libpthread  if ! FREETZ_PACKAGE_OPENCONNECT_STATIC && FREETZ_TARGET_UCLIBC_HAS_multiple_libs
	select FREETZ_LIB_libssl      if ! FREETZ_PACKAGE_OPENCONNECT_STATIC
	select FREETZ_LIB_libxml2     if ! FREETZ_PACKAGE_OPENCONNECT_STATIC
	select FREETZ_LIB_libz        if ! FREETZ_PACKAGE_OPENCONNECT_STATIC
	default n
	help
		Cisco AnyConnect VPN Client

config FREETZ_PACKAGE_OPENCONNECT_STATIC
	bool "Link statically"
	depends on FREETZ_PACKAGE_OPENCONNECT
	default n
	help
		Build OpenConnect binary with statically linked libraries.
```

## make/pkgs/opendd/Config.in
```kconfig
config FREETZ_PACKAGE_OPENDD
	bool "OpenDD 0.7.9"
	default n
	help
		opendd is a DynDNS client, written in C, and especially designed
		for small gateway machines, like a Soekris box. Its main feature
		is that it does not require any Perl or Python interpreter.
		It supports HTTPS, can send a mail report, and can run as daemon.
		It is also very easy to deploy.
		WWW: http://www.bsdmon.com/wakka/OpenDD

if FREETZ_PACKAGE_OPENDD

	comment "SSL not available, needs OpenSSL 1.0 or older"
		depends on !FREETZ_OPENSSL_VERSION_1_MAX

	config FREETZ_PACKAGE_OPENDD_WITH_SSL
		bool "with SSL encryption (port 443)"
		depends on FREETZ_OPENSSL_VERSION_1_MAX
		select FREETZ_LIB_libcrypto
		select FREETZ_LIB_libssl
		default y
		help
			Build with SSL encryption (port 443)

endif # FREETZ_PACKAGE_OPENDD
```

## make/pkgs/openvpn-cgi/Config.in
```kconfig
config FREETZ_PACKAGE_OPENVPN_CGI
	depends on FREETZ_PACKAGE_OPENVPN
	depends on FREETZ_PACKAGE_OPENVPN_USE_V1_CGI
	bool
	select FREETZ_BUSYBOX_FEATURE_PS_WIDE
```

## make/pkgs/openvpn-v2-cgi/Config.in
```kconfig
config FREETZ_PACKAGE_OPENVPN_V2_CGI
	depends on FREETZ_PACKAGE_OPENVPN
	depends on FREETZ_PACKAGE_OPENVPN_USE_V2_CGI
	bool
```

## make/pkgs/phonebook-tools/Config.in
```kconfig
config FREETZ_PACKAGE_PHONEBOOK_TOOLS
	bool "Phone book tools 1.0"
	select FREETZ_BUSYBOX_GETOPT
	select FREETZ_BUSYBOX_GREP
	select FREETZ_BUSYBOX_EGREP
	select FREETZ_BUSYBOX_SED
	select FREETZ_BUSYBOX_TR
	default n
	help
		A set of tools for reading and converting Fritz!Box phone book
		to such (easy parseable) formats like:
		 - .csv (comma-separated values), or
		 - .tsv (tab-separated values).
```

## make/pkgs/portmap/Config.in
```kconfig
config FREETZ_PACKAGE_PORTMAP
	bool "portmap 6.0 (binary only)"
	depends on FREETZ_TARGET_UCLIBC_SUPPORTS_rpc
	default n
	select FREETZ_PACKAGE_TCP_WRAPPERS
	help
		portmap is a part of the ONCRPC collection of software for
		implementing remote procedure calls between computer programs.
		It is use widely by NFS and NIS, and assorted other systems.
```

## make/pkgs/pppd/Config.in
```kconfig
comment "Without 'replace kernel' you can not use mppe/mppc."
	depends on FREETZ_PACKAGE_PPPD && ! FREETZ_REPLACE_KERNEL

config FREETZ_PACKAGE_PPPD
	bool "pppd 2.4.7"
	depends on FREETZ_PACKAGE_PPP
	select FREETZ_LIB_libcrypt          if FREETZ_TARGET_UCLIBC_HAS_multiple_libs
	select FREETZ_LIB_libdl             if FREETZ_TARGET_UCLIBC_HAS_multiple_libs
	select FREETZ_MODULE_ppp_async      if !FREETZ_AVM_HAS_PPP_ASYNC_BUILTIN
	select FREETZ_MODULE_ppp_deflate    if !FREETZ_AVM_HAS_PPP_DEFLATE_BUILTIN
	select FREETZ_MODULE_ppp_generic    if !FREETZ_AVM_HAS_PPP_BUILTIN && !FREETZ_KERNEL_VERSION_2_6_28
	select FREETZ_MODULE_ppp_mppe_mppc  if !FREETZ_AVM_HAS_PPP_MPPE_MPPC_BUILTIN
	default n
	help
		An implementation of the Point-to-point protocol.

		http://www.samba.org/ppp/

config FREETZ_PACKAGE_PPPD_WITH_EAPTLS
	bool "with EAP-TLS support"
	depends on FREETZ_PACKAGE_PPPD
	select FREETZ_LIB_libcrypto
	select FREETZ_LIB_libssl
	default n
	help
		Adds support for EAP-TLS.

config FREETZ_PACKAGE_PPPD_CHAT
	bool "pppd chat"
	depends on FREETZ_PACKAGE_PPP
	select FREETZ_PACKAGE_PPPD
	default n
	help
		Automated conversational script with a modem
```

## make/pkgs/privatekeypassword/Config.in
```kconfig
config FREETZ_BOX_CERTIFICATE_SUPPORT_AVAILABLE
	bool
	depends on FREETZ_AVM_VERSION_06_0X_MIN
	default y

config FREETZ_PACKAGE_PRIVATEKEYPASSWORD
	bool "privatekeypassword 0.7-git"
	depends on FREETZ_BOX_CERTIFICATE_SUPPORT_AVAILABLE
	select FREETZ_LIB_libprivatekeypassword
	default n
	help
		Reveals the password for AVM's private key file (/var/flash/websrv_ssl_key.pem),
		makes it possible to reuse it for other packages.
```

## make/pkgs/proxychains-ng/Config.in
```kconfig
config FREETZ_PACKAGE_PROXYCHAINS_NG
	bool "ProxyChains-NG 4.14"
	select FREETZ_LIB_libpthread if FREETZ_TARGET_UCLIBC_HAS_multiple_libs
	default n
	help
		A preloader which hooks calls to sockets in dynamically
		linked programs and redirects it through one or more
		socks/http proxies, tor is also supported.

		Usage: proxychains4 telnet mail.example.com 25

if FREETZ_PACKAGE_PROXYCHAINS_NG

	choice
		prompt "Version"
		default FREETZ_PACKAGE_PROXYCHAINS_NG_VERSION_STABLE

		config FREETZ_PACKAGE_PROXYCHAINS_NG_VERSION_STABLE
			bool "stable 4.14"

		config FREETZ_PACKAGE_PROXYCHAINS_NG_VERSION_LATEST
			bool "latest git"

		config FREETZ_PACKAGE_PROXYCHAINS_NG_VERSION_CUSTOM
			bool "custom hash"

	endchoice

	config FREETZ_PACKAGE_PROXYCHAINS_NG_VERSION_COMMIT
		string "Revision"
		depends on FREETZ_PACKAGE_PROXYCHAINS_NG_VERSION_CUSTOM
		default "e895fb713a"

	config FREETZ_PACKAGE_PROXYCHAINS_NG_SELECT_TOR
		bool "Select Tor"
		depends on FREETZ_OPENSSL_VERSION_1_MIN
		select FREETZ_PACKAGE_TOR
		default n

endif # FREETZ_PACKAGE_PROXYCHAINS_NG
```

## make/pkgs/python-imaging-library/Config.in
```kconfig
config FREETZ_PACKAGE_PYTHON_IMAGING_LIBRARY
	bool "Imaging Library 1.1.7"
	depends on FREETZ_PACKAGE_PYTHON
	select FREETZ_LIB_libpython2 if !FREETZ_PACKAGE_PYTHON_STATIC
	select FREETZ_LIB_libfreetype
	select FREETZ_LIB_libjpeg
	select FREETZ_LIB_libz
	default n
	help
		The Python Imaging Library adds image processing capabilities to the Python interpreter.
		This library provides extensive file format support, an efficient internal representation,
		and fairly powerful image processing capabilities.
```

## make/pkgs/python-pycurl/Config.in
```kconfig
config FREETZ_PACKAGE_PYTHON_PYCURL
	bool "pycurl 7.43.0"
	depends on FREETZ_PACKAGE_PYTHON
	select FREETZ_LIB_libpython2 if !FREETZ_PACKAGE_PYTHON_STATIC
	select FREETZ_LIB_libcurl
	default n
	help
		PycURL is a Python interface to libcurl. PycURL can be used
		to fetch objects identified by a URL from a Python program.
```

## make/pkgs/python-pyopenssl/Config.in
```kconfig
comment "pyopenssl (not available, needs OpenSSL 1.0 or older)"
	depends on !FREETZ_OPENSSL_VERSION_1_MAX

config FREETZ_PACKAGE_PYTHON_PYOPENSSL
	bool "pyopenssl 0.13.1"
	depends on FREETZ_PACKAGE_PYTHON
	depends on FREETZ_OPENSSL_VERSION_1_MAX
	select FREETZ_PACKAGE_PYTHON_MOD_CTYPES
	select FREETZ_LIB_libpython2 if !FREETZ_PACKAGE_PYTHON_STATIC
	select FREETZ_LIB_libcrypto
	select FREETZ_LIB_libssl
	default n
	help
		Python interface to the OpenSSL library.
```

## make/pkgs/python-pyrrd/Config.in
```kconfig
config FREETZ_PACKAGE_PYTHON_PYRRD
	bool "pyrrd 0.1.0"
	depends on FREETZ_PACKAGE_PYTHON
	select FREETZ_PACKAGE_RRDTOOL
	default n
	help
		An Object-Oriented Python Interface for RRDTool.
```

## make/pkgs/python-pyserial/Config.in
```kconfig
config FREETZ_PACKAGE_PYTHON_PYSERIAL
	bool "pyserial 2.6"
	depends on FREETZ_PACKAGE_PYTHON
	select FREETZ_PACKAGE_PYTHON_MOD_CTYPES
	default n
	help
		Python Serial Port Extension.
```

## make/pkgs/python-yenc/Config.in
```kconfig
config FREETZ_PACKAGE_PYTHON_YENC
	bool "yEnc 0.4.0"
	depends on FREETZ_PACKAGE_PYTHON
	select FREETZ_LIB_libpython2 if !FREETZ_PACKAGE_PYTHON_STATIC
	default n
```

## make/pkgs/rpcbind/Config.in
```kconfig
config FREETZ_PACKAGE_RPCBIND
	bool "RPCBind 1.2.6 (binary only)"
	depends on !FREETZ_TARGET_UCLIBC_SUPPORTS_rpc
	default n
	select FREETZ_PACKAGE_TCP_WRAPPERS
	select FREETZ_LIB_libtirpc
	select FREETZ_ADD_ETCNETCONFIG
	help
		The rpcbind utility is a server that converts
		RPC program numbers into universal addresses.

config FREETZ_PACKAGE_RPCBIND_RPCINFO
	bool "RPCInfo"
	depends on FREETZ_PACKAGE_RPCBIND
	default n
	help
		The rpcinfo utility makes an RPC call to an
		RPC server and reports what it finds. 
```
