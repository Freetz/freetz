## make/pkgs/rrdtool/Config.in
```kconfig
config FREETZ_PACKAGE_RRDTOOL
	bool "RRDtool 1.2.30 (binary only)"
	select FREETZ_LIB_librrd
	select FREETZ_LIB_libm if FREETZ_TARGET_UCLIBC_HAS_multiple_libs
	select FREETZ_LIB_libz
	default n
	help
		RRDtool is the OpenSource industry standard, high
		performance data logging and graphing system for
		time series data. Use it to write your custom
		monitoring shell scripts or create whole applications
		using its PHP bindings.
```

## make/pkgs/rsync/Config.in
```kconfig
config FREETZ_PACKAGE_RSYNC
	bool "rsync 3.2.6"
	select FREETZ_LIB_libpopt
	select FREETZ_LIB_libz
	default n
	help
		rsync is an open source utility that provides fast incremental
		file transfer.
```

## make/pkgs/sablevm-sdk/Config.in
```kconfig
config FREETZ_PACKAGE_SABLEVM_SDK
	bool "sablevm 1.13 (binary only)"
	select FREETZ_LIB_libltdl     if FREETZ_TARGET_UCLIBC_HAS_multiple_libs
	select FREETZ_LIB_libm        if FREETZ_TARGET_UCLIBC_HAS_multiple_libs
	select FREETZ_LIB_libffi
	select FREETZ_LIB_libpopt
	select FREETZ_LIB_libpthread  if FREETZ_TARGET_UCLIBC_HAS_multiple_libs
	select FREETZ_LIB_libz
	default n
	help
		SableVM is a robust, extremely portable, efficient, and specifications-compliant
		Java virtual machine that aims to be easy to maintain and to extend. It features
		a state-of-the-art and efficient interpreter engine. Its source code is very
		accessible and easy to understand. It also has many robustness features that have
		been the object of careful design.

config FREETZ_PACKAGE_SABLEVM_SDK_MINI
	bool "use mini classlist"
	depends on FREETZ_PACKAGE_SABLEVM_SDK
	default y
	help
		Use minimalistic (400 KB) instead of full featured classlist (14 MB).
```
