## make/quagga/Config.in
```kconfig
config FREETZ_PACKAGE_QUAGGA
	bool "quagga 0.99.17"
	default n
	select FREETZ_LIB_libcrypt  if FREETZ_TARGET_UCLIBC_HAS_multiple_libs
	select FREETZ_LIB_librt     if FREETZ_TARGET_UCLIBC_HAS_multiple_libs
	select FREETZ_LIB_libncurses
	select FREETZ_LIB_libreadline
	select FREETZ_LIB_libhistory
	select FREETZ_BUSYBOX_START_STOP_DAEMON
	select FREETZ_BUSYBOX_SEQ
	select FREETZ_ADD_ETCSERVICES if !FREETZ_AVM_HAS_ETCSERVICES
	select FREETZ_PACKAGE_QUAGGA_ZEBRA
	select FREETZ_PACKAGE_QUAGGA_VTYSH
	help
		The Quagga Software Routing Suite

		A routing software package that provides TCP/IP based routing services
		with routing protocols support such as RIPv1, RIPv2, RIPng, OSPFv2,
		OSPFv3, BGP-4, and BGP-4+.

		This package does not provide any configuration help yet, though you
		can edit the configuration file(s) via the web interface. You can
		find the documentation at http://www.quagga.net/.
		YOU SHOULD NOT SELECT THIS PACKAGE (I.E. YOU DO NOT NEED IT)
		IF YOU DON'T KNOW HOW TO CONFIGURE THE ROUTING DAEMONS!
		(However: a guided/safe config interface is on the todo list ;-)

if FREETZ_PACKAGE_QUAGGA

	config FREETZ_PACKAGE_QUAGGA_ZEBRA
		bool

	config FREETZ_PACKAGE_QUAGGA_VTYSH
		bool

	config FREETZ_PACKAGE_QUAGGA_BGPD
		bool "bgpd"
		default n

	config FREETZ_PACKAGE_QUAGGA_RIPD
		bool "ripd"
		default n

	config FREETZ_PACKAGE_QUAGGA_RIPNGD
		bool "ripngd"
		depends on FREETZ_TARGET_IPV6_SUPPORT
		default n

	config FREETZ_PACKAGE_QUAGGA_OSPFD
		bool "ospfd"
		default n

	config FREETZ_PACKAGE_QUAGGA_OSPF6D
		bool "ospf6d"
		depends on FREETZ_TARGET_IPV6_SUPPORT
		default n

	config FREETZ_PACKAGE_QUAGGA_ISISD
		bool "isisd"
		default n

endif # FREETZ_PACKAGE_QUAGGA
```

## make/radvd/Config.in
```kconfig
comment "radvd (not available, needs IPv6 support of the kernel)"
	depends on !FREETZ_TARGET_IPV6_SUPPORT

menuconfig FREETZ_PACKAGE_RADVD
	bool "radvd 1.9.3/2.19"
	depends on FREETZ_TARGET_IPV6_SUPPORT
	select FREETZ_BUSYBOX_IP
	default n
	help
		The "router advertisement daemon" (radvd) is used for host autoconfiguration in ipv6 networks.

if FREETZ_PACKAGE_RADVD

	choice
		prompt "Version"
			default FREETZ_PACKAGE_RADVD_VERSION_CURRENT

		config FREETZ_PACKAGE_RADVD_VERSION_ABANDON
			bool "1.x"
			depends on FREETZ_KERNEL_VERSION_2_6_13
			select FREETZ_LIB_libdaemon

		config FREETZ_PACKAGE_RADVD_VERSION_CURRENT
			bool "2.x"
			depends on !FREETZ_KERNEL_VERSION_2_6_13

	endchoice

endif # FREETZ_PACKAGE_RADVD
```

## make/rcapid/Config.in
```kconfig
config FREETZ_PACKAGE_RCAPID
	bool "Rcapid 0.1"
	select FREETZ_PACKAGE_INETD
	select FREETZ_LIB_libcapi20
	default n
	help
		Remote CAPI daemon from isdn4linux.
```
