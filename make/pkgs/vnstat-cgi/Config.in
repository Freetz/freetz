## make/pkgs/vnstat-cgi/Config.in
```kconfig
config FREETZ_PACKAGE_VNSTAT_CGI
	bool "vnstat Webinterface"
	select FREETZ_PACKAGE_VNSTAT
	select FREETZ_PACKAGE_VNSTAT_DAEMON
	select FREETZ_PACKAGE_VNSTAT_IMAGE
	default n
	help
		Lets you view graphically the output of vnstat.
```

## make/pkgs/vpnc/Config.in
```kconfig
config FREETZ_PACKAGE_VPNC
	bool "Vpnc 0.5.3"
	select FREETZ_LIB_libgpg_error
	select FREETZ_LIB_libgcrypt
	default n
	help
		Cisco IPSec VPN Client

config FREETZ_PACKAGE_VPNC_WITH_HYBRID_AUTH
	bool "Hybrid auth"
	depends on FREETZ_PACKAGE_VPNC
	select FREETZ_LIB_libcrypto
	default n

config FREETZ_PACKAGE_VPNC_NAT_SUPPORT
	bool "NAT support"
	depends on \
		FREETZ_PACKAGE_VPNC && \
		FREETZ_PACKAGE_IPTABLES_IS_SELECTABLE
	select FREETZ_PACKAGE_IPTABLES
	default n
	help
		Enable NAT support for VPNC. This requires iptables!
```

## make/pkgs/wireguard-linux-compat/Config.in
```kconfig
config FREETZ_PACKAGE_WIREGUARD_LINUX_COMPAT
	bool "wireguard-linux-compat 1.0.20220627"
	depends on FREETZ_PACKAGE_WIREGUARD
	default n
	select FREETZ_MODULE_wireguard
	help
		This package provides the kernel module required for Wireguard

if FREETZ_PACKAGE_WIREGUARD_LINUX_COMPAT

	config FREETZ_PACKAGE_WIREGUARD_LINUX_COMPAT_skb_put_data
		bool
		default y
		depends on \
			FREETZ_AVM_SOURCE_1200_07_20 || \
			FREETZ_AVM_SOURCE_1200_07_27 || \
			FREETZ_AVM_SOURCE_7530_07_20 || \
			FREETZ_AVM_SOURCE_7530_07_25 || \
			FREETZ_AVM_SOURCE_6000_07_27

endif # FREETZ_PACKAGE_WIREGUARD_LINUX_COMPAT
```

## make/pkgs/wireguard/Config.in
```kconfig
comment "wireguard-tools (not available, needs at least kernel v3)"
	depends on !FREETZ_KERNEL_VERSION_3_MIN

comment "wireguard-tools (not available, needs replace kernel)"
	depends on FREETZ_KERNEL_VERSION_3_MIN && !(FREETZ_AVM_HAS_CRYPTO_BLKCIPHER_BUILTIN || FREETZ_REPLACE_KERNEL)

comment "wireguard-tools (not available, needs kernel modules)"
	depends on FREETZ_KERNEL_VERSION_3_MIN && (FREETZ_AVM_HAS_CRYPTO_BLKCIPHER_BUILTIN || FREETZ_REPLACE_KERNEL) && !FREETZ_REPLACE_MODULE_AVAILABLE

config FREETZ_PACKAGE_WIREGUARD
	bool "wireguard-tools 1.0.20210914"
	depends on FREETZ_KERNEL_VERSION_3_MIN && (FREETZ_AVM_HAS_CRYPTO_BLKCIPHER_BUILTIN || FREETZ_REPLACE_KERNEL) && FREETZ_REPLACE_MODULE_AVAILABLE
	default n
	select FREETZ_REMOVE_WIREGUARD if FREETZ_AVM_HAS_WIREGUARD
	select FREETZ_BUSYBOX_IP
	select FREETZ_PACKAGE_WIREGUARD_LINUX_COMPAT
	help
		WireGuard is an extremely simple yet fast and modern VPN
		that utilizes state-of-the-art cryptography. It aims to be
		faster, simpler, leaner, and more useful than IPSec, while
		avoiding the massive headache. It intends to be considerably
		more performant than OpenVPN. WireGuard is designed as a
		general purpose VPN for running on embedded interfaces and
		super computers alike, fit for many different circumstances.
		Initially released for the Linux kernel, it plans to be
		cross-platform and widely deployable. It is currently under
		heavy development, but already it might be regarded as the
		most secure, easiest to use, and simplest VPN solution in
		the industry.
```

## make/pkgs/xpdf/Config.in
```kconfig
menuconfig FREETZ_PACKAGE_XPDF
	bool "Xpdf 3.04 (binary only)"
	select FREETZ_LIB_libm if FREETZ_TARGET_UCLIBC_HAS_multiple_libs
	select FREETZ_LIB_STDCXXLIB
	default n
	help
		Xpdf is an open source viewer for Portable Document Format
		(PDF) files. (These are also sometimes also called 'Acrobat'
		files, from the name of Adobe's PDF software.) The Xpdf
		project also includes a PDF text extractor, PDF-to-PostScript
		converter, and various other utilities.

		This packages includes only the non-X utilities.

if FREETZ_PACKAGE_XPDF

config FREETZ_PACKAGE_XPDF_pdftops
	bool "pdftops"
	default y

config FREETZ_PACKAGE_XPDF_pdftotext
	bool "pdftotext"
	default n

config FREETZ_PACKAGE_XPDF_pdfinfo
	bool "pdfinfo"
	default n

config FREETZ_PACKAGE_XPDF_pdffonts
	bool "pdffonts"
	default n

config FREETZ_PACKAGE_XPDF_pdfimages
	bool "pdfimages"
	default n

endif # FREETZ_PACKAGE_XPDF
```

## make/pkgs/xrelayd/Config.in
```kconfig
config FREETZ_PACKAGE_XRELAYD
	bool "Xrelayd 0.2.1pre2"
	select FREETZ_LIB_libpolarssl12 if ! FREETZ_PACKAGE_XRELAYD_STATIC
	default n
	help
		SSL tunnel based on PolarSSL. Xrelayd is a stripped down version of
		stunnel based on PolarSSL library. Essentially, this package makes your
		router's websrv or httpd SSL-enabled, offering you the option of remote
		configuration via WWW or secure remote use of features like Rudi-Shell.

config FREETZ_PACKAGE_XRELAYD_GENSTUFF
	bool "With Key-/Cert-Generation"
	depends on FREETZ_PACKAGE_XRELAYD
	select FREETZ_LIB_libpolarssl12_WITH_GENRSA
	default n
	help
		Include support for private key and x509 certificate generation.

config FREETZ_PACKAGE_XRELAYD_STATIC
	bool "Create semistatic binary (link in polarssl library only)"
	depends on FREETZ_PACKAGE_XRELAYD
	default n
	help
		Eliminate run-time dependency on polarssl by linking it statically.

config FREETZ_PACKAGE_XRELAYD_STATIC_FULL
	bool "Create completely static binary (link in all libraries)"
	depends on FREETZ_PACKAGE_XRELAYD
	select FREETZ_PACKAGE_XRELAYD_STATIC
	default n
	help
		Create statically linked binary.
```

## make/polipo/Config.in
```kconfig
config FREETZ_PACKAGE_POLIPO
	bool "Polipo 1.1.1"
	default n

	help
		Polipo is a small and fast caching web proxy
		(a web cache, an HTTP proxy, a proxy server).

config FREETZ_PACKAGE_POLIPO_STATIC
	bool "Link statically"
	depends on FREETZ_PACKAGE_POLIPO
	default n
	help
		Build polipo as a statically linked binary (no need of shared libraries).
```

## make/ppp-cgi/Config.in
```kconfig
config FREETZ_PACKAGE_PPP_CGI
	bool "ppp dial-up-network"
	depends on FREETZ_AVM_HAS_USB_HOST
	depends on (FREETZ_REPLACE_KERNEL_AVAILABLE && !FREETZ_KERNEL_VERSION_2_6_28) || FREETZ_REPLACE_KERNEL
	select FREETZ_PACKAGE_PPP
	select FREETZ_PACKAGE_PPPD_CHAT
	select FREETZ_MODULE_option if !FREETZ_AVM_HAS_USB_SERIAL_OPTION_BUILTIN
	select FREETZ_BUSYBOX_START_STOP_DAEMON
	select FREETZ_PACKAGE_DNSMASQ
	default n
	help
		Use this package to establish a dun connection

config FREETZ_PACKAGE_PPP_COMGT
	bool "select comgt package"
	depends on FREETZ_PACKAGE_PPP_CGI
	select FREETZ_PACKAGE_COMGT
	default n
	help
		This option adds comgt, a GPRS/EDGE/3G/HSDPA datacard control tool, to the image.
```

## make/ppp/Config.in
```kconfig
comment "Point-to-Point (not available, needs kernel modules)"
	depends on !FREETZ_REPLACE_MODULE_AVAILABLE

comment "Point-to-Point (not available, needs replace kernel)"
	depends on FREETZ_KERNEL_VERSION_2_6_28 && !FREETZ_REPLACE_KERNEL

config FREETZ_PACKAGE_PPP
	bool "Point-to-Point"
	depends on (FREETZ_REPLACE_MODULE_AVAILABLE && !FREETZ_KERNEL_VERSION_2_6_28) || FREETZ_REPLACE_KERNEL
```

## make/pppd/Config.in
```kconfig
comment "Point-to-Point (not available, no sources by AVM)"
	depends on !FREETZ_REPLACE_KERNEL_AVAILABLE

comment "Point-to-Point (not available, needs replace kernel)"
	depends on FREETZ_KERNEL_VERSION_2_6_28 && !FREETZ_REPLACE_KERNEL

config FREETZ_PACKAGE_PPP
	bool "Point-to-Point"
	depends on (FREETZ_REPLACE_KERNEL_AVAILABLE && !FREETZ_KERNEL_VERSION_2_6_28) || \
		FREETZ_REPLACE_KERNEL


comment "Without 'replace kernel' you can not use mppe/mppc."
	depends on FREETZ_PACKAGE_PPPD && ! FREETZ_REPLACE_KERNEL

config FREETZ_PACKAGE_PPPD
	bool "pppd 2.4.5"
	depends on FREETZ_PACKAGE_PPP
	select FREETZ_LIB_libcrypt
	select FREETZ_LIB_libdl
	select FREETZ_MODULE_ppp_async if ! FREETZ_TYPE_7390
	select FREETZ_MODULE_ppp_deflate
	select FREETZ_MODULE_ppp_generic if ! FREETZ_TYPE_7390
	select FREETZ_MODULE_ppp_mppe_mppc
	default n
	help
		An implementation of the Point-to-point protocol.

		http://www.samba.org/ppp/

config FREETZ_PACKAGE_PPPD_CHAT
	bool "pppd chat"
	depends on FREETZ_PACKAGE_PPP
	select FREETZ_PACKAGE_PPPD
	default n
	help
		Automated conversational script with a modem
```

## make/pptp/Config.in
```kconfig
config FREETZ_PACKAGE_PPTP
	bool "pptp 1.7.2"
	depends on FREETZ_PACKAGE_PPP
	select FREETZ_PACKAGE_PPPD
	select FREETZ_LIB_libutil if FREETZ_TARGET_UCLIBC_HAS_multiple_libs
	select FREETZ_BUSYBOX_IP
	select FREETZ_BUSYBOX_FEATURE_IP_ROUTE
	default n
	help
		Linux and FreeBSD client for the proprietary Microsoft
		Point-to-Point tunneling protocol, PPTP, sponsored by HP.
```

## make/pptpd/Config.in
```kconfig
config FREETZ_PACKAGE_PPTPD
	bool "pptpd 1.4.0"
	depends on FREETZ_PACKAGE_PPP
	select FREETZ_PACKAGE_PPPD
	select FREETZ_LIB_libutil if FREETZ_TARGET_UCLIBC_HAS_multiple_libs
	default n
	help
		Poptop is an open source implementation of a PPTP server.
		Running under x86 or embedded Motorola ColdFire architectures
		Poptop provides full interoperability with the Microsoft PPTP
		VPN client.
```

## make/privatekeypassword/Config.in
```kconfig
config FREETZ_PACKAGE_PRIVATEKEYPASSWORD
	bool "privatekeypassword 0.5"
	depends on FREETZ_AVM_VERSION_06_0X_MIN
	select FREETZ_LIB_libprivatekeypassword
	default n
	help
		Reveals the password for AVM's private key file (/var/flash/websrv_ssl_key.pem),
		makes it possible to reuse it for other packages.
```

## make/privoxy/Config.in
```kconfig
config FREETZ_PACKAGE_PRIVOXY
	bool "Privoxy 3.0.33"
	default n
	help
		Privoxy is a web proxy with advanced filtering capabilities for protecting privacy, modifying web page
		data, managing cookies, controlling access, and removing ads, banners, pop-ups and other obnoxious
		Internet junk.

		It can also be used together with Tor Proxy to forward HTTP traffic to Tor as described in the Tor
		documentation.

		Open http://config.privoxy.org/show-status for details.

if FREETZ_PACKAGE_PRIVOXY

	config FREETZ_PACKAGE_PRIVOXY_WITH_ADBLOCK
		bool "With AdBlock filter list downloader"
		select FREETZ_PACKAGE_WGET
		select FREETZ_PACKAGE_WGET_WITH_SSL
		default n
		help
			This option enables automatic filter list downloads from adblock.org.
			Requires and selects GNU wget (busybox wget does not support https).

	config FREETZ_PACKAGE_PRIVOXY_WITH_SHARED_PCRE
		bool "With shared libpcre"
		select FREETZ_LIB_libpcre
		select FREETZ_LIB_libpcreposix
		default y
		help
			Causes libpcre to be linked in dynamically.

	config FREETZ_PACKAGE_PRIVOXY_WITH_ZLIB
		bool "With zlib Compression"
		select FREETZ_LIB_libz
		default n
		help
			ZLIB Compression for privoxy

endif # FREETZ_PACKAGE_PRIVOXY
```

## make/proxychains-ng/Config.in
```kconfig
config FREETZ_PACKAGE_PROXYCHAINS_NG
	bool "ProxyChains-NG 4.14"
	select FREETZ_LIB_libpthread
	default n
	help
		A preloader which hooks calls to sockets in dynamically
		linked programs and redirects it through one or more
		socks/http proxies, tor is also supported.

		Usage: proxychains4 telnet mail.example.com 25

choice
	depends on FREETZ_PACKAGE_PROXYCHAINS_NG
	prompt "Version"
	default FREETZ_PACKAGE_PROXYCHAINS_NG_VERSION_STABLE

	config FREETZ_PACKAGE_PROXYCHAINS_NG_VERSION_STABLE
		bool "stable 4.14"

	config FREETZ_PACKAGE_PROXYCHAINS_NG_VERSION_LATEST
		bool "latest git"

	config FREETZ_PACKAGE_PROXYCHAINS_NG_VERSION_CUSTOM
		bool "custom hash"

endchoice

config FREETZ_PACKAGE_PROXYCHAINS_NG_VERSION_COMMIT
	string "Revision"
	depends on FREETZ_PACKAGE_PROXYCHAINS_NG && FREETZ_PACKAGE_PROXYCHAINS_NG_VERSION_CUSTOM
	default "e895fb713a"

config FREETZ_PACKAGE_PROXYCHAINS_NG_SELECT_TOR
	bool "Select Tor"
	depends on FREETZ_PACKAGE_PROXYCHAINS_NG
	select FREETZ_PACKAGE_TOR
	default n
```

## make/pyload/Config.in
```kconfig
config FREETZ_PACKAGE_PYLOAD
	bool "pyLoad 0.4.9 (binary only)"
	select FREETZ_PACKAGE_PYTHON
	select FREETZ_PACKAGE_PYTHON_MOD_SQLITE
	select FREETZ_PACKAGE_PYTHON_IMAGING_LIBRARY
	select FREETZ_PACKAGE_PYTHON_PYCURL
	select FREETZ_PACKAGE_PYTHON_PYCRYPTO
	select FREETZ_PACKAGE_PYTHON_PYOPENSSL
	select FREETZ_PACKAGE_JS
	select FREETZ_PACKAGE_UNRAR
	default n
	help
		pyLoad is a fast, lightweight and full featured download manager
		for many One-Click-Hoster, container formats like DLC, video sites
		or just plain http/ftp links.

config FREETZ_PACKAGE_PYLOAD_WITH_TESSERACT
	bool "With Tesseract OCR for captcha recognition"
	depends on FREETZ_PACKAGE_PYLOAD && FREETZ_PACKAGE_TESSERACT_AVAILABLE
	select FREETZ_PACKAGE_TESSERACT
	default n
	help
		Causes Tesseract OCR to be added to the image
		for captcha recognition support in pyLoad.

		Note:
		 - Tesseract OCR is a huge package.
		 - pyLoad support for captcha recognition
		   is very limited even with Tesseract OCR.

		You most probably want to say 'no' here.
```

## make/python-bjoern/Config.in
```kconfig
config FREETZ_PACKAGE_PYTHON_BJOERN
	bool "bjoern 1.3.4"
	depends on FREETZ_PACKAGE_PYTHON
	select FREETZ_LIB_libpython2 if !FREETZ_PACKAGE_PYTHON_STATIC
	select FREETZ_LIB_libev
	default n
	help
		A screamingly fast Python WSGI server written in C.
```

## make/python-cheetah/Config.in
```kconfig
config FREETZ_PACKAGE_PYTHON_CHEETAH
	bool "cheetah 2.4.4"
	depends on FREETZ_PACKAGE_PYTHON
	select FREETZ_LIB_libpython2 if !FREETZ_PACKAGE_PYTHON_STATIC
	default n
```

## make/python-mechanize/Config.in
```kconfig
config FREETZ_PACKAGE_PYTHON_MECHANIZE
	bool "mechanize 0.2.5"
	depends on FREETZ_PACKAGE_PYTHON
	select FREETZ_PACKAGE_PYTHON_MOD_SQLITE
	select FREETZ_PACKAGE_PYTHON_MOD_SSL
	select FREETZ_LIB_libpython2 if !FREETZ_PACKAGE_PYTHON_STATIC
	default n
	help
		Stateful programmatic web browsing, after Andy Lester's Perl module WWW::Mechanize.
```

## make/python-pycrypto/Config.in
```kconfig
config FREETZ_PACKAGE_PYTHON_PYCRYPTO
	bool "pycrypto 2.6.1"
	depends on FREETZ_PACKAGE_PYTHON
	select FREETZ_LIB_libpython2 if !FREETZ_PACKAGE_PYTHON_STATIC
	select FREETZ_LIB_libgmp
	default n
	help
		A collection of both secure hash functions (such as MD5 and SHA),
		and various encryption algorithms (AES, DES, IDEA, RSA, ElGamal, etc.).
```

## make/python-pyopenssl/Config.in
```kconfig
config FREETZ_PACKAGE_PYTHON_PYOPENSSL
	bool "pyopenssl 0.13"
	depends on FREETZ_PACKAGE_PYTHON
	select FREETZ_PACKAGE_PYTHON_MOD_CTYPES
	select FREETZ_LIB_libpython2 if !FREETZ_PACKAGE_PYTHON_STATIC
	select FREETZ_LIB_libcrypto
	select FREETZ_LIB_libssl
	select FREETZ_OPENSSL_VERSION_PROMPT
	default n
	help
		Python interface to the OpenSSL library.
```
