## make/pkgs/fowsr/Config.in
```kconfig
config FREETZ_PACKAGE_FOWSR
	bool "fowsr 1.0-20110904 (binary only)"
	select FREETZ_LIB_libusb_0
	default n
	help
		fowsr is a USB Data Collector application for WH1080 compatible weather stations.
		Output formats includes XML, Wunderground.com and pywws.
		See http://fowsr.googlecode.com for further information.
```

## make/pkgs/fstyp/Config.in
```kconfig
config FREETZ_PACKAGE_FSTYP
	bool "fstyp 0.1 (binary only)"
	depends on FREETZ_PATCH_FREETZMOUNT
	default n
	help
		fstyp can be used to heuristically detect which filesystem type a block
		device contains.
```

## make/pkgs/gdb/Config.in
```kconfig
config FREETZ_PACKAGE_GDB
	bool "gdb GNU debugger 6.8/7.9.1 (binary only)"

if FREETZ_PACKAGE_GDB

	choice
		prompt "version"
		default FREETZ_GDB_VERSION_7_9
		help
			Select the version of gdb you wish to use.

		config FREETZ_GDB_VERSION_6_8
			bool "gdb 6.8"

		config FREETZ_GDB_VERSION_7_9
			bool "gdb 7.9.1"
	endchoice

	config FREETZ_PACKAGE_GDB_GDB
		bool "Build gdb for target"
		select FREETZ_LIB_libdl  if FREETZ_TARGET_UCLIBC_HAS_multiple_libs
		select FREETZ_LIB_libm   if FREETZ_TARGET_UCLIBC_HAS_multiple_libs
		select FREETZ_LIB_libncurses
		select FREETZ_LIB_libreadline
		default n
		help
			Build the full gdb debugger to run on the target.

	config FREETZ_PACKAGE_GDB_GDBSERVER
		bool "Build gdb server for target"
		select FREETZ_LIB_libthread_db
		default n
		help
			Build the gdbserver stub to run on the target.
			Full gdb is needed to debug a program.

	config FREETZ_PACKAGE_GDB_HOST
		bool "Build gdb for host"
		default n
		help
			Build gdb to run on the host to debug programs run on the target.

endif # FREETZ_PACKAGE_GDB
```

## make/pkgs/getdns/Config.in
```kconfig
comment "getdns (not available, needs OpenSSL 1.0 or newer)"
	depends on !FREETZ_OPENSSL_VERSION_1_MIN

config FREETZ_PACKAGE_GETDNS
	bool "getdns 1.5.2"
	depends on FREETZ_OPENSSL_VERSION_1_MIN
	select FREETZ_LIB_libcrypto
	select FREETZ_LIB_libcrypto_WITH_EC
	select FREETZ_LIB_libssl
	#
	select FREETZ_LIB_libpthread if FREETZ_TARGET_UCLIBC_HAS_multiple_libs
	#
	select FREETZ_LIB_libyaml
	default n
	help
		getdns/Stubby is an application that acts as a local DNS
		Privacy stub resolver (using DNS-over-TLS). Stubby encrypts
		DNS queries sent from a client machine (desktop or laptop)
		to a DNS Privacy resolver increasing end user privacy.

	config FREETZ_PACKAGE_GETDNS_CA_BUNDLE
		bool "Select CA-bundle"
		depends on FREETZ_PACKAGE_GETDNS
		default y
		select FREETZ_PACKAGE_CA_BUNDLE
```

## make/pkgs/ghostscript-fonts/Config.in
```kconfig
config FREETZ_PACKAGE_GHOSTSCRIPT_FONTS
	bool "Ghostscript fonts 8.11 (binary only)"
	default n
	help
		This package provides the Ghostscript fonts.
```

## make/pkgs/gntpsend/Config.in
```kconfig
config FREETZ_PACKAGE_GNTPSEND
	bool "gntpsend 0.3.2-git (binary only)"
	default n
	help
		Growl is a notification system for the Mac OS X. Applications can use Growl
		to display small notifications about events which the user deems important,
		in a consistent manner.

		This package provides a tool 'gntp-send' which allows to send notifications
		to Growl.
```

## make/pkgs/gw6/Config.in
```kconfig
config FREETZ_PACKAGE_GW6
	bool "Gateway6 client 5.1"
	depends on FREETZ_TARGET_IPV6_SUPPORT
	select FREETZ_BUSYBOX_IP
	select FREETZ_BUSYBOX_FEATURE_IP_ADDRESS
	select FREETZ_LIB_libpthread if FREETZ_TARGET_UCLIBC_HAS_multiple_libs
	select FREETZ_LIB_STDCXXLIB
	select FREETZ_BUSYBOX_FEATURE_PS_WIDE
	default n
	help
		Client to build a tunnel to the ipv6 network (see http://go6.net).
		The binary will be installed as /usr/sbin/gw6c and CGI frontend
		will be provided for a simple configuration. A sample can be
		found in /usr/share/gw6/.
```

## make/pkgs/hd-idle/Config.in
```kconfig
config FREETZ_PACKAGE_HD_IDLE
	bool "hd-idle 0.99"
	default n
	depends on FREETZ_AVM_HAS_USB_HOST
	help
		Another idle-daemon for attached hard drives if sg3utils doesn't
		work as expected. This can happen with most low-cost USB drives.
```

## make/pkgs/hp-utils/Config.in
```kconfig
config FREETZ_PACKAGE_HP_UTILS
	bool "hp-utils 0.3.2"
	default n
	select FREETZ_PACKAGE_HPLIP
	help
		hp-utils is a collection of utility programs for
		HP printers. It's meant to be used on systems,
		which are unable to run the corresponding programs
		provided by HPLIP, e.g. because they only have
		limited memory and/or cpu power.
		hp-utils is primarily focused towards embedded systems,
		particularly towards the FRITZ!Box, a family
		of DSL routers produced by AVM.
```

## make/pkgs/htop/Config.in
```kconfig
config FREETZ_PACKAGE_HTOP
	bool "htop 1.0.3/3.2.1 (binary only)"
	select FREETZ_LIB_libncurses
	select FREETZ_LIB_libm   if FREETZ_TARGET_UCLIBC_HAS_multiple_libs
	select FREETZ_LIB_libdl  if FREETZ_TARGET_UCLIBC_HAS_multiple_libs && !FREETZ_PACKAGE_HTOP_VERSION_ABANDON
	default n
	help
		htop is a more powerful alternative to top, using ncurses.

if FREETZ_PACKAGE_HTOP

	choice
		prompt "Version"
			default FREETZ_PACKAGE_HTOP_VERSION_CURRENT

		config FREETZ_PACKAGE_HTOP_VERSION_ABANDON
			bool "1.0.3"
			depends on !FREETZ_TARGET_GCC_4_8_MIN

		config FREETZ_PACKAGE_HTOP_VERSION_CURRENT
			bool "3.2.1"
			depends on FREETZ_TARGET_GCC_4_8_MIN

	endchoice

endif # FREETZ_PACKAGE_HTOP
```

## make/pkgs/iconv/Config.in
```kconfig
config FREETZ_PACKAGE_ICONV
	bool "iconv 1.13.1 (binary only)"
	select FREETZ_LIB_libiconv
	default n
	help
		A program for converting text from one encoding to another.
```

## make/pkgs/ifstat/Config.in
```kconfig
config FREETZ_PACKAGE_IFSTAT
	bool "ifstat 1.1 (binary only)"
	default n
	help
		 ifstat is a tool to report network interfaces bandwith
		 just like vmstat/iostat do for other system counters.
		 ifstat gathers these statistics from the kernel internal
		 counters, which is highly operating system dependent.
		 If the net-snmp (or ucd-snmp) library is available,
		 ifstat can use it to gather statistics from remote equipments
		 (hosts, routers, switches...) or even the local host if a SNMP
		 daemon is running. ifstat's functionnalities can also be
		 included in a static library for use in other applications.
		 To use it, you just have to pass --enable-library while
		 configuring ifstat
		 WWW: http://gael.roualland.free.fr/ifstat/
```

## make/pkgs/isc-dhcp/Config.in
```kconfig
config FREETZ_PACKAGE_ISC_DHCP
	bool "ISC dhcp 4.3.6-P1 (binary only)"
	default n
	help
		ISC DHCP is open source software that implements the Dynamic Host Configuration Protocol
		for connection to an IP network. It is production-grade software that offers a complete
		solution for implementing DHCP servers, relay agents, and clients for small local networks
		to large enterprises. ISC DHCP solution supports both IPv4 and IPv6, and is suitable
		for use in high-volume and high-reliability applications.
```

## make/pkgs/jamvm/Config.in
```kconfig
config FREETZ_PACKAGE_JAMVM
	bool "JamVM 1.5.4 (binary only)"
	select FREETZ_PACKAGE_CLASSPATH
	select FREETZ_LIB_libffi
	select FREETZ_LIB_libz
	default n
	help
		JamVM - extremely small Java VM

		JamVM is a new Java Virtual Machine which conforms to the JVM
		specification version 2 (blue book). In comparison to most other VM's
		(free and commercial) it is extremely small, with a stripped executable
		on PowerPC of only ~160K, and Intel 140K. However, unlike other small
		VMs (e.g. KVM) it is designed to support the full specification, and
		includes support for object finalisation, Soft/Weak/Phantom References,
		class-unloading, the Java Native Interface (JNI) and the Reflection API.

		Class Libraries: JamVM is designed to use the GNU Classpath Java class
		library. A number of classes are reference classes which must be
		modified for a particular VM. These are provided along with JamVM (see
		INSTALL). JamVM should always work with the latest development snapshot
		of Classpath (currently 0.93). It should also work with the latest
		version direct from CVS, and the upcoming 0.94 snapshot (but check the
		Classpath mailing lists for possible patches). Later snapshots of
		Classpath may also work, if no modifications have been made to the VM
		interface.

		Note, JamVM will not work with the class library from Sun or IBM's
		Virtual Machines.
```

## make/pkgs/js/Config.in
```kconfig
config FREETZ_PACKAGE_JS
	bool "js OSSP 1.6.20070208 (binary only)"
	default n
	select FREETZ_LIB_libjs
	help
		OSSP js is a stand-alone distribution of the JavaScript (JS)
		programming language reference implementation from Mozilla.
```

## make/pkgs/juis_check/Config.in
```kconfig
config FREETZ_PACKAGE_JUIS_CHECK
	bool "juis_check 1.3"
	select FREETZ_BUSYBOX_NC
	select FREETZ_BUSYBOX_NC_110_COMPAT
	default n
	help
		This integrates the juis_check script from tools/ dir into the image.
		It run 23 time faster (0,3sec vs 7sec) than other bloated
		implementations and needs only 4% of space (4kB vs 93kB).
```

## make/pkgs/knock/Config.in
```kconfig
config FREETZ_PACKAGE_KNOCK
	bool "Knock 0.8"
	select FREETZ_LIB_libpcap
	default n
	help
		Knockd is a port-knock server. It listens to all traffic on an ethernet
		(or PPP) interface, looking for special "knock" sequences of port-hits.
```

## make/pkgs/ldd/Config.in
```kconfig
config FREETZ_PACKAGE_LDD
	bool "ldd 0.1 (binary only)"
	default n
	help
		ldd prints the shared libraries required by each program or shared
		library specified on the command line.
```

## make/pkgs/lua/Config.in
```kconfig
config FREETZ_PACKAGE_LUA
	bool "Lua 5.1.5/5.4.4 (binary only)"
	default n
	select FREETZ_LIB_liblua
	select FREETZ_LIB_libdl  if FREETZ_TARGET_UCLIBC_HAS_multiple_libs
	select FREETZ_LIB_libm   if FREETZ_TARGET_UCLIBC_HAS_multiple_libs
	help
		Lua Scripting Language.

		Lua is a powerful, efficient, lightweight, embeddable scripting language.
		It supports procedural programming, object-oriented programming,
		functional programming, data-driven programming, and data description.

		Lua combines simple procedural syntax with powerful data description
		constructs based on associative arrays and extensible semantics. Lua is
		dynamically typed, runs by interpreting bytecode with a register-based
		virtual machine, and has automatic memory management with incremental
		garbage collection, making it ideal for configuration, scripting, and
		rapid prototyping. 

if FREETZ_PACKAGE_LUA

	choice
		prompt "Version"

		config FREETZ_PACKAGE_LUA_VERSION_ABANDON
			bool "5.1.5"
			depends on FREETZ_LIB_liblua_WITH_VERSION_ABANDON

		config FFREETZ_PACKAGE_LUA_VERSION_CURRENT
			bool "5.4.4"
			depends on FREETZ_LIB_liblua_WITH_VERSION_CURRENT

	endchoice

	config FREETZ_PACKAGE_LUA_READLINE
		bool "Build with readline support"
		default y
		select FREETZ_LIB_libreadline
		select FREETZ_LIB_libhistory   if FREETZ_LIB_liblua_WITH_VERSION_ABANDON
		select FREETZ_LIB_libncurses   if FREETZ_LIB_liblua_WITH_VERSION_ABANDON

endif # FREETZ_PACKAGE_LUA
```

## make/pkgs/lynx/Config.in
```kconfig
config FREETZ_PACKAGE_LYNX
	bool "Lynx 2.8.9 (binary only)"
	select FREETZ_LIB_libncurses
	default n
	help
		Lynx text mode web browser

		Lynx is a fully-featured World Wide Web (WWW) client for users running
		cursor-addressable, character-cell display devices (e.g., vt100
		terminals, vt100 emulators running on PCs or Macs, or any other
		character-cell display). It will display HTML documents containing links
		to files on the local system, as well as files on remote systems running
		http, gopher, ftp, wais, nntp, finger, or cso/ph/qi servers, and
		services accessible via logins to telnet, tn3270 or rlogin accounts.

if FREETZ_PACKAGE_LYNX

	config FREETZ_PACKAGE_LYNX_WITH_SSL
		bool "With https support"
		select FREETZ_LIB_libcrypto
		select FREETZ_LIB_libssl
		select FREETZ_LIB_libdl if FREETZ_TARGET_UCLIBC_HAS_multiple_libs
		default y

	config FREETZ_PACKAGE_LYNX_WITH_ZLIB
		bool "With zlib support"
		select FREETZ_LIB_libz
		default y

endif # FREETZ_PACKAGE_LYNX
```

## make/pkgs/mini_fo/Config.in
```kconfig
config FREETZ_PACKAGE_MINI_FO
	bool "mini_fo 0.3"
	depends on FREETZ_REPLACE_MODULE_AVAILABLE
	select FREETZ_MODULE_mini_fo if !FREETZ_AVM_HAS_MINI_FO_BUILTIN
	default n
	help
		Makes the filesystem writeable. Changes are not reboot-persistent,
		unless stored on a hard disk or on flash storage media. The way mini_fo
		is configured here creates the overlay filesystem in the router's RAM
		disk, so they definitely are *not* reboot-persistent. Nonetheless,
		mini_fo is tremendously helpful, eliminating the need for tricks like
		'mount -o bind' etc.

		Note: The mini_fo root filesystem will not be used if an NFS-root was
		mounted first (see NFS-root package). Still, both packages can be
		installed at the same time, because mini_fo is still useful if NFS-root
		is decativated.

		This package does not work with (at least) 7390 at the moment.

config FREETZ_PACKAGE_MINI_FO_JFFS2
	bool "Use jffs2 for data storage (persistent) "
	depends on FREETZ_PACKAGE_MINI_FO && ! FREETZ_REMOVE_JFFS2
	depends on !FREETZ_REMOVE_JFFS2
	select FREETZ_MODULE_jffs2 if !FREETZ_AVM_HAS_JFFS2_FS_BUILTIN
	default n
	help
		Enables possibility to store filesystem changes persistent to jffs2.
		When a new image is flashed the data may be lost!
```

## make/pkgs/mtr/Config.in
```kconfig
config FREETZ_PACKAGE_MTR
	bool "MTR 0.80/0.95 (binary only)"
	select FREETZ_LIB_libncurses
	default n
	help
		MTR combines the functionality of the 'traceroute' and 'ping' programs
		in a single network diagnostic tool.

if FREETZ_PACKAGE_MTR

	choice
		prompt "Version"
			default FREETZ_PACKAGE_MTR_VERSION_CURRENT

		config FREETZ_PACKAGE_MTR_VERSION_ABANDON
			bool "0.80"
			depends on !FREETZ_TARGET_GCC_4_8_MIN

		config FREETZ_PACKAGE_MTR_VERSION_CURRENT
			bool "0.95"
			depends on FREETZ_TARGET_GCC_4_8_MIN

	endchoice

endif # FREETZ_PACKAGE_MTR
```

## make/pkgs/mysql/Config.in
```kconfig
config FREETZ_PACKAGE_MYSQL
	bool "MySQL 6.0.11-alpha"
	select FREETZ_BUSYBOX_START_STOP_DAEMON
	select FREETZ_LIB_libncurses
	select FREETZ_LIB_STDCXXLIB
	select FREETZ_LIB_libcrypto
	select FREETZ_LIB_libssl
	select FREETZ_LIB_libpthread  if FREETZ_TARGET_UCLIBC_HAS_multiple_libs
	select FREETZ_LIB_libz
	select FREETZ_LIB_libm        if FREETZ_TARGET_UCLIBC_HAS_multiple_libs
	select FREETZ_LIB_librt       if FREETZ_TARGET_UCLIBC_HAS_multiple_libs
	select FREETZ_LIB_libdl       if FREETZ_TARGET_UCLIBC_HAS_multiple_libs
	select FREETZ_LIB_libnsl
	depends on FREETZ_TARGET_ARCH_MIPS
	default n
	help
		MySQL is a very fast, multi-threaded, multi-user and robust
		SQL (Structured Query Language) database server.
		
		Unstable, as this version is quite old, but runs well on
		Fritzbox. Do not expose this daemon to the internet!

config FREETZ_PACKAGE_MYSQL_mysqld
	bool "mysqld"
	depends on FREETZ_PACKAGE_MYSQL
	default y
	help
		MySQL server

config FREETZ_PACKAGE_MYSQL_mysql
	bool "mysql"
	depends on FREETZ_PACKAGE_MYSQL
	default y
	help
		MySQL client
		This is required to view the status webif page.

config FREETZ_PACKAGE_MYSQL_setup
	bool "setup"
	depends on FREETZ_PACKAGE_MYSQL
	select FREETZ_BUSYBOX_BZIP2
	default y
	help
		Default tables to initialize MySQL. Use it by
		"rc.mysql setup". Could be deselected  after
		initial setup.
		You could also initialize the database manually.
```

## make/pkgs/nc6/Config.in
```kconfig
config FREETZ_PACKAGE_NC6
	bool "nc6 1.0 (binary only)"
	default n
	help
		A netcat clone with ipv6 support.
```
