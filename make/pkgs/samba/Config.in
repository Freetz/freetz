## make/pkgs/samba/Config.in
```kconfig
config FREETZ_PACKAGE_SAMBA
	bool "Samba 3.0.37/3.6.25"
	default n
	select FREETZ_PACKAGE_SAMBA_SMBD if (!FREETZ_PACKAGE_SAMBA_SMBCLIENT && !FREETZ_PACKAGE_SAMBA_NMBLOOKUP)
	select FREETZ_BUSYBOX_READLINK

choice
	depends on FREETZ_PACKAGE_SAMBA
	prompt "version"
	default FREETZ_SAMBA_VERSION_3_0

	config FREETZ_SAMBA_VERSION_3_0
		bool "samba 3.0.37"
		help
			The binary with smbd and nmbd needs about 1033 kB (uncompressed).

	config FREETZ_SAMBA_VERSION_3_6
		bool "samba 3.6.25"
		help
			The binary with smbd and nmbd needs about 1682 kB (uncompressed).
endchoice

config FREETZ_PACKAGE_SAMBA_SMBD
	bool "smbd (file sharing server)"
	depends on FREETZ_PACKAGE_SAMBA
	select FREETZ_LIB_libcrypt    if FREETZ_TARGET_UCLIBC_HAS_multiple_libs
	select FREETZ_LIB_libdl       if FREETZ_TARGET_UCLIBC_HAS_multiple_libs
	select FREETZ_LIB_libpopt
	select FREETZ_LIB_libz        if FREETZ_SAMBA_VERSION_3_6
	select FREETZ_LIB_libiconv    if FREETZ_TARGET_UCLIBC_0_9_28
	default y
	help
		Provides the Samba SMB server (smbd). This is what you need if you would
		like your router's file system to be accessible from Windows or from
		other UNIX/Linux machines via smbmount, smbclient, cifsmount or similar.

config FREETZ_PACKAGE_SAMBA_NMBD
	bool "nmbd (NetBIOS name server)"
	depends on FREETZ_PACKAGE_SAMBA
	select FREETZ_PACKAGE_SAMBA_SMBD
	default n
	help
		Provides the Samba NetBIOS name server (nmbd). This is what you need
		if you would like to see your router in the network neighbourhood or
		act as a master browser.

config FREETZ_PACKAGE_SAMBA_SMBCLIENT
	bool "smbclient"
	depends on FREETZ_PACKAGE_SAMBA
	select FREETZ_LIB_libcrypt    if FREETZ_TARGET_UCLIBC_HAS_multiple_libs && FREETZ_SAMBA_VERSION_3_0
	select FREETZ_LIB_libdl       if FREETZ_TARGET_UCLIBC_HAS_multiple_libs
	select FREETZ_LIB_libpopt
	select FREETZ_LIB_libreadline
	select FREETZ_LIB_libncurses
	select FREETZ_LIB_libz        if FREETZ_SAMBA_VERSION_3_6
	select FREETZ_LIB_libiconv    if FREETZ_TARGET_UCLIBC_0_9_28
	default n
	help
		ftp-like client to access SMB/CIFS resources on servers.

config FREETZ_PACKAGE_SAMBA_NMBLOOKUP
	bool "nmblookup"
	depends on FREETZ_PACKAGE_SAMBA
	select FREETZ_LIB_libcrypt    if FREETZ_TARGET_UCLIBC_HAS_multiple_libs && FREETZ_SAMBA_VERSION_3_0
	select FREETZ_LIB_libdl       if FREETZ_TARGET_UCLIBC_HAS_multiple_libs
	select FREETZ_LIB_libpopt
	select FREETZ_LIB_libiconv    if FREETZ_TARGET_UCLIBC_0_9_28
	default n
	help
		NetBIOS over TCP/IP client used to lookup NetBIOS names.

config FREETZ_PACKAGE_SAMBA_MAX_DEBUG_LEVEL
	int "Maximum level of compiled-in debug messages"
	depends on FREETZ_PACKAGE_SAMBA
	default -1
	help
		1000 - include all debug messages
		   2 - include only important messages
		  -1 - disable debug messages completely

		 Note: this option affects the size of the Samba binary.
		       The higher the debug level, the more debug output
		       is generated and the bigger the binary is.
```

## make/pkgs/sane-backends/Config.in
```kconfig
menuconfig FREETZ_PACKAGE_SANE_BACKENDS
	bool "SANE 1.0.27"
	select FREETZ_PACKAGE_INETD
	select FREETZ_PACKAGE_SANE_BACKENDS_BACKEND_dll
	select FREETZ_LIB_libm        if FREETZ_TARGET_UCLIBC_HAS_multiple_libs
	select FREETZ_LIB_libpthread  if FREETZ_TARGET_UCLIBC_HAS_multiple_libs
	select FREETZ_LIB_libusb_1
	default n
	help
		SANE - Scanner support
		(initial Freetz package by Michael Denk, tehron @ http://www.ip-phone-forum.de/)

if FREETZ_PACKAGE_SANE_BACKENDS

config FREETZ_PACKAGE_SANE_BACKENDS_WITH_AVAHI
	bool "enable avahi support"
	select FREETZ_PACKAGE_AVAHI
	select FREETZ_LIB_libavahi_client
	default n
	help
		Enable avahi support.

config FREETZ_PACKAGE_SANE_BACKENDS_sane_find_scanner
	bool "sane-find-scanner"
	default n

config FREETZ_PACKAGE_SANE_BACKENDS_scanimage
	bool "scanimage"
	default n

config FREETZ_PACKAGE_SANE_BACKENDS_BACKEND_dll
	bool "dll backend"
	default n

config FREETZ_PACKAGE_SANE_BACKENDS_BACKEND_abaton
	bool "abaton backend"
	select FREETZ_PACKAGE_SANE_BACKENDS_BACKEND_dll
	default n

config FREETZ_PACKAGE_SANE_BACKENDS_BACKEND_agfafocus
	bool "agfafocus backend"
	select FREETZ_PACKAGE_SANE_BACKENDS_BACKEND_dll
	default n

config FREETZ_PACKAGE_SANE_BACKENDS_BACKEND_apple
	bool "apple backend"
	select FREETZ_PACKAGE_SANE_BACKENDS_BACKEND_dll
	default n

config FREETZ_PACKAGE_SANE_BACKENDS_BACKEND_artec
	bool "artec backend"
	select FREETZ_PACKAGE_SANE_BACKENDS_BACKEND_dll
	default n

config FREETZ_PACKAGE_SANE_BACKENDS_BACKEND_artec_eplus48u
	bool "artec_eplus48u backend"
	select FREETZ_PACKAGE_SANE_BACKENDS_BACKEND_dll
	default n

config FREETZ_PACKAGE_SANE_BACKENDS_BACKEND_as6e
	bool "as6e backend"
	select FREETZ_PACKAGE_SANE_BACKENDS_BACKEND_dll
	default n

config FREETZ_PACKAGE_SANE_BACKENDS_BACKEND_avision
	bool "avision backend"
	select FREETZ_PACKAGE_SANE_BACKENDS_BACKEND_dll
	default n

config FREETZ_PACKAGE_SANE_BACKENDS_BACKEND_bh
	bool "bh backend"
	select FREETZ_PACKAGE_SANE_BACKENDS_BACKEND_dll
	default n

config FREETZ_PACKAGE_SANE_BACKENDS_BACKEND_canon
	bool "canon backend"
	select FREETZ_PACKAGE_SANE_BACKENDS_BACKEND_dll
	default n

config FREETZ_PACKAGE_SANE_BACKENDS_BACKEND_canon630u
	bool "canon630u backend"
	select FREETZ_PACKAGE_SANE_BACKENDS_BACKEND_dll
	default n

config FREETZ_PACKAGE_SANE_BACKENDS_BACKEND_canon_dr
	bool "canon_dr backend"
	select FREETZ_PACKAGE_SANE_BACKENDS_BACKEND_dll
	default n

config FREETZ_PACKAGE_SANE_BACKENDS_BACKEND_cardscan
	bool "cardscan backend"
	select FREETZ_PACKAGE_SANE_BACKENDS_BACKEND_dll
	default n

config FREETZ_PACKAGE_SANE_BACKENDS_BACKEND_coolscan
	bool "coolscan backend"
	select FREETZ_PACKAGE_SANE_BACKENDS_BACKEND_dll
	default n

config FREETZ_PACKAGE_SANE_BACKENDS_BACKEND_coolscan2
	bool "coolscan2 backend"
	select FREETZ_PACKAGE_SANE_BACKENDS_BACKEND_dll
	default n

config FREETZ_PACKAGE_SANE_BACKENDS_BACKEND_coolscan3
	bool "coolscan3 backend"
	select FREETZ_PACKAGE_SANE_BACKENDS_BACKEND_dll
	default n

config FREETZ_PACKAGE_SANE_BACKENDS_BACKEND_dc210
	bool "dc210 backend"
	select FREETZ_PACKAGE_SANE_BACKENDS_BACKEND_dll
	select FREETZ_LIB_libjpeg
	default n

config FREETZ_PACKAGE_SANE_BACKENDS_BACKEND_dc240
	bool "dc240 backend"
	select FREETZ_PACKAGE_SANE_BACKENDS_BACKEND_dll
	select FREETZ_LIB_libjpeg
	default n

config FREETZ_PACKAGE_SANE_BACKENDS_BACKEND_dc25
	bool "dc25 backend"
	select FREETZ_PACKAGE_SANE_BACKENDS_BACKEND_dll
	default n

config FREETZ_PACKAGE_SANE_BACKENDS_BACKEND_dmc
	bool "dmc backend"
	select FREETZ_PACKAGE_SANE_BACKENDS_BACKEND_dll
	default n

config FREETZ_PACKAGE_SANE_BACKENDS_BACKEND_epjitsu
	bool "epjitsu backend"
	select FREETZ_PACKAGE_SANE_BACKENDS_BACKEND_dll
	default n

config FREETZ_PACKAGE_SANE_BACKENDS_BACKEND_epson
	bool "epson backend"
	select FREETZ_PACKAGE_SANE_BACKENDS_BACKEND_dll
	default n

config FREETZ_PACKAGE_SANE_BACKENDS_BACKEND_epson2
	bool "epson2 backend"
	select FREETZ_PACKAGE_SANE_BACKENDS_BACKEND_dll
	default n

config FREETZ_PACKAGE_SANE_BACKENDS_BACKEND_epsonds
	bool "epsonds backend"
	select FREETZ_PACKAGE_SANE_BACKENDS_BACKEND_dll
	select FREETZ_LIB_libjpeg
	default n

config FREETZ_PACKAGE_SANE_BACKENDS_BACKEND_fujitsu
	bool "fujitsu backend"
	select FREETZ_PACKAGE_SANE_BACKENDS_BACKEND_dll
	default n

config FREETZ_PACKAGE_SANE_BACKENDS_BACKEND_genesys
	bool "genesys backend"
	select FREETZ_PACKAGE_SANE_BACKENDS_BACKEND_dll
	default n

config FREETZ_PACKAGE_SANE_BACKENDS_BACKEND_gt68xx
	bool "gt68xx backend"
	select FREETZ_PACKAGE_SANE_BACKENDS_BACKEND_dll
	default n

config FREETZ_PACKAGE_SANE_BACKENDS_BACKEND_hp
	bool "hp backend"
	select FREETZ_PACKAGE_SANE_BACKENDS_BACKEND_dll
	default n

config FREETZ_PACKAGE_SANE_BACKENDS_BACKEND_hp3500
	bool "hp3500 backend"
	select FREETZ_PACKAGE_SANE_BACKENDS_BACKEND_dll
	default n

config FREETZ_PACKAGE_SANE_BACKENDS_BACKEND_hp3900
	bool "hp3900 backend"
	select FREETZ_PACKAGE_SANE_BACKENDS_BACKEND_dll
	default n

config FREETZ_PACKAGE_SANE_BACKENDS_BACKEND_hp4200
	bool "hp4200 backend"
	select FREETZ_PACKAGE_SANE_BACKENDS_BACKEND_dll
	default n

config FREETZ_PACKAGE_SANE_BACKENDS_BACKEND_hp5400
	bool "hp5400 backend"
	select FREETZ_PACKAGE_SANE_BACKENDS_BACKEND_dll
	default n

config FREETZ_PACKAGE_SANE_BACKENDS_BACKEND_hp5590
	bool "hp5590 backend"
	select FREETZ_PACKAGE_SANE_BACKENDS_BACKEND_dll
	default n

config FREETZ_PACKAGE_SANE_BACKENDS_BACKEND_hpljm1005
	bool "hpljm1005 backend"
	select FREETZ_PACKAGE_SANE_BACKENDS_BACKEND_dll
	default n

config FREETZ_PACKAGE_SANE_BACKENDS_BACKEND_hs2p
	bool "hs2p backend"
	select FREETZ_PACKAGE_SANE_BACKENDS_BACKEND_dll
	default n

config FREETZ_PACKAGE_SANE_BACKENDS_BACKEND_ibm
	bool "ibm backend"
	select FREETZ_PACKAGE_SANE_BACKENDS_BACKEND_dll
	default n

config FREETZ_PACKAGE_SANE_BACKENDS_BACKEND_kodak
	bool "kodak backend"
	select FREETZ_PACKAGE_SANE_BACKENDS_BACKEND_dll
	default n

config FREETZ_PACKAGE_SANE_BACKENDS_BACKEND_kodakaio
	bool "kodakaio backend"
	select FREETZ_PACKAGE_SANE_BACKENDS_BACKEND_dll
	default n

config FREETZ_PACKAGE_SANE_BACKENDS_BACKEND_kvs1025
	bool "kvs1025 backend"
	select FREETZ_PACKAGE_SANE_BACKENDS_BACKEND_dll
	default n

config FREETZ_PACKAGE_SANE_BACKENDS_BACKEND_kvs20xx
	bool "kvs20xx backend"
	select FREETZ_PACKAGE_SANE_BACKENDS_BACKEND_dll
	default n

config FREETZ_PACKAGE_SANE_BACKENDS_BACKEND_kvs40xx
	bool "kvs40xx backend"
	select FREETZ_PACKAGE_SANE_BACKENDS_BACKEND_dll
	default n

config FREETZ_PACKAGE_SANE_BACKENDS_BACKEND_leo
	bool "leo backend"
	select FREETZ_PACKAGE_SANE_BACKENDS_BACKEND_dll
	default n

config FREETZ_PACKAGE_SANE_BACKENDS_BACKEND_lexmark
	bool "lexmark backend"
	select FREETZ_PACKAGE_SANE_BACKENDS_BACKEND_dll
	default n

config FREETZ_PACKAGE_SANE_BACKENDS_BACKEND_ma1509
	bool "ma1509 backend"
	select FREETZ_PACKAGE_SANE_BACKENDS_BACKEND_dll
	default n

config FREETZ_PACKAGE_SANE_BACKENDS_BACKEND_magicolor
	bool "magicolor backend"
	select FREETZ_PACKAGE_SANE_BACKENDS_BACKEND_dll
	default n

config FREETZ_PACKAGE_SANE_BACKENDS_BACKEND_matsushita
	bool "matsushita backend"
	select FREETZ_PACKAGE_SANE_BACKENDS_BACKEND_dll
	default n

config FREETZ_PACKAGE_SANE_BACKENDS_BACKEND_microtek
	bool "microtek backend"
	select FREETZ_PACKAGE_SANE_BACKENDS_BACKEND_dll
	default n

config FREETZ_PACKAGE_SANE_BACKENDS_BACKEND_microtek2
	bool "microtek2 backend"
	select FREETZ_PACKAGE_SANE_BACKENDS_BACKEND_dll
	default n

config FREETZ_PACKAGE_SANE_BACKENDS_BACKEND_mustek
	bool "mustek backend"
	select FREETZ_PACKAGE_SANE_BACKENDS_BACKEND_dll
	default n

config FREETZ_PACKAGE_SANE_BACKENDS_BACKEND_mustek_usb
	bool "mustek_usb backend"
	select FREETZ_PACKAGE_SANE_BACKENDS_BACKEND_dll
	default n

config FREETZ_PACKAGE_SANE_BACKENDS_BACKEND_mustek_usb2
	bool "mustek_usb2 backend"
	select FREETZ_PACKAGE_SANE_BACKENDS_BACKEND_dll
	default n

config FREETZ_PACKAGE_SANE_BACKENDS_BACKEND_nec
	bool "nec backend"
	select FREETZ_PACKAGE_SANE_BACKENDS_BACKEND_dll
	default n

config FREETZ_PACKAGE_SANE_BACKENDS_BACKEND_net
	bool "net backend"
	select FREETZ_PACKAGE_SANE_BACKENDS_BACKEND_dll
	default n

config FREETZ_PACKAGE_SANE_BACKENDS_BACKEND_niash
	bool "niash backend"
	select FREETZ_PACKAGE_SANE_BACKENDS_BACKEND_dll
	default n

config FREETZ_PACKAGE_SANE_BACKENDS_BACKEND_p5
	bool "p5 backend"
	select FREETZ_PACKAGE_SANE_BACKENDS_BACKEND_dll
	default n

config FREETZ_PACKAGE_SANE_BACKENDS_BACKEND_pie
	bool "pie backend"
	select FREETZ_PACKAGE_SANE_BACKENDS_BACKEND_dll
	default n

config FREETZ_PACKAGE_SANE_BACKENDS_BACKEND_pieusb
	bool "pieusb backend"
	select FREETZ_PACKAGE_SANE_BACKENDS_BACKEND_dll
	default n

config FREETZ_PACKAGE_SANE_BACKENDS_BACKEND_pixma
	bool "pixma backend"
	select FREETZ_PACKAGE_SANE_BACKENDS_BACKEND_dll
	default n

config FREETZ_PACKAGE_SANE_BACKENDS_BACKEND_plustek
	bool "plustek backend"
	select FREETZ_PACKAGE_SANE_BACKENDS_BACKEND_dll
	default n

config FREETZ_PACKAGE_SANE_BACKENDS_BACKEND_plustek_pp
	bool "plustek_pp backend"
	select FREETZ_PACKAGE_SANE_BACKENDS_BACKEND_dll
	default n

config FREETZ_PACKAGE_SANE_BACKENDS_BACKEND_qcam
	bool "qcam backend"
	select FREETZ_PACKAGE_SANE_BACKENDS_BACKEND_dll
	default n

config FREETZ_PACKAGE_SANE_BACKENDS_BACKEND_ricoh
	bool "ricoh backend"
	select FREETZ_PACKAGE_SANE_BACKENDS_BACKEND_dll
	default n

config FREETZ_PACKAGE_SANE_BACKENDS_BACKEND_rts8891
	bool "rts8891 backend"
	select FREETZ_PACKAGE_SANE_BACKENDS_BACKEND_dll
	default n

config FREETZ_PACKAGE_SANE_BACKENDS_BACKEND_s9036
	bool "s9036 backend"
	select FREETZ_PACKAGE_SANE_BACKENDS_BACKEND_dll
	default n

config FREETZ_PACKAGE_SANE_BACKENDS_BACKEND_sceptre
	bool "sceptre backend"
	select FREETZ_PACKAGE_SANE_BACKENDS_BACKEND_dll
	default n

config FREETZ_PACKAGE_SANE_BACKENDS_BACKEND_sharp
	bool "sharp backend"
	select FREETZ_PACKAGE_SANE_BACKENDS_BACKEND_dll
	default n

config FREETZ_PACKAGE_SANE_BACKENDS_BACKEND_sm3600
	bool "sm3600 backend"
	select FREETZ_PACKAGE_SANE_BACKENDS_BACKEND_dll
	default n

config FREETZ_PACKAGE_SANE_BACKENDS_BACKEND_sm3840
	bool "sm3840 backend"
	select FREETZ_PACKAGE_SANE_BACKENDS_BACKEND_dll
	default n

config FREETZ_PACKAGE_SANE_BACKENDS_BACKEND_snapscan
	bool "snapscan backend"
	select FREETZ_PACKAGE_SANE_BACKENDS_BACKEND_dll
	default n

config FREETZ_PACKAGE_SANE_BACKENDS_BACKEND_sp15c
	bool "sp15c backend"
	select FREETZ_PACKAGE_SANE_BACKENDS_BACKEND_dll
	default n

config FREETZ_PACKAGE_SANE_BACKENDS_BACKEND_st400
	bool "st400 backend"
	select FREETZ_PACKAGE_SANE_BACKENDS_BACKEND_dll
	default n

config FREETZ_PACKAGE_SANE_BACKENDS_BACKEND_stv680
	bool "stv680 backend"
	select FREETZ_PACKAGE_SANE_BACKENDS_BACKEND_dll
	default n

config FREETZ_PACKAGE_SANE_BACKENDS_BACKEND_tamarack
	bool "tamarack backend"
	select FREETZ_PACKAGE_SANE_BACKENDS_BACKEND_dll
	default n

config FREETZ_PACKAGE_SANE_BACKENDS_BACKEND_teco1
	bool "teco1 backend"
	select FREETZ_PACKAGE_SANE_BACKENDS_BACKEND_dll
	default n

config FREETZ_PACKAGE_SANE_BACKENDS_BACKEND_teco2
	bool "teco2 backend"
	select FREETZ_PACKAGE_SANE_BACKENDS_BACKEND_dll
	default n

config FREETZ_PACKAGE_SANE_BACKENDS_BACKEND_teco3
	bool "teco3 backend"
	select FREETZ_PACKAGE_SANE_BACKENDS_BACKEND_dll
	default n

config FREETZ_PACKAGE_SANE_BACKENDS_BACKEND_test
	bool "test backend"
	select FREETZ_PACKAGE_SANE_BACKENDS_BACKEND_dll
	default n

config FREETZ_PACKAGE_SANE_BACKENDS_BACKEND_u12
	bool "u12 backend"
	select FREETZ_PACKAGE_SANE_BACKENDS_BACKEND_dll
	default n

config FREETZ_PACKAGE_SANE_BACKENDS_BACKEND_umax
	bool "umax backend"
	select FREETZ_PACKAGE_SANE_BACKENDS_BACKEND_dll
	default n

config FREETZ_PACKAGE_SANE_BACKENDS_BACKEND_umax1220u
	bool "umax1220u backend"
	select FREETZ_PACKAGE_SANE_BACKENDS_BACKEND_dll
	default n

config FREETZ_PACKAGE_SANE_BACKENDS_BACKEND_umax_pp
	bool "umax_pp backend"
	select FREETZ_PACKAGE_SANE_BACKENDS_BACKEND_dll
	default n

config FREETZ_PACKAGE_SANE_BACKENDS_BACKEND_xerox_mfp
	bool "xerox_mfp backend"
	select FREETZ_PACKAGE_SANE_BACKENDS_BACKEND_dll
	default n

endif # FREETZ_PACKAGE_SANE_BACKENDS
```
