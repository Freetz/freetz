## make/pkgs/unfs3/Config.in
```kconfig
if FREETZ_TARGET_UCLIBC_SUPPORTS_rpc

	comment "UNFS3 (not available, you have selected incompatible package nfsd)"
		depends on FREETZ_PACKAGE_NFSD_CGI

	config FREETZ_PACKAGE_UNFS3
		bool "UNFS3 0.9.23"
		depends on !FREETZ_PACKAGE_NFSD_CGI
		select FREETZ_PACKAGE_PORTMAP if FREETZ_TARGET_UCLIBC_SUPPORTS_rpc
		select FREETZ_PACKAGE_RPCBIND if !FREETZ_TARGET_UCLIBC_SUPPORTS_rpc
		select FREETZ_LIB_libtirpc    if !FREETZ_TARGET_UCLIBC_SUPPORTS_rpc
		help
			Userspace NFS v3 Server.

endif # FREETZ_TARGET_UCLIBC_SUPPORTS_rpc
```

## make/pkgs/usbids/Config.in
```kconfig
config FREETZ_PACKAGE_USBIDS
	bool "usb.ids a5edeafb60"
	default n
	help
		This package provides up-to-date version of the usb.ids file
		needed by many usb related packages.

if FREETZ_PACKAGE_USBIDS

	config FREETZ_PACKAGE_USBIDS_VERSION_LATEST
		bool "Use latest version"
		default n
		help
			Download the latest version of usb.ids file.

endif # FREETZ_PACKAGE_USBIDS
```

## make/pkgs/usbroot/Config.in
```kconfig
config FREETZ_PACKAGE_USBROOT
	bool "USB root 0.2"
	depends on FREETZ_AVM_HAS_USB_HOST
	select FREETZ_PACKAGE_FSTYP if FREETZ_PATCH_FREETZMOUNT
	select FREETZ_PACKAGE_USBROOT_E2FSCK if FREETZ_AVM_HAS_E2FSPROGS
	select FREETZ_BUSYBOX_MAKEDEVS
	default n
	help
		Mount an ext{2,3} filesystem (fs) from an USB stick and use it
		as root fs which may be fully writable and basically unlimited
		in size. The Linux kernel will still be loaded from your box
		and during the first phase of the init process the SquashFS on
		the box is still used, but after the USB root is mounted, we
		pivot_root into it and it becomes the new root fs. The default
		is to unmount the read-only fs on the box to conserve memory,
		but if desired, it can be still be accessed under /oldroot
		(though this is absolutely not necessary anymore after
		pivot_root).

		Having said that, it should be clear that the usb stick should
		contain everything necessary to run the box. Usually you just
		create a full copy of a target filesystem (e.g. from
		build/modified/filesystem or from an unpacked firmware image)
		and start modifying it as needed. The binaries (kernel modules,
		executables, shared libraries) used therein just have to fit
		the kernel installed on the box.

		Note: The webinterface makes it pretty easy to (de-)activate and
		configure the functionality of this package. However, USB root
		is an expert thing! See also the help screen of
		/etc/init.d/rc.usbroot for further description. As some config
		data is stored in bootloader environment, this package is
		special anyway.

config FREETZ_PACKAGE_USBROOT_E2FSCK
	bool "Include e2fsck support"
	depends on FREETZ_PACKAGE_USBROOT
	select FREETZ_REMOVE_AVM_E2FSPROGS if FREETZ_AVM_HAS_E2FSPROGS && !FREETZ_PATCH_UDEVMOUNT
	select FREETZ_PACKAGE_E2FSPROGS if FREETZ_REMOVE_AVM_E2FSPROGS
	select FREETZ_PACKAGE_E2FSPROGS_E2FSCK if FREETZ_REMOVE_AVM_E2FSPROGS
	default n
	help
		This option includes the /usr/sbin/e2fsck application which is used
		to fix filesystem errors automatically prior to mounting usbroot.
```

## make/pkgs/vermagic/Config.in
```kconfig
config FREETZ_PACKAGE_VERMAGIC
	bool "vermagic 1ac45e08d4-git (binary only)"
	default n
	help
		A tool dump .modinfo section and set vermagic variable of Linux Kernel Modules.
		It also supports (not tested) CRC dump and changes, including the vermagic string.
		The original work is from here: https://github.com/fanfuqiang/vc
		The extended code of this tool: https://github.com/D1W0U/vermagic
```

## make/pkgs/virtualip-cgi/Config.in
```kconfig
config FREETZ_PACKAGE_VIRTUALIP_CGI
	bool "Virtual IP CGI 0.4.2 (deprecated)"
	depends on FREETZ_SHOW_EXPERT
	default n
	help
		Creates a virtual network interface. In former times this was
		used to comfortably open server ports on the Fritz!Box itself
		via AVM web interface. Nowadays the avm-firewall package is used
		for this task.

		The package is also equipped with a configuration interface for the
		Freetz web configurator which lets you choose the IP address and
		net mask of the virtual interface as well as toggle auto-start.
```
