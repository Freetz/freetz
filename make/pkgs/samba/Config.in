## make/pkgs/scanbuttond/Config.in
```kconfig
config FREETZ_PACKAGE_SCANBUTTOND
	bool "scanbuttond cvs"
	select FREETZ_LIB_libdl if FREETZ_TARGET_UCLIBC_HAS_multiple_libs
	select FREETZ_LIB_libusb_0
	select FREETZ_PACKAGE_SANE_BACKENDS
	select FREETZ_PACKAGE_SANE_BACKENDS_scanimage
	select FREETZ_PACKAGE_SCANBUTTOND_BACKEND_meta
	default n
	help
		Scanner button daemon. It allows you to invoke actions such as shell
		scripts whenever one of the scanner front panel buttons is pressed.

if FREETZ_PACKAGE_SCANBUTTOND

config FREETZ_PACKAGE_SCANBUTTOND_BACKEND_artec_eplus48u
	bool "artec_eplus48u backend"
	default n

config FREETZ_PACKAGE_SCANBUTTOND_BACKEND_epson
	bool "epson backend"
	default n

config FREETZ_PACKAGE_SCANBUTTOND_BACKEND_genesys
	bool "genesys backend"
	default n

config FREETZ_PACKAGE_SCANBUTTOND_BACKEND_gt68xx
	bool "gt68xx backend"
	default n

config FREETZ_PACKAGE_SCANBUTTOND_BACKEND_hp3500
	bool "hp3500 backend"
	default n

config FREETZ_PACKAGE_SCANBUTTOND_BACKEND_hp3900
	bool "hp3900 backend"
	default n

config FREETZ_PACKAGE_SCANBUTTOND_BACKEND_hp5590
	bool "hp5590 backend"
	default n

config FREETZ_PACKAGE_SCANBUTTOND_BACKEND_meta
	bool "meta backend"
	default n

config FREETZ_PACKAGE_SCANBUTTOND_BACKEND_mustek
	bool "mustek backend"
	default n

config FREETZ_PACKAGE_SCANBUTTOND_BACKEND_niash
	bool "niash backend"
	default n

config FREETZ_PACKAGE_SCANBUTTOND_BACKEND_plustek
	bool "plustek backend"
	default n

config FREETZ_PACKAGE_SCANBUTTOND_BACKEND_plustek_umax
	bool "plustek_umax backend"
	default n

config FREETZ_PACKAGE_SCANBUTTOND_BACKEND_snapscan
	bool "snapscan backend"
	default n

endif # FREETZ_PACKAGE_SCANBUTTOND
```

## make/pkgs/ser2net/Config.in
```kconfig
config FREETZ_PACKAGE_SER2NET
	bool "ser2net 3.5.4"
	default n
	help
		Ser2net is a program for allowing network connections to serial
		ports. It supports RFC 2217 (remote control of serial port
		parameters), but you must have a complient client.
```

## make/pkgs/sfk/Config.in
```kconfig
config FREETZ_PACKAGE_SFK
	bool "Swiss File Knife 1.9.7.2"
	select FREETZ_LIB_STDCXXLIB if ! FREETZ_PACKAGE_SFK_STATIC
#	select FREETZ_LIB_STDCXXLIB_WITH_WCHAR
	default n
	help
		Swiss File Knife - A Command Line Tools Collection

		This packages provides the freeware version of SFK,
		see http://stahlworks.com/dev/swiss-file-knife.html
		for further information

config FREETZ_PACKAGE_SFK_STATIC
	bool "Link statically"
	depends on FREETZ_PACKAGE_SFK
	default n
	help
		Causes all libraries SFK depends on to be linked in statically
```

## make/pkgs/siproxd/Config.in
```kconfig
config FREETZ_PACKAGE_SIPROXD
	bool "siproxd 0.8.1"
	default n
	select FREETZ_LIB_libpthread  if FREETZ_TARGET_UCLIBC_HAS_multiple_libs
	select FREETZ_LIB_libdl       if FREETZ_TARGET_UCLIBC_HAS_multiple_libs
	select FREETZ_LIB_libltdl
	select FREETZ_LIB_libosip2
	help
		Siproxd is a proxy/masquerading daemon for the SIP protocol.
		See http://siproxd.sourceforge.net for more information.

config FREETZ_PACKAGE_SIPROXD_PLUGIN_DEFAULTTARGET
	bool "include defaulttarget plugin"
	depends on FREETZ_PACKAGE_SIPROXD
	default n

config FREETZ_PACKAGE_SIPROXD_PLUGIN_FIX_BOGUS_VIA
	bool "include fix_bogus_via plugin"
	depends on FREETZ_PACKAGE_SIPROXD
	default n

config FREETZ_PACKAGE_SIPROXD_PLUGIN_LOGCALL
	bool "include logcall plugin"
	depends on FREETZ_PACKAGE_SIPROXD
	default n

config FREETZ_PACKAGE_SIPROXD_PLUGIN_PREFIX
	bool "include prefix plugin"
	depends on FREETZ_PACKAGE_SIPROXD
	default n

config FREETZ_PACKAGE_SIPROXD_PLUGIN_REGEX
	bool "include regex plugin"
	depends on FREETZ_PACKAGE_SIPROXD
	default n

config FREETZ_PACKAGE_SIPROXD_PLUGIN_SHORTDIAL
	bool "include shortdial plugin"
	depends on FREETZ_PACKAGE_SIPROXD
	default n

config FREETZ_PACKAGE_SIPROXD_PLUGIN_STUN
	bool "include stun plugin"
	depends on FREETZ_PACKAGE_SIPROXD
	default n

config FREETZ_PACKAGE_SIPROXD_PLUGIN_DEMO
	bool "include demo plugin"
	depends on FREETZ_PACKAGE_SIPROXD
	default n
	help
		include demo plugin (only for demo purposes)
```

## make/pkgs/slang/Config.in
```kconfig
config FREETZ_PACKAGE_SLANG
	bool "S-Lang 2.3.1a (binary only)"
	select FREETZ_LIB_libslang
	default n
	help
		S-Lang is a powerful interpreted language that may be embedded
		into an application to make the application extensible.

		Note: at the moment this options causes only libslang to be included
		in the image, i.e. S-Lang shell support is disabled.

config FREETZ_PACKAGE_SLANG_MODULES
	bool "include shared modules"
	depends on FREETZ_PACKAGE_SLANG
	select FREETZ_LIB_libiconv if FREETZ_TARGET_UCLIBC_0_9_28
	select FREETZ_LIB_libpcre
	select FREETZ_LIB_libz
	default n
	help
		This option causes shared modules to be included in the image.
```

## make/pkgs/slurm/Config.in
```kconfig
config FREETZ_PACKAGE_SLURM
	bool "Slurm 0.3.3 (binary only)"
	select FREETZ_LIB_libncurses
	default n
	help
		slurm - yet another network load monitor
		slurm started as a FreeBSD port of the Linux ppp link monitor called
		pppstatus by Gabriel Montenegro.
		features:
			- "realtime" traffic statistics
			- three graph modes: combined RX and TX and two split views
			- can monitor any network device
			- curses ascii graphics
```

## make/pkgs/smstools3/Config.in
```kconfig
config FREETZ_PACKAGE_SMSTOOLS3
	bool "smstools3 3.1.21"
	default n
	help
		The SMS Server Tools 3 is a SMS Gateway software which can send
		and receive short messages through GSM modems and mobile phones.
		This is the enhanced version 3.x maintained by Mr. Keijo "Keke"
		Kasvi.
		WWW: http://smstools3.kekekasvi.com
```

## make/pkgs/spindown-cgi/Config.in
```kconfig
config FREETZ_PACKAGE_SPINDOWN_CGI
	bool "spindown-cgi 0.2"
	default n
	select FREETZ_PACKAGE_SG3UTILS
	select FREETZ_BUSYBOX_START_STOP_DAEMON
	help
		Choose this package if you want to spin down your attached USB disk after
		a configurable idle time period. However, it is not guaranteed to work with
		all disks.

source "make/pkgs/sg3_utils/Config.in"
```

## make/pkgs/sslh/Config.in
```kconfig
config FREETZ_PACKAGE_SSLH
	bool "sslh 1.22c"
	default n
	select FREETZ_LIB_libconfig
	select FREETZ_LIB_libpcre2
	help
		sslh accepts HTTPS, SSH and OpenVPN connections on the same port.
		This makes it possible to connect to an SSH server or an OpenVPN
		on port 443 (e.g. from inside a corporate firewall, which almost
		never block port 443) while still serving HTTPS on that port.
```

## make/pkgs/streamripper/Config.in
```kconfig
config FREETZ_PACKAGE_STREAMRIPPER
	bool "Streamripper 1.64.6"
	select FREETZ_LIB_libglib_2
	select FREETZ_LIB_libm        if FREETZ_TARGET_UCLIBC_HAS_multiple_libs
	select FREETZ_LIB_libpthread  if FREETZ_TARGET_UCLIBC_HAS_multiple_libs
	select FREETZ_LIB_libpcre
	select FREETZ_LIB_libmad
	select FREETZ_BUSYBOX_START_STOP_DAEMON
	default n
	help
		Streamripper records mp3 and ogg streams.
		For shoutcast style streams it finds the "meta data"
		or track separation data, and uses that as a marker
		for where the track should be separated.

config FREETZ_PACKAGE_STREAMRIPPER_WITH_OGGVORBIS
	bool "Add support to rip ogg streams"
	depends on FREETZ_PACKAGE_STREAMRIPPER
	select FREETZ_LIB_libogg
	select FREETZ_LIB_libvorbis
	default n
	help
		Select this option if you want to be able to rip
		ogg streams with streamripper.
```

## make/pkgs/subversion/Config.in
```kconfig
config FREETZ_PACKAGE_SUBVERSION_LIBRARIES
	bool

config FREETZ_PACKAGE_SUBVERSION
	bool "Subversion 1.9.12/1.14.2"
	select FREETZ_PACKAGE_SUBVERSION_REMOVE_WEBIF if !FREETZ_PACKAGE_SUBVERSION_SVNSERVE
	select FREETZ_PACKAGE_SUBVERSION_LIBRARIES    if !FREETZ_PACKAGE_SUBVERSION_STATIC
	select FREETZ_BUSYBOX_START_STOP_DAEMON
	select FREETZ_LIB_libm                        if FREETZ_TARGET_UCLIBC_HAS_multiple_libs
	select FREETZ_LIB_libcrypto                   if !FREETZ_PACKAGE_SUBVERSION_STATIC  # serf
	select FREETZ_LIB_libssl                      if !FREETZ_PACKAGE_SUBVERSION_STATIC  # serf
	select FREETZ_LIB_libapr                      if !FREETZ_PACKAGE_SUBVERSION_STATIC
	select FREETZ_LIB_libaprutil                  if !FREETZ_PACKAGE_SUBVERSION_STATIC
	select FREETZ_LIB_libexpat                    if !FREETZ_PACKAGE_SUBVERSION_STATIC  # apr
	select FREETZ_LIB_liblz4                      if !FREETZ_PACKAGE_SUBVERSION_STATIC && !FREETZ_PACKAGE_SUBVERSION_VERSION_ABANDON
	select FREETZ_LIB_libserf                     if !FREETZ_PACKAGE_SUBVERSION_STATIC
	select FREETZ_LIB_libsqlite3                  if !FREETZ_PACKAGE_SUBVERSION_STATIC
	select FREETZ_LIB_libutf8proc                 if !FREETZ_PACKAGE_SUBVERSION_STATIC && !FREETZ_PACKAGE_SUBVERSION_VERSION_ABANDON
	select FREETZ_LIB_libuuid                     if !FREETZ_PACKAGE_SUBVERSION_STATIC  # apr
	select FREETZ_LIB_libz                        if !FREETZ_PACKAGE_SUBVERSION_STATIC
	default n
	help
		Subversion, also known as svn, is a version control system much like
		the Concurrent Versions System (CVS). Version control systems allow
		many individuals (who may be distributed geographically) to collaborate
		on a set of files (typically source code). Subversion has all the major
		features of CVS, plus certain new features that CVS users often wish
		they had.

if FREETZ_PACKAGE_SUBVERSION

	choice
		prompt "Version"
		default FREETZ_PACKAGE_SUBVERSION_VERSION_CURRENT

		config FREETZ_PACKAGE_SUBVERSION_VERSION_ABANDON
			bool "1.9.12"

		config FREETZ_PACKAGE_SUBVERSION_VERSION_CURRENT
			bool "1.14.2"
	endchoice

	config FREETZ_PACKAGE_SUBVERSION_WITH_LIBDB
		bool "build with Berkeley-DB support"
		select FREETZ_LIB_libaprutil_WITH_LIBDB
		default n
		help
			Enables Berkeley-DB support in subversion.

	config FREETZ_PACKAGE_SUBVERSION_SVN
		bool "Include svn"
		default y
		help
			Include svn (subversion client tool) in the image.

	config FREETZ_PACKAGE_SUBVERSION_SVNADMIN
		bool "Inlcude svnadmin"
		default y
		help
			Include svnadmin (subversion repository administration tool) in the image.

	config FREETZ_PACKAGE_SUBVERSION_SVNDUMPFILTER
		bool "Include svndumpfilter"
		default y
		help
			Include svndumpfilter (tool to filter subversion repository dumpfile) in the image.

	config FREETZ_PACKAGE_SUBVERSION_SVNLOOK
		bool "Include svnlook"
		default y
		help
			Include svnlook (subversion repository examination tool) in the image.

	config FREETZ_PACKAGE_SUBVERSION_SVNRDUMP
		bool "Include svnrdump"
		default y
		help
			Include svnrdump (subversion remote repository dumper and loader utility) in the image.

	config FREETZ_PACKAGE_SUBVERSION_SVNSERVE
		bool "Include svnserve"
		default y
		help
			Include svnserve (server for the 'svn' repository access method) in the image.

	config FREETZ_PACKAGE_SUBVERSION_SVNSYNC
		bool "Inlcude svnsync"
		default y
		help
			Include svnsync (repository synchronization tool) in the image.

	config FREETZ_PACKAGE_SUBVERSION_SVNVERSION
		bool "Include svnversion"
		default y
		help
			Include svnversion (tool to produce a compact version number for a working copy) in the image.

	config FREETZ_PACKAGE_SUBVERSION_APACHE_MODULES
		bool "Apache modules"
		depends on FREETZ_PACKAGE_APACHE2 && !FREETZ_PACKAGE_APACHE2_COMPILEINMODS
		select FREETZ_PACKAGE_SUBVERSION_mod_dav_svn

	if FREETZ_PACKAGE_SUBVERSION_APACHE_MODULES

		config FREETZ_PACKAGE_SUBVERSION_mod_authz_svn
			bool "mod_authz_svn"
			default n
			help
				Subversion path-based authorization module for Apache

		config FREETZ_PACKAGE_SUBVERSION_mod_dav_svn
			bool "mod_dav_svn"
			default n
			help
				Subversion plug-in for the Apache DAV module

		config FREETZ_PACKAGE_SUBVERSION_mod_dontdothat
			bool "mod_dontdothat"
			default n
			help
				Module to block certain kinds of Apache Subversion requests

	endif # FREETZ_PACKAGE_SUBVERSION_APACHE_MODULES

	config FREETZ_PACKAGE_SUBVERSION_STATIC
		bool "Link statically"
		depends on !FREETZ_PACKAGE_SUBVERSION_APACHE_MODULES
		default n
		help
			Activating this switch causes all libraries subversion tools
			depend on to be linked in statically.

	config FREETZ_PACKAGE_SUBVERSION_REMOVE_WEBIF
		bool "Remove webinterface"
		default n
		help
			This option removes the webinterface

endif # FREETZ_PACKAGE_SUBVERSION
```

## make/pkgs/synce-serial/Config.in
```kconfig
comment "SynCE serial (not available, needs kernel modules)"
	depends on !(FREETZ_REPLACE_KERNEL && FREETZ_PACKAGE_PPP)

config FREETZ_PACKAGE_SYNCE_SERIAL
	bool "SynCE serial 0.10.0 (binary only)"
	depends on FREETZ_REPLACE_KERNEL && FREETZ_PACKAGE_PPP
	select FREETZ_PACKAGE_PPPD
	select FREETZ_PACKAGE_SYNCE_DCCM
	default n
	help
		SynCE is a framework to sync WinCE devices
```

## make/pkgs/syslogd-cgi/Config.in
```kconfig
config FREETZ_PACKAGE_SYSLOGD_CGI
	bool "Syslogd CGI"
	select FREETZ_BUSYBOX_FEATURE_IPC_SYSLOG
	select FREETZ_BUSYBOX_FEATURE_KLOGD_KLOGCTL if FREETZ_AVM_HAS_PRINTK
	select FREETZ_BUSYBOX_FEATURE_LOGREAD_REDUCED_LOCKING
	select FREETZ_BUSYBOX_FEATURE_REMOTE_LOG
	select FREETZ_BUSYBOX_FEATURE_ROTATE_LOGFILE
	select FREETZ_BUSYBOX_FEATURE_SYSLOGD_DUP
	select FREETZ_BUSYBOX_KLOGD if FREETZ_AVM_HAS_PRINTK
	select FREETZ_BUSYBOX_LOGREAD
	select FREETZ_BUSYBOX_SYSLOGD
	default y
	help
		Configuration frontend to syslogd
```

## make/pkgs/tcpproxy/Config.in
```kconfig
config FREETZ_PACKAGE_TCPPROXY
	bool "tcpproxy 2.0.0-beta15 (binary only)"
	default n
	help
		tcpproxy is a proxy (or tunnel or redirector) for TCP/IP protocols.
		In standalone mode it waits for incoming connections forwarding
		them to another machine or starting a local server program.
```

## make/pkgs/tesseract/Config.in
```kconfig
config FREETZ_PACKAGE_TESSERACT
	bool "Tesseract OCR 3.02.02 (binary only)"
	select FREETZ_LIB_libtesseract
	select FREETZ_PACKAGE_TESSERACT_tesseract
	select FREETZ_PACKAGE_TESSERACT_ENG
	default n
	help
		Tesseract is an Open Source OCR engine

		Note:
		 Tesseract including languages files is a huge package and requires
		 a lot of RAM at run-time. It is NOT recommended to use it on boxes
		 having less than 64MB RAM.

if FREETZ_PACKAGE_TESSERACT

	comment "You need a box with at least 64MB RAM to run Tesseract"

	menu "Languages"

		config FREETZ_PACKAGE_TESSERACT_ENG
			bool "English"

		config FREETZ_PACKAGE_TESSERACT_DEU
			bool "German"
	endmenu

	config FREETZ_PACKAGE_TESSERACT_tesseract
		bool "tesseract"

	config FREETZ_PACKAGE_TESSERACT_ambiguous_words
		bool "ambiguous_words"

	config FREETZ_PACKAGE_TESSERACT_classifier_tester
		bool "classifier_tester"

	config FREETZ_PACKAGE_TESSERACT_cntraining
		bool "cntraining"

	config FREETZ_PACKAGE_TESSERACT_combine_tessdata
		bool "combine_tessdata"

	config FREETZ_PACKAGE_TESSERACT_dawg2wordlist
		bool "dawg2wordlist"

	config FREETZ_PACKAGE_TESSERACT_mftraining
		bool "mftraining"

	config FREETZ_PACKAGE_TESSERACT_shapeclustering
		bool "shapeclustering"

	config FREETZ_PACKAGE_TESSERACT_unicharset_extractor
		bool "unicharset_extractor"

	config FREETZ_PACKAGE_TESSERACT_wordlist2dawg
		bool "wordlist2dawg"

endif # FREETZ_PACKAGE_TESSERACT
```

## make/pkgs/tree/Config.in
```kconfig
config FREETZ_PACKAGE_TREE
	bool "tree 1.8.0 (binary only)"
	default n
	help
		Tree is a recursive directory listing program
		that produces a depth indented listing of files,
		which is colorized ala dircolors if the LS_COLORS
		environment variable is set and output is to tty.
```

## make/pkgs/udpxy/Config.in
```kconfig
config FREETZ_PACKAGE_UDPXY
	bool "udpxy 1.0.23-9 (binary only)"
	default n
	help
		Small-footprint UNIX/Linux daemon to relay multicast
		UDP traffic to client's TCP (HTTP) connection.
```
