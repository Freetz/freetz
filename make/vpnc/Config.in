## make/vpnc/Config.in
```kconfig
config FREETZ_PACKAGE_VPNC
	bool "Vpnc 0.5.3"
	depends on FREETZ_LANG_DE || ! FREETZ_SELECTED_LANG_ONLY
	select FREETZ_LIB_libnsl
	select FREETZ_LIB_libgpg_error
	select FREETZ_LIB_libgcrypt
	select FREETZ_LIB_libdl
	default n
	help
		Cisco IPSec VPN Client

config FREETZ_PACKAGE_VPNC_WITH_HYBRID_AUTH
	bool "Hybrid auth"
	depends on FREETZ_PACKAGE_VPNC
	select FREETZ_LIB_libcrypto
	default n

config FREETZ_PACKAGE_VPNC_NAT_SUPPORT
	bool "NAT support"
	depends on FREETZ_PACKAGE_VPNC
	select FREETZ_PACKAGE_IPTABLES
	default n
	help
		Enable NAT support for VPNC. This requires iptables!
```

## make/vsftpd/Config.in
```kconfig
config FREETZ_PACKAGE_VSFTPD
	bool "vsftpd 3.0.3"
	select FREETZ_LIB_libcrypt            if !FREETZ_PACKAGE_VSFTPD_STATIC && FREETZ_TARGET_UCLIBC_HAS_multiple_libs
	default n
	help
		A fast and secure FTP server

config FREETZ_PACKAGE_VSFTPD_WITH_SSL
	bool "build with SSL support"
	depends on FREETZ_PACKAGE_VSFTPD
	select FREETZ_LIB_libcrypto           if !FREETZ_PACKAGE_VSFTPD_STATIC
	select FREETZ_LIB_libcrypto_WITH_EC
	select FREETZ_LIB_libssl              if !FREETZ_PACKAGE_VSFTPD_STATIC
	default n
	help
		This option enables SSL support for vsftpd.

config FREETZ_PACKAGE_VSFTPD_STATIC
	bool "Link statically"
	depends on FREETZ_PACKAGE_VSFTPD
	default n
	help
		Causes all libraries vsftpd depends on to be linked in statically.
```

## make/vtun/Config.in
```kconfig
config FREETZ_PACKAGE_VTUN
	bool "VTun 3.0.4"
	default n
	help
		Virtual tunnel client and server

config FREETZ_PACKAGE_VTUN_STATIC
	bool "Link statically"
	depends on FREETZ_PACKAGE_VTUN
	default n
	help
		VTUN needs the following shared libraries which can be linked in statically
		by activating this switch:
		- libc.so
		- libgcc_s.so
		(- libcrypto.so)
		(- liblzo2.so)
		(- libz.so)

config FREETZ_PACKAGE_VTUN_WITH_LZO
	bool "With lzo Compression"
	depends on FREETZ_PACKAGE_VTUN
	select FREETZ_LIB_liblzo2 if ! FREETZ_PACKAGE_VTUN_STATIC
	default y
	help
		Build with LZO2 compression for tunnel traffic

config FREETZ_PACKAGE_VTUN_WITH_ZLIB
	bool "With libz Compression"
	depends on FREETZ_PACKAGE_VTUN
	select FREETZ_LIB_libz if ! FREETZ_PACKAGE_VTUN_STATIC
	default y
	help
		Build with LIBZ compression for tunnel traffic

config FREETZ_PACKAGE_VTUN_WITH_SSL
	bool "With SSL Encryption"
	depends on FREETZ_PACKAGE_VTUN
	select FREETZ_LIB_libcrypto if !FREETZ_PACKAGE_VTUN_STATIC
	default y
	help
		Build with SSL encryption for tunnel traffic

config FREETZ_PACKAGE_VTUN_WITH_SHAPER
	bool "With traffic shaper"
	depends on FREETZ_PACKAGE_VTUN
	default y
	help
		Build with shaper
```

## make/wget/Config.in
```kconfig
config FREETZ_PACKAGE_WGET
	bool "GNU Wget 1.19.5 (binary only)"
	default n
	help
		GNU Wget is a free software package for retrieving files using
		HTTP, HTTPS and FTP, the most widely-used Internet protocols. It
		is a non-interactive commandline tool, so it may easily be
		called from scripts, cron jobs, terminals, etc.

config FREETZ_PACKAGE_WGET_WITH_SSL
	bool "build with SSL support"
	depends on FREETZ_PACKAGE_WGET
	default n
	help
		This option enables SSL support for Wget.

choice
	depends on FREETZ_PACKAGE_WGET_WITH_SSL
	prompt "SSL library"
	default FREETZ_PACKAGE_WGET_OPENSSL

	config FREETZ_PACKAGE_WGET_OPENSSL
		bool "OpenSSL"
		select FREETZ_OPENSSL_VERSION_PROMPT
		select FREETZ_LIB_libcrypto if !FREETZ_PACKAGE_WGET_STATIC
		select FREETZ_LIB_libssl    if !FREETZ_PACKAGE_WGET_STATIC

	config FREETZ_PACKAGE_WGET_GNUTLS
		bool "GnuTLS"
		select FREETZ_LIB_libgnutls if !FREETZ_PACKAGE_WGET_STATIC
endchoice

config FREETZ_PACKAGE_WGET_STATIC
	bool "Statically link libraries"
	depends on FREETZ_PACKAGE_WGET_WITH_SSL
	default n
	help
		Wget with SSL support needs the following shared libraries which
		can be linked in statically by activating this switch:
		- libcrypto
		- libssl
		- libgnutls
```

## make/wireguard-linux-compat/Config.in
```kconfig
comment "WireGuard module (not available, needs replace kernel)"
	depends on FREETZ_KERNEL_VERSION_3_10_MIN && !FREETZ_REPLACE_KERNEL && !FREETZ_AVM_HAS_CRYPTO_BLKCIPHER_BUILTIN

config FREETZ_PACKAGE_WIREGUARD_LINUX_COMPAT
	bool "wireguard-linux-compat 1.0.20200729"
	depends on FREETZ_KERNEL_VERSION_3_10_MIN && (FREETZ_AVM_HAS_CRYPTO_BLKCIPHER_BUILTIN || FREETZ_REPLACE_KERNEL) && FREETZ_REPLACE_MODULE_AVAILABLE
	default n
	select FREETZ_BUSYBOX_IP
	select FREETZ_MODULE_wireguard
	help
		This package provides the kernel module required for Wireguard
```

## make/wireguard/Config.in
```kconfig
comment "wireguard-tools (not available, needs replace kernel)"
	depends on FREETZ_KERNEL_VERSION_3_10_MIN && !FREETZ_REPLACE_KERNEL && !FREETZ_AVM_HAS_CRYPTO_BLKCIPHER_BUILTIN

config FREETZ_PACKAGE_WIREGUARD
	bool "wireguard-tools 1.0.20200319"
	depends on FREETZ_KERNEL_VERSION_3_10_MIN && (FREETZ_AVM_HAS_CRYPTO_BLKCIPHER_BUILTIN || FREETZ_REPLACE_KERNEL) && FREETZ_REPLACE_MODULE_AVAILABLE
	default n
	select FREETZ_BUSYBOX_IP
	select FREETZ_PACKAGE_WIREGUARD_LINUX_COMPAT
	help
		WireGuard is an extremely simple yet fast and modern VPN
		that utilizes state-of-the-art cryptography. It aims to be
		faster, simpler, leaner, and more useful than IPSec, while
		avoiding the massive headache. It intends to be considerably
		more performant than OpenVPN. WireGuard is designed as a
		general purpose VPN for running on embedded interfaces and
		super computers alike, fit for many different circumstances.
		Initially released for the Linux kernel, it plans to be
		cross-platform and widely deployable. It is currently under
		heavy development, but already it might be regarded as the
		most secure, easiest to use, and simplest VPN solution in
		the industry.
```

## make/wol-cgi/Config.in
```kconfig
config FREETZ_PACKAGE_WOL_CGI
	bool "Wake-on-LAN (WoL) CGI 0.6"
	default n
	help
		Web configuration interface for Etherwake wake-on-LAN. Accessible via
		the URL http://fritz.box:84, it enables you to interactively wake up
		sleeping or switched off computers in the LAN reachable from you router
		box. Which machines can be woken up can be configured using the regular
		Freetz web interface.
```

## make/wol/Config.in
```kconfig
config FREETZ_PACKAGE_WOL
	bool "WOL 0.7.1 (binary only)"
	select FREETZ_PACKAGE_WOL_CGI
	default n
	help
		Simple Wake-On-Lan utility to wake up Magic-Packet-compliant hardware.
```

## make/wput/Config.in
```kconfig
config FREETZ_PACKAGE_WPUT
	bool "wput 0.6.1 (binary only)"
	select FREETZ_LIB_libncurses
	select FREETZ_LIB_libutil if FREETZ_TARGET_UCLIBC_HAS_multiple_libs
	default n
	help
		Wput is a command-line ftp-client that looks like wget but instead of
		downloading, uploads files or whole directories to remote ftp-servers.
```

## make/xmail/Config.in
```kconfig
config FREETZ_PACKAGE_XMAIL
	bool "XMail 1.27"
	select FREETZ_LIB_STDCXXLIB  if !FREETZ_PACKAGE_XMAIL_STATIC
	select FREETZ_LIB_libdl      if !FREETZ_PACKAGE_XMAIL_STATIC && FREETZ_TARGET_UCLIBC_HAS_multiple_libs
	select FREETZ_LIB_libpthread if !FREETZ_PACKAGE_XMAIL_STATIC && FREETZ_TARGET_UCLIBC_HAS_multiple_libs
	default n
	help
		XMail is an Internet and Intranet mail server featuring an SMTP server,
		POP3 server, finger server, multiple domains, no need for users to have
		a real system account, SMTP relay checking, RBL/RSS/ORBS/DUL and custom
		(IP based and address based) spam protection, SMTP authentication (PLAIN
		LOGIN CRAM-MD5 POP3-before-SMTP and custom), a POP3 account synchronizer
		with external POP3 accounts, account aliases, domain aliases, custom
		mail processing, direct mail files delivery, custom mail filters,
		mailing lists, remote administration, custom mail exchangers, logging,
		and multi-platform code.

config FREETZ_PACKAGE_XMAIL_WITH_SSL
	bool "build with SSL support"
	depends on FREETZ_PACKAGE_XMAIL
	select FREETZ_LIB_libcrypto if !FREETZ_PACKAGE_XMAIL_STATIC
	select FREETZ_LIB_libssl    if !FREETZ_PACKAGE_XMAIL_STATIC
	default n
	help
		This option enables SSL support for XMail.

config FREETZ_PACKAGE_XMAIL_STATIC
	bool "Link statically"
	depends on FREETZ_PACKAGE_XMAIL_WITH_SSL
	default n
	help
		Build XMail with staticly linked Libs.
```

## make/xpdf/Config.in
```kconfig
config FREETZ_PACKAGE_XPDF
	bool "Xpdf 3.02 (binary only)"
	select FREETZ_LIB_libuClibcxx
	default n
	help
		Xpdf is an open source viewer for Portable Document Format
		(PDF) files. (These are also sometimes also called 'Acrobat'
		files, from the name of Adobe's PDF software.) The Xpdf
		project also includes a PDF text extractor, PDF-to-PostScript 
		converter, and various other utilities.
		
		This packages includes only the non-X utilities.

menu "Xpdf options"
	depends FREETZ_PACKAGE_XPDF

config FREETZ_XPDF_pdftops
	bool "pdftops"
	default y

config FREETZ_XPDF_pdftotext
	bool "pdftotext"
	default n

config FREETZ_XPDF_pdfinfo
	bool "pdfinfo"
	default n

config FREETZ_XPDF_pdffonts
	bool "pdffonts"
	default n

config FREETZ_XPDF_pdfimages
	bool "pdfimages"
	default n

endmenu
```

## make/xrelayd/Config.in
```kconfig
config FREETZ_PACKAGE_XRELAYD
	bool "Xrelayd 0.2.1pre2"
	select FREETZ_LIB_libpolarssl
	default n
	help
		SSL tunnel based on PolarSSL. Xrelayd is a stripped down version of
		stunnel based on PolarSSL library. Essentially, this package makes your
		router's websrv or httpd SSL-enabled, offering you the option of remote
		configuration via WWW or secure remote use of features like Rudi-Shell.

		This package will eventually replace Matrixtunnel, even though the
		PolarSSL library is somewhat bigger than MatrixSSL. Its command line
		interface is identical to Matrixtunnel's, so switching should be easy
		for all users.
```

## make/xsltproc/Config.in
```kconfig
config FREETZ_PACKAGE_XSLTPROC
	bool "xsltproc 1.1.26 (binary only)"
	select FREETZ_LIB_libxslt
	select FREETZ_LIB_libexslt
	default n
	help
		xsltproc is a command line tool for applying XSLT stylesheets to XML
		documents. It is part of libxslt, the XSLT C library for GNOME.
		While it was developed as part of the GNOME project, it can operate
		independently of the GNOME desktop.
```

## make/zabbix/Config.in
```kconfig
config FREETZ_PACKAGE_ZABBIX
	bool "Zabbix 2.4.6 (binary only)"
	default n
	help
		Zabbix is an enterprise-class open source distributed monitoring
		solution.

		Zabbix is software that monitors numerous parameters of a
		network and the health and integrity of servers. Zabbix uses a
		flexible notification mechanism that allows users to configure
		e-mail based alerts for virtually any event. This allows a fast
		reaction to server problems. Zabbix offers excellent reporting
		and data visualisation features based on the stored data. This
		makes Zabbix ideal for capacity planning.

		Zabbix supports both polling and trapping. All Zabbix reports
		and statistics, as well as configuration parameters, are
		accessed through a web-based front end. A web-based front end
		ensures that the status of your network and the health of your
		servers can be assessed from any location. Properly configured,
		Zabbix can play an important role in monitoring IT
		infrastructure. This is equally true for small organisations
		with a few servers and for large companies with a multitude of
		servers.

		Zabbix is free of cost. Zabbix is written and distributed under
		the GPL General Public License version 2. It means that
		its source code is freely distributed and available for the
		general public.

config FREETZ_PACKAGE_ZABBIX_agentd
	bool "agent"
	depends on FREETZ_PACKAGE_ZABBIX
	select FREETZ_BUSYBOX_FEATURE_UTMP
	select FREETZ_BUSYBOX_WHO
	select FREETZ_LIB_libiconv if FREETZ_TARGET_UCLIBC_0_9_28
	default n
	help
		Zabbix agent is deployed on a monitoring target to actively
		monitor local resources and applications (hard drives, memory,
		processor statistics etc).

		The agent gathers operational information locally and reports
		data to Zabbix server for further processing. In case of failures
		(such as a hard disk running full or a crashed service process),
		Zabbix server can actively alert the administrators of the particular
		machine that reported the failure.

config FREETZ_PACKAGE_ZABBIX_server
	bool "server"
	depends on FREETZ_PACKAGE_ZABBIX
	select FREETZ_LIB_libm if FREETZ_TARGET_UCLIBC_HAS_multiple_libs
	select FREETZ_LIB_libsqlite3
	select FREETZ_LIB_libiconv if FREETZ_TARGET_UCLIBC_0_9_28
	default n
	help
		Zabbix server is the central process of Zabbix software.
		The server performs the polling and trapping of data,
		it calculates triggers, sends notifications to users.
		It is the central component to which Zabbix agents and
		proxies report data on availability and integrity of systems.
		The server can itself remotely check networked services
		(such as web servers and mail servers) using simple service checks.

		Note: most freetz users want to say NO here.

config FREETZ_PACKAGE_ZABBIX_proxy
	bool "proxy"
	depends on FREETZ_PACKAGE_ZABBIX
	select FREETZ_LIB_libm if FREETZ_TARGET_UCLIBC_HAS_multiple_libs
	select FREETZ_LIB_libsqlite3
	select FREETZ_LIB_libiconv if FREETZ_TARGET_UCLIBC_0_9_28
	default n
	help
		Zabbix proxy is a process that may collect monitoring data
		from one or more monitored devices and send the information
		to the Zabbix server, essentially working on behalf of the server.
		All collected data is buffered locally and then transferred
		to the Zabbix server the proxy belongs to.

		Deploying a proxy is optional, but may be very beneficial
		to distribute the load of a single Zabbix server. If only
		proxies collect data, processing on the server becomes
		less CPU and disk I/O hungry.

config FREETZ_PACKAGE_ZABBIX_sender
	bool "sender"
	depends on FREETZ_PACKAGE_ZABBIX
	select FREETZ_LIB_libiconv if FREETZ_TARGET_UCLIBC_0_9_28
	default n
	help
		Zabbix sender is a command line utility that may be used
		to send performance data to Zabbix server for processing.

		The utility is usually used in long running user scripts
		for periodical sending of availability and performance data.

config FREETZ_PACKAGE_ZABBIX_get
	bool "get"
	depends on FREETZ_PACKAGE_ZABBIX
	select FREETZ_LIB_libiconv if FREETZ_TARGET_UCLIBC_0_9_28
	default n
	help
		Zabbix get is a process which can be used to communicate
		with Zabbix agent and retrieve required information from
		the agent.

		The utility is usually used for the troubleshooting
		of Zabbix agents.
```
