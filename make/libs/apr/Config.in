## make/libs/apr/Config.in
```kconfig
config FREETZ_LIB_libapr
	select FREETZ_LIB_libcrypt    if FREETZ_TARGET_UCLIBC_HAS_multiple_libs
	select FREETZ_LIB_libm        if FREETZ_TARGET_UCLIBC_HAS_multiple_libs
	select FREETZ_LIB_libpthread  if FREETZ_TARGET_UCLIBC_HAS_multiple_libs
	select FREETZ_LIB_libuuid
	bool "Apache Portable Runtime Library (libapr-1.so)"
	default n
	help
		APR is Apache's Portable Runtime Library, designed to be a support
		library that provides a predictable and consistent interface to
		underlying platform-specific implementations.

	config FREETZ_LIB_libapr_WITH_DSO
		select FREETZ_LIB_libdl if FREETZ_TARGET_UCLIBC_HAS_multiple_libs
		bool "Build with DSO support" if FREETZ_LIB_libapr
		default n
		help
			This option enables DSO support in libapr.
```

## make/libs/attr/Config.in
```kconfig
config FREETZ_LIB_libattr
	bool "libattr (libattr.so)"
	default n
	help
		libattr allows to modify extended attributes of files.
```

## make/libs/bluez-libs/Config.in
```kconfig
config FREETZ_LIB_libbluetooth
	bool "bluez-libs (libbluetooth.so)"
	default n
	help
		The overall goal of the bluez project is to make an implementation of
		the Bluetooth wireless standards specifications for Linux.
```

## make/libs/cyassl/Config.in
```kconfig
config FREETZ_LIB_libcyassl
	bool "CyaSSL (libcyassl.so)"
	select FREETZ_LIB_libm
	select FREETZ_LIB_libpthread
	select FREETZ_LIB_libz
	default n
	help
		The yaSSL software package is a fast, open source, dual licensed
		implementation of SSL (SSLv3 and TLSv1). It includes SSL client
		libraries and an SSL server implementation. yaSSL supports multiple
		API's, including those defined by SSL and TLS. yaSSL also supports an
		OpenSSL compatibility interface.
```

## make/libs/db/Config.in
```kconfig
config FREETZ_LIB_libdb
	bool "Berkeley DB library (libdb.so)"
	select FREETZ_LIB_libpthread if FREETZ_TARGET_UCLIBC_HAS_multiple_libs
	default n
	help
		The Berkeley database library.
```

## make/libs/devmapper/Config.in
```kconfig
config FREETZ_LIB_libdevmapper
	bool "libdevmapper (libdevmapper.so)"
	default n
	help
		Device-mapper library.
```

## make/libs/expat/Config.in
```kconfig
config FREETZ_LIB_libexpat
	bool "libexpat (libexpat.so)"
	select FREETZ_LIB_libm if FREETZ_TARGET_UCLIBC_HAS_multiple_libs
	default n
	help
		This is Expat, a C library for parsing XML, written by James Clark.
		Expat is a stream-oriented XML parser. This means that you register
		handlers with the parser before starting the parse. These handlers
		are called when the parser discovers the associated structures in the
		document being parsed. A start tag is an example of the kind of
		structures for which you may register handlers.
```

## make/libs/flac/Config.in
```kconfig
config FREETZ_LIB_libFLAC
	bool "FLAC (libFLAC.so)"
	select FREETZ_LIB_libm if FREETZ_TARGET_UCLIBC_HAS_multiple_libs
	default n
	help
		Free Lossless Audio Codec library.
```

## make/libs/freetype/Config.in
```kconfig
config FREETZ_LIB_libfreetype
	bool "FreeType (freetype.so)"
	select FREETZ_LIB_libz
	default n
	help
		FreeType 2 is a software font engine that is designed to be small,
		efficient, highly customizable, and portable while capable of producing
		high-quality output (glyph images). It can be used in graphics
		libraries, display servers, font conversion tools, text image generation
		tools, and many other products as well.
```

## make/libs/gd/Config.in
```kconfig
config FREETZ_LIB_libgd
	bool "libgd (libgd.so)"
	default n
	select FREETZ_LIB_libjpeg
	select FREETZ_LIB_libfreetype
	select FREETZ_LIB_libpng12
	select FREETZ_LIB_libz
	help
		GD is an open source code library for the dynamic creation of images by
		programmers. GD creates PNG, JPEG and GIF images, among other formats.
		GD is commonly used to generate charts, graphics, thumbnails, and most
		anything else, on the fly.
```

## make/libs/glib/Config.in
```kconfig
config FREETZ_LIB_libglib_1
	bool "GLib 1.2 (libglib-1.2.so)"
	select FREETZ_LIB_libpthread
	default n
	help
		GLib is a library containing many useful C routines for things such as
		trees, hashes, and lists.
```

## make/libs/glib2/Config.in
```kconfig
config FREETZ_LIB_libglib_2
	bool "GLib2 libglib (libglib-2.0.so)"
	select FREETZ_LIB_libiconv if FREETZ_TARGET_UCLIBC_0_9_28
	select FREETZ_LIB_libpcre
	select FREETZ_LIB_libpthread if FREETZ_TARGET_UCLIBC_HAS_multiple_libs
	default n
	help
		GLib is a library containing many useful C routines for things such as
		trees, hashes, and lists.

config FREETZ_LIB_libgio_2
	bool "GLib2 libgio (libgio-2.0.so)"
	select FREETZ_LIB_libglib_2
	select FREETZ_LIB_libgmodule_2
	select FREETZ_LIB_libgobject_2
	select FREETZ_LIB_libgthread_2
	select FREETZ_LIB_libz
	default n
	help
		Input, output and streaming API of GLib.

config FREETZ_LIB_libgobject_2
	bool "GLib2 libgobject (libgobject-2.0.so)"
	select FREETZ_LIB_libglib_2
	select FREETZ_LIB_libgthread_2
	select FREETZ_LIB_libffi
	default n
	help
		If your application uses Glib2 GObjects, select this library.

config FREETZ_LIB_libgmodule_2
	bool "GLib2 libgmodule (libgmodule-2.0.so)"
	select FREETZ_LIB_libglib_2
	select FREETZ_LIB_libdl if FREETZ_TARGET_UCLIBC_HAS_multiple_libs
	default n
	help
		If your application uses Glib2 modules (plug-ins), select this library.

config FREETZ_LIB_libgthread_2
	bool "GLib2 libgthread (libgthread-2.0.so)"
	select FREETZ_LIB_libglib_2
	default n
	help
		If your application uses Glib2 threads, select this library.
```

## make/libs/gmp/Config.in
```kconfig
config FREETZ_LIB_libgmp
	bool "GNU MP Bignum Library (libgmp.so)"
	default n
	help
		GNU MP Bignum Library

		The GMP library provides arbitrary precision arithmetic, operating on
		signed integers, rational numbers, and floating point numbers.
		It can be used to implement cryptographic algorithms.
```

## make/libs/iksemel/Config.in
```kconfig
config FREETZ_LIB_libiksemel
	bool "libiksemel (libiksemel.so)"
	select FREETZ_LIB_libdl if FREETZ_TARGET_UCLIBC_HAS_multiple_libs
	select FREETZ_LIB_libcrypto
	select FREETZ_LIB_libssl
	default n
	help
		iksemel is an XML (eXtensible Markup Language) parser library designed for Jabber applications.
```

## make/libs/jansson/Config.in
```kconfig
config FREETZ_LIB_libjansson
	bool "libjansson (libjansson.so)"
	default n
	help
		A C library for encoding, decoding and manipulating JSON data.
```

## make/libs/jpeg/Config.in
```kconfig
config FREETZ_LIB_libjpeg
	bool "JPEG library (libjpeg.so)"
	default n
	help
		libjpeg is a library for handling the JPEG (JFIF) image format
```

## make/libs/js/Config.in
```kconfig
config FREETZ_LIB_libjs
	bool "libjs (libjs.so)"
	default n
	help
		OSSP js - Mozilla JavaScript Engine
```

## make/libs/ldns/Config.in
```kconfig
config FREETZ_LIB_libldns
	bool "libldns (libldns.so)"
	select FREETZ_LIB_libcrypto
	select FREETZ_LIB_libssl
	default n
	help
		The goal of ldns is to simplify DNS programming, it supports recent RFCs
		like the DNSSEC documents, and allows developers to easily create software
		conforming to current RFCs, and experimental software for current Internet
		Drafts. A secondary benefit of using ldns is speed; ldns is written in C
		it should be a lot faster than Perl.

	config FREETZ_LIB_libldns_WITH_EC
		bool "Force elliptic curve support"
		depends on FREETZ_LIB_libldns
		select FREETZ_LIB_libcrypto_WITH_EC
		default y
```

## make/libs/leptonica/Config.in
```kconfig
config FREETZ_LIB_liblept
	bool "leptonica (liblept.so)"
	select FREETZ_LIB_libm if FREETZ_TARGET_UCLIBC_HAS_multiple_libs
	select FREETZ_LIB_libjpeg
	select FREETZ_LIB_libpng12
	select FREETZ_LIB_libtiff
	select FREETZ_LIB_libz
	default n
	help
		A library for efficient image processing and image analysis operations.
```

## make/libs/libatomic/Config.in
```kconfig
config FREETZ_LIB_libatomic
	bool "libatomic (libatomic.so)"
	depends on FREETZ_TARGET_GCC_4_8_MIN
	default n
	help
		GCC Atomics Library

		Included in gcc since v4.8, see
		https://gcc.gnu.org/wiki/Atomic/GCCMM
```

## make/libs/libavmhmac/Config.in
```kconfig
config FREETZ_LIB_libavmhmac
	bool "libavmhmac (libavmhmac.so) - EXPERIMENTAL"
	depends on FREETZ_REPLACE_OPENSSL
	default n
	help
		Replaces AVM's libavmhmac.
		Our libavmhmac only forwards functions to openssl's libcrypto where AVM
		wrote their own implementations. We have no clue why they did this.
```

## make/libs/libcap/Config.in
```kconfig
config FREETZ_LIB_libcap
	bool "libcap (libcap.so)"
	depends on ! (FREETZ_TARGET_UCLIBC_0_9_28 || FREETZ_TARGET_UCLIBC_0_9_29)
	select FREETZ_LIB_libattr
	default n
	help
		A library for getting and setting POSIX.1e (formerly POSIX 6)
		draft 15 capabilities.
```

## make/libs/libcapi/Config.in
```kconfig
config FREETZ_LIB_libcapi20
	bool "CAPI 2.0 (libcapi20.so)"
	default n
	help
		COMMON-ISDN-API (CAPI) 2.0 Library
```

## make/libs/libconfig/Config.in
```kconfig
config FREETZ_LIB_libconfig
	bool "libconfig (libconfig.so)"
	default n
	help
		Libconfig is a simple library for processing structured configuration
		files. Libconfig is very compact - just 46K for the stripped C shared
		library. This makes it well-suited for memory-constrained systems.
```
