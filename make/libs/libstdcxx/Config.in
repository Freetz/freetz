## make/libs/libstdcxx/Config.in
```kconfig
config FREETZ_LIB_libstdc__
	bool "libstdc++ (libstdc++-6.0.x.so)"
	select FREETZ_LIB_libm if FREETZ_TARGET_UCLIBC_HAS_multiple_libs
	default n
	help
		GNU implementation of the Standard C++ Library.
```

## make/libs/libsynce/Config.in
```kconfig
config FREETZ_LIB_libsynce
	bool "libsynce (libsynce.so)"
	default n
	select FREETZ_LIB_libiconv if FREETZ_TARGET_UCLIBC_0_9_28
	help
		A helper library for SynCE, a framework to sync WinCE devices
```

## make/libs/libtasn1/Config.in
```kconfig
config FREETZ_LIB_libtasn1
	bool "GNU ASN1 library (libtasn1.so)"
	default n
	help
		A small ASN.1 library.
```

## make/libs/libtirpc/Config.in
```kconfig
config FREETZ_LIB_libtirpc
	bool "libtirpc (libtirpc.so)"
	depends on !FREETZ_TARGET_UCLIBC_SUPPORTS_rpc
	default n
	select FREETZ_ADD_ETCNETCONFIG
	help
		Libtirpc is a port of Suns Transport-Independent RPC library to
		Linux. It's being developed by the Bull GNU/Linux NFSv4 project. 
```

## make/libs/libtool/Config.in
```kconfig
config FREETZ_LIB_libltdl
	bool "libtool (libltdl.so)"
	default n
	help
		A generic dynamic object loading library
```

## make/libs/libusb/Config.in
```kconfig
config FREETZ_LIB_libusb_0
	bool "libusb-0.1 (libusb-0.1.so)"
	select FREETZ_LIB_libusb_1 if FREETZ_LIB_libusb_0_WITH_COMPAT
	default n
	help
		A library for accessing Linux USB devices (legacy API).

if FREETZ_LIB_libusb_0

	choice
		prompt "implemented using"
			default FREETZ_LIB_libusb_0_WITH_LEGACY

		config FREETZ_LIB_libusb_0_WITH_LEGACY
			bool "legacy library"

		config FREETZ_LIB_libusb_0_WITH_COMPAT
			bool "libusb-1.0 compat layer"
	endchoice

endif # FREETZ_LIB_libusb_0
```

## make/libs/libusb1/Config.in
```kconfig
config FREETZ_LIB_libusb_1
	bool "libusb-1.0 (libusb-1.0.so)"
	select FREETZ_LIB_libpthread if FREETZ_TARGET_UCLIBC_HAS_multiple_libs
	default n
	help
		A library for accessing Linux USB devices (current API).

if FREETZ_LIB_libusb_1

	config FREETZ_LIB_libusb_1_WITH_ABANDON
		bool
		depends on FREETZ_TARGET_GCC_4_MAX || FREETZ_KERNEL_VERSION_2_MAX
		default y

endif # FREETZ_LIB_libusb_1
```

## make/libs/libuv/Config.in
```kconfig
config FREETZ_LIB_libuv
	bool "libuv (libuv.so)"
	depends on FREETZ_TARGET_GCC_4_8_MIN
	select FREETZ_LIB_libm if FREETZ_TARGET_UCLIBC_HAS_multiple_libs
	default n
	help
		libuv is a async IO library for various programs
```

## make/libs/libvorbis/Config.in
```kconfig
config FREETZ_LIB_libvorbis
	bool "libvorbis (libvorbis.so)"
	select FREETZ_LIB_libm
	select FREETZ_LIB_libogg
	default n
	help
		Vorbis is the name of a specific audio compression scheme that's
		designed to be contained in Ogg. libvorbis is a BSD-style license
		software implementation of the Vorbis specification by the Xiph.Org
		Foundation.

config FREETZ_LIB_libvorbisenc
	bool "libvorbisenc (libvorbisenc.so)"
	select FREETZ_LIB_libvorbis
	default n
	help
		Libvorbisenc is an encoding convenience library intended to encapsulate
		the elaborate setup that libvorbis requires for encoding. Libvorbisenc
		gives easy access to all high-level adjustments an application may
		require when encoding and also exposes some low-level tuning parameters
		to allow applications to make detailed adjustments to the encoding
		process.

config FREETZ_LIB_libvorbisfile
	bool "libvorbisfile (libvorbisfile.so)"
	select FREETZ_LIB_libvorbis
	default n
	help
		The Vorbisfile library provides a convenient high-level API for decoding
		and basic manipulation of all Vorbis I audio streams.
		Libvorbisfile is implemented as a layer on top of Xiph.org's reference
		libogg and libvorbis libraries.
```

## make/libs/libxml2/Config.in
```kconfig
config FREETZ_LIB_libxml2
	bool "libxml2 (libxml2.so)"
	select FREETZ_LIB_libiconv if FREETZ_TARGET_UCLIBC_0_9_28
	select FREETZ_LIB_libpthread
	select FREETZ_LIB_libm
	select FREETZ_LIB_libz
	default n
	help
		XML toolkit from the GNOME project

config FREETZ_LIB_libxml2_WITH_HTML
	bool "build libxml2 with html support" if FREETZ_LIB_libxml2
	default n
	help
		Adds html parsing capability to libxml2. This increases the size of
		libxml2 by 120kB. Html parsing is required to build libxslt.
```

## make/libs/linux-atm/Config.in
```kconfig
config FREETZ_LIB_libatm
	bool "linux-atm (libatm.so)"
	default n
	help
		Libatm is a library for accessing the Linux ATM subsystem.
```

## make/libs/lz4/Config.in
```kconfig
config FREETZ_LIB_liblz4
	bool "LZ4 (liblz4.so)"
	default n
	help
		LZ4 is a very fast lossless compression algorithm, providing
		compression speed at 400 MB/s per core, scalable with multi-cores
		CPU. It also features an extremely fast decoder, with speed
		in multiple GB/s per core, typically reaching RAM speed limits
		on multi-core systems.
```

## make/libs/lzo/Config.in
```kconfig
config FREETZ_LIB_liblzo2
	bool "LZO (liblzo2.so)"
	default n
	help
		LZO is a portable lossless data compression library written in ANSI C.
		It offers pretty fast compression and *very* fast decompression.
		Decompression requires no memory. In addition there are slower
		compression levels achieving a quite competitive compression ratio
		while still decompressing at this very high speed.
```

## make/libs/matrixssl/Config.in
```kconfig
config FREETZ_LIB_libmatrixssl
	bool "MatrixSSL (libmatrixssl.so)"
	select FREETZ_LIB_libpthread
	default n
	help
		MatrixSSL is an open source embedded SSL implementation designed for
		small footprint applications and devices. There are existing open-source
		SSL implementations available and there are existing embedded SSL
		implementations, but there was a notable absence of packages that offer
		both.
```

## make/libs/mbedtls/Config.in
```kconfig
config FREETZ_LIB_libmbedcrypto
	bool "mbed crypto (libmbedcrypto.so)"
	default n

config FREETZ_LIB_libmbedcrypto_WITH_BLOWFISH
	bool "With Blowfish cipher" if FREETZ_LIB_libmbedcrypto
	default n
	help
		Enables support for the Blowfish block cipher.

config FREETZ_LIB_libmbedcrypto_WITH_GENRSA
	bool "With RSA prime-number generation" if FREETZ_LIB_libmbedcrypto
	default n
	help
		Enables the RSA prime-number generation code.

config FREETZ_LIB_libmbedtls
	bool "mbed TLS (libmbedtls.so)"
	default n

config FREETZ_LIB_libmbedx509
	bool "mbed X.509 (libmbedx509.so)"
	default n
```

## make/libs/mpc/Config.in
```kconfig
config FREETZ_LIB_libmpc
	select FREETZ_LIB_libgmp
	select FREETZ_LIB_libmpfr
	bool "GNU MPC Library (libmpc.so)"
	default n
	help
		MPC is a C library for the arithmetic of complex numbers with
		arbitrarily high precision and correct rounding of the result. It is
		built upon and follows the same principles as MPFR.
```

## make/libs/mpfr/Config.in
```kconfig
config FREETZ_LIB_libmpfr
	select FREETZ_LIB_libgmp
	bool "GNU MPFR Library (libmpfr.so)"
	default n
	help
		MPFR provides a library for multiple-precision floating-point
		computation with correct rounding. The computation is both
		efficient and has a well-defined semantics. It copies the good
		ideas from the ANSI/IEEE-754 standard for double-precision
		floating-point arithmetic (53-bit mantissa).
```

## make/libs/ncurses/Config.in
```kconfig
config FREETZ_LIB_libncurses
	bool "ncurses (libncurses.so)"
	select FREETZ_SHARE_terminfo
	default n
	help
		ncurses is a programming library providing an API, allowing the
		programmer to write text user interfaces in a terminal-independent
		manner. It also optimizes screen changes, in order to reduce the
		latency experienced when using remote shells.

		Ncurses stands for "new curses", and is a replacement for the
		discontinued 4.4 BSD classic curses.

source make/libs/ncurses/ncurses-Config.in

config FREETZ_LIB_libform
	bool "libform (libform.so)"
	default n
	select FREETZ_LIB_libncurses
	help
		The form library is a curses extension that supports easy programming of
		on-screen forms for data entry and program control.

config FREETZ_LIB_libmenu
	bool "libmenu (libmenu.so)"
	default n
	select FREETZ_LIB_libncurses
	help
		The menu library is a curses extension that supports easy programming of
		menu hierarchies with a uniform but flexible interface.

config FREETZ_LIB_libpanel
	bool "libpanel (libpanel.so)"
	default n
	select FREETZ_LIB_libncurses
	help
		The ncurses library by itself provides good support for screen displays
		in which the windows are tiled (non-overlapping).
		When your interface design is such that windows may dive deeper into
		the visibility stack or pop to the top at runtime, the resulting book-
		keeping can be tedious and difficult to get right. Hence the panels
		library.

config FREETZ_LIB_libncurses_terminfo_dir
	string "terminfo database location"
	default "/usr/share/terminfo"
	depends on FREETZ_SHARE_terminfo
	help
		Here you may relocate the terminfo database created, if you don't use
		an "original" Freetz image.

config FREETZ_LIB_libncurses_tabset_dir
	string "tabset definitions location"
	default "/usr/share/tabset"
	depends on FREETZ_SHARE_terminfo
	help
		Here you may relocate the tabset definitions created, if you don't use
		an "original" Freetz image.
```

## make/libs/ncursesw/Config.in
```kconfig
config FREETZ_LIB_libncursesw
	bool "ncursesw (libncursesw.so)"
	select FREETZ_SHARE_terminfo
	default n
	help
		ncurses is a programming library providing an API, allowing the
		programmer to write text user interfaces in a terminal-independent
		manner. It also optimizes screen changes, in order to reduce the
		latency experienced when using remote shells.

		Ncurses stands for "new curses", and is a replacement for the
		discontinued 4.4 BSD classic curses.
		
		Ncursesw has additional wide-character (unicode) support.
		Ncurses and Ncursesw libraries are source-compatible, but
		not binary-compatible. 

if FREETZ_LIB_libncursesw

config FREETZ_LIB_libformw
	bool "libformw (libformw.so)"
	default n
	help
		The form library is a curses extension that supports easy programming of
		on-screen forms for data entry and program control.

config FREETZ_LIB_libmenuw
	bool "libmenuw (libmenuw.so)"
	default n
	help
		The menu library is a curses extension that supports easy programming of
		menu hierarchies with a uniform but flexible interface.

config FREETZ_LIB_libpanelw
	bool "libpanelw (libpanelw.so)"
	default n
	help
		The ncurses library by itself provides good support for screen displays
		in which the windows are tiled (non-overlapping).
		When your interface design is such that windows may dive deeper into
		the visibility stack or pop to the top at runtime, the resulting book-
		keeping can be tedious and difficult to get right. Hence the panels
		library.

endif # FREETZ_LIB_libncursesw
```

## make/libs/neon/Config.in
```kconfig
config FREETZ_LIB_libneon
	bool "libneon (libneon.so)"
	select FREETZ_LIB_libexpat
	default n
	help
		neon is an HTTP and WebDAV client library, with a C language API.

config FREETZ_LIB_libneon_WITH_SSL
	bool "build with SSL support" if FREETZ_LIB_libneon
	select FREETZ_LIB_libcrypto
	select FREETZ_LIB_libssl
	default n
	help
		This option enables SSL support for neon.

config FREETZ_LIB_libneon_WITH_ZLIB
	bool "build with zlib support" if FREETZ_LIB_libneon
	select FREETZ_LIB_libz
	default n
	help
		This option enables zlib support for neon.
```

## make/libs/nettle/Config.in
```kconfig
config FREETZ_LIB_libnettle
	bool "libnettle (libnettle.so)"
	default n
	help
		A low level cryptographic library (symmetric and one-way cryptos)

config FREETZ_LIB_libhogweed
	bool "libhogweed (libhogweed.so)"
	default n
	select FREETZ_LIB_libgmp
	select FREETZ_LIB_libnettle
	help
		A low level cryptographic library (public-key cryptos)
```

## make/libs/openjpeg/Config.in
```kconfig
config FREETZ_LIB_libopenjpeg
	bool "libopenjpeg (libopenjpeg.so)"
	select FREETZ_LIB_libm if FREETZ_TARGET_UCLIBC_HAS_multiple_libs
	default n
	help
		JPEG 2000 image compression/decompression library
```

## make/libs/openobex/Config.in
```kconfig
config FREETZ_LIB_libopenobex
	bool "libopenobex (libopenobex.so)"
	select FREETZ_LIB_libbluetooth
	default n
	help
		The overall goal of this project is to make an open source
		implementation of the Object Exchange (OBEX) protocol.
```

## make/libs/openssl/Config.in
```kconfig
config FREETZ_LIB_libcrypto
	bool "OpenSSL cryptographic library (libcrypto.so)"
	select FREETZ_LIB_libssl if FREETZ_REPLACE_SSL_LIBS
	default n
	help
		crypto - OpenSSL cryptographic library

		The OpenSSL crypto library implements a wide range of cryptographic
		algorithms used in various Internet standards. The services provided by
		this library are used by the OpenSSL implementations of SSL, TLS and
		S/MIME, and they have also been used to implement SSH, OpenPGP, and
		other cryptographic standards.

		libcrypto consists of a number of sub-libraries that implement the
		individual algorithms. The functionality includes symmetric encryption,
		public key cryptography and key agreement, certificate handling,
		cryptographic hash functions and a cryptographic pseudo-random number
		generator.

config FREETZ_LIB_libssl
	bool "OpenSSL SSL/TLS library (libssl.so)"
	depends on FREETZ_LIB_libcrypto
	default n
	help
		SSL - OpenSSL SSL/TLS library

		The OpenSSL ssl library implements the Secure Sockets Layer (SSL v2/v3)
		and Transport Layer Security (TLS v1) protocols. It provides a rich API.

		In Freetz, e.g. Tor, sTunnel and OpenVPN depend on libssl.
```

## make/libs/pcre/Config.in
```kconfig
config FREETZ_LIB_libpcre
	bool "libpcre (libpcre.so)"
	default n
	help
		A Perl Compatible Regular Expression library

config FREETZ_LIB_libpcreposix
	bool "libpcreposix (libpcreposix.so)"
	select FREETZ_LIB_libpcre
	default n
	help
		A POSIX wrapper interface to the Perl Compatible Regular Expression
		library
```
