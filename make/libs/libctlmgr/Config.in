## make/libs/libctlmgr/Config.in
```kconfig
config FREETZ_LIB_libctlmgr
	bool "libctlmgr (libctlmgr.so)"
	depends on FREETZ_HAS_AVM_USB_HOST
	default n
	help
		This is Freetz compatibility library which overwrites functions of AVM's
		libraries, e.g. write_etc_passwd.
```

## make/libs/libdaemon/Config.in
```kconfig
config FREETZ_LIB_libdaemon
	bool "libdaemon (libdaemon.so)"
	default n
	help
		Libdaemon is a lightweight C library that eases the writing of UNIX daemons.
```

## make/libs/libdvbcsa/Config.in
```kconfig
config FREETZ_LIB_libdvbcsa
	bool "libdvbcsa (libdvbcsa.so)"
	default n
	help
		libdvbcsa is a free implementation of the
		DVB Common Scrambling Algorithm (DVB/CSA)
		with encryption and decryption capabilities.
```

## make/libs/libelf/Config.in
```kconfig
config FREETZ_LIB_libelf
	bool "libelf (libelf.so)"
	default n
	help
		libelf - ELF object file access library
```

## make/libs/libevent/Config.in
```kconfig
config FREETZ_LIB_libevent
	bool "libevent (libevent.so)"
	default n
	select FREETZ_LIB_libpthread
	help
		libevent is an asynchronous event notification software library.

		The libevent API provides a mechanism to execute a callback function
		when a specific event occurs on a file descriptor or after a timeout
		has been reached. Furthermore, libevent also support callbacks due to
		signals or regular timeouts.

		libevent is meant to replace the event loop found in event-driven
		network servers. An application just needs to call event_dispatch() and
		then add or remove events dynamically without having to change the event
		loop.
```

## make/libs/libexif/Config.in
```kconfig
config FREETZ_LIB_libexif
	bool "EXIF library (libexif.so)"
	select FREETZ_LIB_libm if FREETZ_TARGET_UCLIBC_HAS_multiple_libs
	default n
	help
		libexif is a library for parsing, editing, and saving EXIF data.
```

## make/libs/libfakefile/Config.in
```kconfig
config FREETZ_LIB_libfakefile
	bool "libfakefile (libfakefile.so)"
	default n
	help
		A library which can be used to fake the content of text files.
```

## make/libs/libffi/Config.in
```kconfig
config FREETZ_LIB_libffi
	bool "libffi (libffi.so)"
	help
		libffi is a library that really only provides the lowest, machine
		dependent layer of a fully featured foreign function interface. A layer
		must exist above libffi that handles type conversions for values passed
		between the two languages. ffi stands for Foreign Function Interface.
		A foreign function interface is the popular name for the interface that
		allows code written in one language to call code written in another
		language.
```

## make/libs/libfreetz/Config.in
```kconfig
config FREETZ_LIB_libfreetz
	bool "libfreetz (libfreetz.so)"
	depends on FREETZ_HAS_AVM_USB_HOST && ! FREETZ_TYPE_LABOR_PREVIEW
	default n
	help
		This is Freetz compatibility library which overwrites functions of AVM's
		libraries, e.g. write_etc_passwd.
```

## make/libs/libftdi/Config.in
```kconfig
config FREETZ_LIB_libftdi
	bool "libftdi (libftdi.so)"
	select FREETZ_LIB_libusb_0
	default n
	help
		A library (using libusb) to talk to FTDI's FT232BM/245BM, FT2232C/D and
		FT232/245R type chips including the popular bitbang mode.
```

## make/libs/libgcc_s/Config.in
```kconfig
config FREETZ_LIB_libgcc_s
	bool "GCC low-level runtime library (libgcc_s.so)"
	default n
	help
		GCC low-level runtime library

		GCC provides a low-level runtime library, `libgcc.a' or `libgcc_s.so.1'
		on some platforms. GCC generates calls to routines in this library
		automatically, whenever it needs to perform some operation that is too
		complicated to emit inline code for.

		Most of the routines in libgcc handle arithmetic operations that the
		target processor cannot perform directly. This includes integer multiply
		and divide on some machines, and all floating-point operations on other
		machines. libgcc also includes routines for exception handling, and a
		handful of miscellaneous operations.
```

## make/libs/libgpg-error/Config.in
```kconfig
config FREETZ_LIB_libgpg_error
	bool "GnuPG error library (libgpg-error.so)"
	default n
	help
		Libgpg-error is a small library that defines common error values for all
		GnuPG components. Among these are GPG, GPGSM, GPGME, GPG-Agent,
		libgcrypt, Libksba, DirMngr, Pinentry, SmartCard Daemon and possibly
		more in the future.
```

## make/libs/libgsm/Config.in
```kconfig
config FREETZ_LIB_libgsm
	bool "libgsm (libgsm.so)"
	default n
	help
		This package contains runtime shared libraries for libgsm, an
		implementation of the European GSM 06.10 provisional standard for
		full-rate speech transcoding, prI-ETS 300 036, which uses RPE/LTP
		(residual pulse excitation/long term prediction) coding at 13 kbit/s.
```

## make/libs/libid3tag/Config.in
```kconfig
config FREETZ_LIB_libid3tag
	bool "libid3tag (libid3tag.so)"
	select FREETZ_LIB_libz
	default n
	help
		ID3 tag manipulation library
```

## make/libs/libmad/Config.in
```kconfig
config FREETZ_LIB_libmad
	bool "libmad (libmad.so)"
	default n
	help
		MAD is a high-quality MPEG audio decoder. It currently supports MPEG-1
		and the MPEG-2 extension to Lower Sampling Frequencies, as well as the
		so-called MPEG 2.5 format. All three audio layers (Layer I, Layer II,
		and Layer III a.k.a. MP3) are fully implemented.
```

## make/libs/libmultid/Config.in
```kconfig
config FREETZ_LIB_libmultid
	bool "libmultid (libmultid.so)"
	default n
	help
		If this library is preloaded to multid,
		some portbindings will be remapped.

choice
	prompt "Listen on"
		depends on FREETZ_LIB_libmultid
		default FREETZ_LIB_libmultid_WITH_ANYIP

	config FREETZ_LIB_libmultid_WITH_ANYIP
		bool "any ip"
		help
			Remapped ports listen on any ip.
			This is multid's default.

	config FREETZ_LIB_libmultid_WITH_LOCAL
		bool "localhost"
		depends on ! \
		( \
			FREETZ_TYPE_LANG_DE && ( \
				FREETZ_TYPE_WLAN_3270 || \
				FREETZ_TYPE_WLAN_3270_V3 || \
				FREETZ_TYPE_FON_WLAN_7240 || \
				FREETZ_TYPE_FON_WLAN_7270_16 || \
				FREETZ_TYPE_FON_WLAN_7320 || \
				FREETZ_TYPE_FON_WLAN_7330 || \
				FREETZ_TYPE_FON_WLAN_7360 || \
				FREETZ_TYPE_FON_WLAN_7390 \
			) || \
			!FREETZ_TYPE_LANG_DE && ( \
				FREETZ_TYPE_FON_WLAN_7340 || \
				FREETZ_TYPE_FON_WLAN_7360_XL || \
				FREETZ_TYPE_FON_WLAN_7390 \
			) \
		)
		help
			Remapped ports listen on localhost.
			This could be more secure.

endchoice # "Listen on" #

config FREETZ_LIB_libmultid_WITH_DNS
	bool "Disable DNS"
	depends on FREETZ_LIB_libmultid && FREETZ_AVMDAEMON_DISABLE_DNS
	default n
	help
		Remapps port 53.

config FREETZ_LIB_libmultid_WITH_DHCP
	bool "Disable DHCP"
	depends on FREETZ_LIB_libmultid && FREETZ_AVMDAEMON_DISABLE_DHCP
	default n
	help
		Remapps port 67.

config FREETZ_LIB_libmultid_WITH_LLMNR
	bool "Disable LLMNR"
	depends on FREETZ_LIB_libmultid && FREETZ_AVMDAEMON_DISABLE_LLMNR
	default n
	help
		Remapps port 5353 and 5355.
```

## make/libs/libnet/Config.in
```kconfig
config FREETZ_LIB_libnet
	bool "libnet (libnet.so)"
	default n
	help
		A C library for portable packet creation and injection.
		Libnet is an API to help with the construction and handling of network
		packets.  It provides a portable framework for low-level network
		packet writing and handling (use libnet in conjunction with libpcap and
		you can write some really cool stuff).  Libnet includes packet creation
		at the IP layer and at the link layer as well as a host of supplementary
		and complementary functionality.  Libnet is very handy with which to
		write network tools and network test code.  See the manpage and sample
		test code for more detailed information.
		http://github.com/sam-github/libnet
		Contact Sam Roberts <vieuxtech@gmail.com> if you have patches or have
		found bugs.
```

## make/libs/libogg/Config.in
```kconfig
config FREETZ_LIB_libogg
	bool "libogg (libogg.so)"
	default n
	help
		Libogg is a library for manipulating ogg bitstreams. It handles both
		making ogg bitstreams and getting packets from ogg bitstreams.
```

## make/libs/libonig/Config.in
```kconfig
config FREETZ_LIB_libonig
	bool "Oniguruma (libonig.so)"
	default n
	help
		Oniguruma is a modern and flexible regular expressions library.
		It encompasses features from different regular expression
		implementations that traditionally exist in different languages.
		It comes close to being a complete superset of all regular
		expression features found in other regular expression
		implementations.
```

## make/libs/liboping/Config.in
```kconfig
config FREETZ_LIB_liboping
	bool "liboping (liboping.so)"
	default n
	help
		A simple library for creating ICMP echo (ping) packets.
```

## make/libs/libosip2/Config.in
```kconfig
config FREETZ_LIB_libosip2
	bool "libosip2 (libosip2.so)"
	select FREETZ_LIB_libosipparser2
	default n
	help
		GNU oSIP library, a Session Initiation Protocol (SIP) implementation.

config FREETZ_LIB_libosipparser2
	bool "libosipparser2 (libosipparser2.so)"
	default n
	help
		GNU oSIP library, a Session Initiation Protocol (SIP) implementation.
```

## make/libs/libpcap/Config.in
```kconfig
config FREETZ_LIB_libpcap
	bool "libpcap (libpcap.so)"
	default n
	help
		libpcap is a system-independent interface for user-level packet capture.
		libpcap provides a portable framework for low-level network monitoring.
		Applications include network statistics collection, security monitoring,
		network debugging, etc.
```

## make/libs/libpng/Config.in
```kconfig
config FREETZ_LIB_libpng12
	bool "PNG library (libpng.so)"
	select FREETZ_LIB_libm
	select FREETZ_LIB_libz
	default n
	help
		libpng is the official PNG reference library. It supports almost all PNG
		features, is extensible, and has been extensively tested for over 12
		years. The home site for development versions (i.e., may be buggy or
		subject to change or include experimental features) is
		http://libpng.sourceforge.net/, and the place to go for questions about
		the library is the png-mng-implement mailing list.
```

## make/libs/libsodium/Config.in
```kconfig
config FREETZ_LIB_libsodium
	bool "libsodium (libsodium.so)"
	default n
	help
		Sodium is a modern, easy-to-use software library for encryption,
		decryption, signatures, password hashing and more.
```

## make/libs/libssh2/Config.in
```kconfig
config FREETZ_LIB_libssh2
	bool "libssh2 (libssh2.so)"
	select FREETZ_LIB_libcrypto_WITH_EC  if FREETZ_LIB_libssh2_WITH_SSL && FREETZ_LIB_libssh2_WITH_OPENSSL
	select FREETZ_LIB_libcrypto          if FREETZ_LIB_libssh2_WITH_SSL && FREETZ_LIB_libssh2_WITH_OPENSSL
	select FREETZ_LIB_libmbedcrypto      if FREETZ_LIB_libssh2_WITH_SSL && FREETZ_LIB_libssh2_WITH_MBEDTLS
	select FREETZ_LIB_libz               if FREETZ_LIB_libssh2_WITH_ZLIB
	default n
	help
		libssh2 is a client-side C library implementing the SSH2 protocol.

config FREETZ_LIB_libssh2_WITH_SSL
	bool "build with SSL support" if FREETZ_LIB_libssh2
	default y                     if FREETZ_LIB_libssh2
	help
		This option enables SSL support in libssh2.

choice
	depends on FREETZ_LIB_libssh2_WITH_SSL
	prompt "SSL library"
	default FREETZ_LIB_libssh2_WITH_OPENSSL

	config FREETZ_LIB_libssh2_WITH_OPENSSL
		bool "OpenSSL"

	config FREETZ_LIB_libssh2_WITH_MBEDTLS
		bool "mbed TLS"
endchoice

config FREETZ_LIB_libssh2_WITH_ZLIB
	bool "build with zlib support" if FREETZ_LIB_libssh2
	default n
	help
		This option enables zlib support in libssh2.
```
