## make/libs/uclibc/Config.in
```kconfig
config FREETZ_LIB_ld_uClibc
	bool "ld-uClibc (ld-uClibc-x.y.z.so)"
	default n
	help
		uClibc is a small C standard library intended for embedded Linux
		systems. uClibc was created to support uClinux, a version of Linux not
		requiring a memory management unit and thus suited for microcontrollers
		(hence the "uC" in the name - "u" is a replacement for the Greek
		character "miu" often used as an abbreviation for the prefix "micro").

		uClibc is much smaller than GNU C Library (glibc), the C library
		normally used with Linux distributions. While glibc is intended to fully
		support all relevant C standards across a wide range of platforms,
		uClibc is specifically focused on embedded Linux. Features can be
		enabled or disabled according to space requirements.

config FREETZ_LIB_libcrypt
	bool "libcrypt (libcrypt-x.y.z.so)"
	depends on FREETZ_TARGET_UCLIBC_HAS_multiple_libs
	default n
	help
		uClibc is a small C standard library intended for embedded Linux
		systems. uClibc was created to support uClinux, a version of Linux not
		requiring a memory management unit and thus suited for microcontrollers
		(hence the "uC" in the name - "u" is a replacement for the Greek
		character "miu" often used as an abbreviation for the prefix "micro").

		uClibc is much smaller than GNU C Library (glibc), the C library
		normally used with Linux distributions. While glibc is intended to fully
		support all relevant C standards across a wide range of platforms,
		uClibc is specifically focused on embedded Linux. Features can be
		enabled or disabled according to space requirements.

config FREETZ_LIB_libdl
	bool "libdl (libdl-x.y.z.so)"
	depends on FREETZ_TARGET_UCLIBC_HAS_multiple_libs
	default n
	help
		uClibc is a small C standard library intended for embedded Linux
		systems. uClibc was created to support uClinux, a version of Linux not
		requiring a memory management unit and thus suited for microcontrollers
		(hence the "uC" in the name - "u" is a replacement for the Greek
		character "miu" often used as an abbreviation for the prefix "micro").

		uClibc is much smaller than GNU C Library (glibc), the C library
		normally used with Linux distributions. While glibc is intended to fully
		support all relevant C standards across a wide range of platforms,
		uClibc is specifically focused on embedded Linux. Features can be
		enabled or disabled according to space requirements.

config FREETZ_LIB_libm
	bool "libm (libm-x.y.z.so)"
	depends on FREETZ_TARGET_UCLIBC_HAS_multiple_libs
	default n
	help
		uClibc is a small C standard library intended for embedded Linux
		systems. uClibc was created to support uClinux, a version of Linux not
		requiring a memory management unit and thus suited for microcontrollers
		(hence the "uC" in the name - "u" is a replacement for the Greek
		character "miu" often used as an abbreviation for the prefix "micro").

		uClibc is much smaller than GNU C Library (glibc), the C library
		normally used with Linux distributions. While glibc is intended to fully
		support all relevant C standards across a wide range of platforms,
		uClibc is specifically focused on embedded Linux. Features can be
		enabled or disabled according to space requirements.

config FREETZ_LIB_libpthread
	bool "libpthread (libpthread-x.y.z.so)"
	depends on FREETZ_TARGET_UCLIBC_HAS_multiple_libs
	default n
	help
		uClibc is a small C standard library intended for embedded Linux
		systems. uClibc was created to support uClinux, a version of Linux not
		requiring a memory management unit and thus suited for microcontrollers
		(hence the "uC" in the name - "u" is a replacement for the Greek
		character "miu" often used as an abbreviation for the prefix "micro").

		uClibc is much smaller than GNU C Library (glibc), the C library
		normally used with Linux distributions. While glibc is intended to fully
		support all relevant C standards across a wide range of platforms,
		uClibc is specifically focused on embedded Linux. Features can be
		enabled or disabled according to space requirements.

config FREETZ_LIB_librt
	bool "librt (librt-x.y.z.so)"
	depends on FREETZ_TARGET_UCLIBC_HAS_multiple_libs
	default n
	help
		uClibc is a small C standard library intended for embedded Linux
		systems. uClibc was created to support uClinux, a version of Linux not
		requiring a memory management unit and thus suited for microcontrollers
		(hence the "uC" in the name - "u" is a replacement for the Greek
		character "miu" often used as an abbreviation for the prefix "micro").

		uClibc is much smaller than GNU C Library (glibc), the C library
		normally used with Linux distributions. While glibc is intended to fully
		support all relevant C standards across a wide range of platforms,
		uClibc is specifically focused on embedded Linux. Features can be
		enabled or disabled according to space requirements.

config FREETZ_LIB_libthread_db
	bool "libthread_db (libthread_db-x.y.z.so)"
	default n
	help
		uClibc is a small C standard library intended for embedded Linux
		systems. uClibc was created to support uClinux, a version of Linux not
		requiring a memory management unit and thus suited for microcontrollers
		(hence the "uC" in the name - "u" is a replacement for the Greek
		character "miu" often used as an abbreviation for the prefix "micro").

		uClibc is much smaller than GNU C Library (glibc), the C library
		normally used with Linux distributions. While glibc is intended to fully
		support all relevant C standards across a wide range of platforms,
		uClibc is specifically focused on embedded Linux. Features can be
		enabled or disabled according to space requirements.

config FREETZ_LIB_libubacktrace
	bool "libubacktrace (libubacktrace-x.y.z.so)"
	depends on FREETZ_TARGET_UCLIBC_HAS_multiple_libs && FREETZ_TARGET_UCLIBC_SUPPORTS_libubacktrace
	default n
	help
		uClibc is a small C standard library intended for embedded Linux
		systems. uClibc was created to support uClinux, a version of Linux not
		requiring a memory management unit and thus suited for microcontrollers
		(hence the "uC" in the name - "u" is a replacement for the Greek
		character "miu" often used as an abbreviation for the prefix "micro").

		uClibc is much smaller than GNU C Library (glibc), the C library
		normally used with Linux distributions. While glibc is intended to fully
		support all relevant C standards across a wide range of platforms,
		uClibc is specifically focused on embedded Linux. Features can be
		enabled or disabled according to space requirements.

config FREETZ_LIB_libuClibc
	bool "libuClibc (libuClibc-x.y.z.so)"
	default n
	help
		uClibc is a small C standard library intended for embedded Linux
		systems. uClibc was created to support uClinux, a version of Linux not
		requiring a memory management unit and thus suited for microcontrollers
		(hence the "uC" in the name - "u" is a replacement for the Greek
		character "miu" often used as an abbreviation for the prefix "micro").

		uClibc is much smaller than GNU C Library (glibc), the C library
		normally used with Linux distributions. While glibc is intended to fully
		support all relevant C standards across a wide range of platforms,
		uClibc is specifically focused on embedded Linux. Features can be
		enabled or disabled according to space requirements.

config FREETZ_LIB_libutil
	bool "libutil (libutil-x.y.z.so)"
	depends on FREETZ_TARGET_UCLIBC_HAS_multiple_libs
	default n
	help
		uClibc is a small C standard library intended for embedded Linux
		systems. uClibc was created to support uClinux, a version of Linux not
		requiring a memory management unit and thus suited for microcontrollers
		(hence the "uC" in the name - "u" is a replacement for the Greek
		character "miu" often used as an abbreviation for the prefix "micro").

		uClibc is much smaller than GNU C Library (glibc), the C library
		normally used with Linux distributions. While glibc is intended to fully
		support all relevant C standards across a wide range of platforms,
		uClibc is specifically focused on embedded Linux. Features can be
		enabled or disabled according to space requirements.
```

## make/libs/uclibcxx/Config.in
```kconfig
config FREETZ_LIB_libuClibc__
	bool "uClibc++ (libuClibc++.so.0.2.5)"
	default n
	help
		An implementation of the Standard C++ Library optimized for embedded systems.

config FREETZ_LIB_libuClibc__WITH_WCHAR
	bool "enable wchar support" if FREETZ_LIB_libuClibc__
	default n
	help
		Enables wchar-support in uClibc++.
```

## make/libs/utf8proc/Config.in
```kconfig
config FREETZ_LIB_libutf8proc
	bool "utf8proc (libutf8proc.so)"
	default n
	help
		a clean C library for processing UTF-8 Unicode data: normalization, case-folding, graphemes, and more
```

## make/libs/wxWidgets/Config.in
```kconfig
config FREETZ_LIB_libwx_baseu
	bool "wxWidgets base (libwx_baseu.so)"
	select FREETZ_LIB_libm
	select FREETZ_LIB_STDCXXLIB
	select FREETZ_LIB_STDCXXLIB_WITH_WCHAR
	default n
```

## make/libs/yaml/Config.in
```kconfig
config FREETZ_LIB_libyaml
	bool "libyaml (libyaml.so)"
	default n
	help
		LibYAML is a YAML 1.1 configuration file parser and
		emitter.
```

## make/libs/zlib/Config.in
```kconfig
config FREETZ_LIB_libz
	bool "Zlib (libz.so)"
	default n
	help
		zlib is a lossless data-compression library for use on virtually any
		computer hardware and operating system. The zlib data format is itself
		portable across platforms.
```
