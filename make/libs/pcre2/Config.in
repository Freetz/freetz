## make/libs/pcre2/Config.in
```kconfig
config FREETZ_LIB_libpcre2
	bool "libpcre2 (libpcre2-8.so)"
	default n
	help
		A Perl Compatible Regular Expression library

config FREETZ_LIB_libpcre2_posix
	bool "libpcre2-posix (libpcre2-posix.so)"
	select FREETZ_LIB_libpcre2
	default n
	help
		A POSIX wrapper interface to the Perl Compatible Regular Expression
		library
```

## make/libs/pjproject2/Config.in
```kconfig
config FREETZ_PJPROJECT2
	bool

config FREETZ_LIB_libpj
	bool "libpj (libpj.so)"
	select FREETZ_PJPROJECT2
	select FREETZ_LIB_libm
	select FREETZ_LIB_libpthread
	select FREETZ_LIB_librt
	select FREETZ_LIB_libuuid if !FREETZ_PACKAGE_E2FSPROGS_STATIC
	default n

config FREETZ_LIB_libpjlib_util
	bool "libpjlib-util (libpjlib-util.so)"
	select FREETZ_PJPROJECT2
	select FREETZ_LIB_libm
	select FREETZ_LIB_libpthread
	select FREETZ_LIB_librt
	select FREETZ_LIB_libpj
	select FREETZ_LIB_libuuid if !FREETZ_PACKAGE_E2FSPROGS_STATIC
	default n

config FREETZ_LIB_libpjmedia
	bool "libpjmedia (libpjmedia.so)"
	select FREETZ_PJPROJECT2
	select FREETZ_LIB_libm
	select FREETZ_LIB_libpthread
	select FREETZ_LIB_librt
	select FREETZ_LIB_libg7221codec
	select FREETZ_LIB_libgsm
	select FREETZ_LIB_libilbccodec
	select FREETZ_LIB_libmilenage
	select FREETZ_LIB_libpjlib_util
	select FREETZ_LIB_libpjmedia_audiodev
	select FREETZ_LIB_libpjmedia_videodev
	select FREETZ_LIB_libpjnath
	select FREETZ_LIB_libpj
	select FREETZ_LIB_libspeexdsp
	select FREETZ_LIB_libspeex
	select FREETZ_LIB_libsrtp
	select FREETZ_LIB_libuuid if !FREETZ_PACKAGE_E2FSPROGS_STATIC
	default n

config FREETZ_LIB_libpjmedia_audiodev
	bool "libpjmedia-audiodev (libpjmedia-audiodev.so)"
	select FREETZ_PJPROJECT2
	select FREETZ_LIB_libm
	select FREETZ_LIB_libpthread
	select FREETZ_LIB_librt
	select FREETZ_LIB_libg7221codec
	select FREETZ_LIB_libgsm
	select FREETZ_LIB_libilbccodec
	select FREETZ_LIB_libmilenage
	select FREETZ_LIB_libpj
	select FREETZ_LIB_libspeexdsp
	select FREETZ_LIB_libspeex
	select FREETZ_LIB_libsrtp
	select FREETZ_LIB_libuuid if !FREETZ_PACKAGE_E2FSPROGS_STATIC
	default n

config FREETZ_LIB_libpjmedia_codec
	bool "libpjmedia-codec (libpjmedia-codec.so)"
	select FREETZ_PJPROJECT2
	select FREETZ_LIB_libm
	select FREETZ_LIB_libpthread
	select FREETZ_LIB_librt
	select FREETZ_LIB_libg7221codec
	select FREETZ_LIB_libgsm
	select FREETZ_LIB_libilbccodec
	select FREETZ_LIB_libmilenage
	select FREETZ_LIB_libpjmedia
	select FREETZ_LIB_libpj
	select FREETZ_LIB_libspeexdsp
	select FREETZ_LIB_libspeex
	select FREETZ_LIB_libsrtp
	select FREETZ_LIB_libuuid if !FREETZ_PACKAGE_E2FSPROGS_STATIC
	default n

config FREETZ_LIB_libpjmedia_videodev
	bool "libpjmedia-videodev (libpjmedia-videodev.so)"
	select FREETZ_PJPROJECT2
	select FREETZ_LIB_libm
	select FREETZ_LIB_libpthread
	select FREETZ_LIB_librt
	select FREETZ_LIB_libg7221codec
	select FREETZ_LIB_libgsm
	select FREETZ_LIB_libilbccodec
	select FREETZ_LIB_libmilenage
	select FREETZ_LIB_libpj
	select FREETZ_LIB_libspeexdsp
	select FREETZ_LIB_libspeex
	select FREETZ_LIB_libsrtp
	select FREETZ_LIB_libuuid if !FREETZ_PACKAGE_E2FSPROGS_STATIC
	default n

config FREETZ_LIB_libpjnath
	bool "libpjnath (libpjnath.so)"
	select FREETZ_PJPROJECT2
	select FREETZ_LIB_libm
	select FREETZ_LIB_libpthread
	select FREETZ_LIB_librt
	select FREETZ_LIB_libpjlib_util
	select FREETZ_LIB_libpj
	select FREETZ_LIB_libuuid if !FREETZ_PACKAGE_E2FSPROGS_STATIC
	default n

config FREETZ_LIB_libpjsip
	bool "libpjsip (libpjsip.so)"
	select FREETZ_PJPROJECT2
	select FREETZ_LIB_libm
	select FREETZ_LIB_libpthread
	select FREETZ_LIB_librt
	select FREETZ_LIB_libg7221codec
	select FREETZ_LIB_libgsm
	select FREETZ_LIB_libilbccodec
	select FREETZ_LIB_libmilenage
	select FREETZ_LIB_libpjlib_util
	select FREETZ_LIB_libpj
	select FREETZ_LIB_libspeexdsp
	select FREETZ_LIB_libspeex
	select FREETZ_LIB_libsrtp
	select FREETZ_LIB_libuuid if !FREETZ_PACKAGE_E2FSPROGS_STATIC
	default n

config FREETZ_LIB_libpjsip_simple
	bool "libpjsip-simple (libpjsip-simple.so)"
	select FREETZ_PJPROJECT2
	select FREETZ_LIB_libm
	select FREETZ_LIB_libpthread
	select FREETZ_LIB_librt
	select FREETZ_LIB_libg7221codec
	select FREETZ_LIB_libgsm
	select FREETZ_LIB_libilbccodec
	select FREETZ_LIB_libmilenage
	select FREETZ_LIB_libpjlib_util
	select FREETZ_LIB_libpjsip
	select FREETZ_LIB_libpj
	select FREETZ_LIB_libspeexdsp
	select FREETZ_LIB_libspeex
	select FREETZ_LIB_libsrtp
	select FREETZ_LIB_libuuid if !FREETZ_PACKAGE_E2FSPROGS_STATIC
	default n

config FREETZ_LIB_libpjsip_ua
	bool "libpjsip-ua (libpjsip-ua.so)"
	select FREETZ_PJPROJECT2
	select FREETZ_LIB_libm
	select FREETZ_LIB_libpthread
	select FREETZ_LIB_librt
	select FREETZ_LIB_libg7221codec
	select FREETZ_LIB_libgsm
	select FREETZ_LIB_libilbccodec
	select FREETZ_LIB_libmilenage
	select FREETZ_LIB_libpjlib_util
	select FREETZ_LIB_libpjmedia
	select FREETZ_LIB_libpjsip_simple
	select FREETZ_LIB_libpjsip
	select FREETZ_LIB_libpj
	select FREETZ_LIB_libspeexdsp
	select FREETZ_LIB_libspeex
	select FREETZ_LIB_libsrtp
	select FREETZ_LIB_libuuid if !FREETZ_PACKAGE_E2FSPROGS_STATIC
	default n

config FREETZ_LIB_libpjsua
	bool "libpjsua (libpjsua.so)"
	select FREETZ_PJPROJECT2
	select FREETZ_LIB_libm
	select FREETZ_LIB_libpthread
	select FREETZ_LIB_librt
	select FREETZ_LIB_libg7221codec
	select FREETZ_LIB_libgsm
	select FREETZ_LIB_libilbccodec
	select FREETZ_LIB_libmilenage
	select FREETZ_LIB_libpjlib_util
	select FREETZ_LIB_libpjmedia_audiodev
	select FREETZ_LIB_libpjmedia_codec
	select FREETZ_LIB_libpjmedia
	select FREETZ_LIB_libpjmedia_videodev
	select FREETZ_LIB_libpjnath
	select FREETZ_LIB_libpjsip_simple
	select FREETZ_LIB_libpjsip
	select FREETZ_LIB_libpjsip_ua
	select FREETZ_LIB_libpj
	select FREETZ_LIB_libspeexdsp
	select FREETZ_LIB_libspeex
	select FREETZ_LIB_libsrtp
	select FREETZ_LIB_libuuid if !FREETZ_PACKAGE_E2FSPROGS_STATIC
	default n

comment "3rdparty libraries"

config FREETZ_LIB_libg7221codec
	bool "libg7221codec (libg7221codec.so)"
	select FREETZ_PJPROJECT2
	default n

config FREETZ_LIB_libilbccodec
	bool "libilbccodec (libilbccodec.so)"
	select FREETZ_PJPROJECT2
	default n

config FREETZ_LIB_libmilenage
	bool "libmilenage (libmilenage.so)"
	select FREETZ_PJPROJECT2
	default n
```

## make/libs/polarssl12/Config.in
```kconfig
config FREETZ_LIB_libpolarssl12
	bool "PolarSSL-1.2.x (libpolarssl12.so)"
	default n
	help
		The aim of the PolarSSL project is to provide a quality, open-source
		cryptographic library written in C and targeted at embedded systems.
		See https://polarssl.org for more details.

config FREETZ_LIB_libpolarssl12_WITH_BLOWFISH
	bool "With Blowfish cipher" if FREETZ_LIB_libpolarssl12
	default n
	help
		Enables support for the Blowfish block cipher.

config FREETZ_LIB_libpolarssl12_WITH_GENRSA
	bool "With RSA prime-number generation" if FREETZ_LIB_libpolarssl12
	default n
	help
		Enables the RSA prime-number generation code.
		Used e.g. for generating private keys in xrelayd.
```

## make/libs/polarssl13/Config.in
```kconfig
config FREETZ_LIB_libpolarssl13
	bool "PolarSSL-1.3.x (libpolarssl13.so)"
	default n
	help
		The aim of the PolarSSL project is to provide a quality, open-source
		cryptographic library written in C and targeted at embedded systems.
		See https://polarssl.org for more details.

config FREETZ_LIB_libpolarssl13_WITH_BLOWFISH
	bool "With Blowfish cipher" if FREETZ_LIB_libpolarssl13
	default n
	help
		Enables support for the Blowfish block cipher.

config FREETZ_LIB_libpolarssl13_WITH_GENRSA
	bool "With RSA prime-number generation" if FREETZ_LIB_libpolarssl13
	default n
	help
		Enables the RSA prime-number generation code.
```

## make/libs/popt/Config.in
```kconfig
config FREETZ_LIB_libpopt
	bool "libpopt (libpopt.so)"
	default n
	help
		The popt library exists essentially for parsing command line options.
```

## make/libs/protobuf-c/Config.in
```kconfig
config FREETZ_LIB_libprotobuf_c
	bool "libprotobuf-c (libprotobuf-c.so)"
	default n
	help
		Library providing a flexible, efficient, automated
		mechanism for serializing structured data.
```

## make/libs/readline/Config.in
```kconfig
config FREETZ_LIB_libreadline
	bool "libreadline.so"
	select FREETZ_LIB_libncurses
	default n
	help
		The Readline library provides a set of functions for use by applications
		that allow users to edit command lines as they are typed in. Both Emacs
		and vi editing modes are available. The Readline library includes
		additional functions to maintain a list of previously-entered command
		lines, to recall and perhaps reedit those lines, and perform csh-like
		history expansion on previous commands.

config FREETZ_LIB_libhistory
	bool "libhistory.so"
	default n
	select FREETZ_LIB_libreadline
	help
		The Readline library provides a set of functions for use by applications
		that allow users to edit command lines as they are typed in. Both Emacs
		and vi editing modes are available. The Readline library includes
		additional functions to maintain a list of previously-entered command
		lines, to recall and perhaps reedit those lines, and perform csh-like
		history expansion on previous commands.
```

## make/libs/serf/Config.in
```kconfig
config FREETZ_LIB_libserf
	bool "libserf (libserf.so)"
	select FREETZ_LIB_libapr
	select FREETZ_LIB_libaprutil
	select FREETZ_LIB_libcrypto
	select FREETZ_LIB_libssl
	select FREETZ_LIB_libz
	default n
	help
		High-performance asynchronous HTTP client library
```

## make/libs/spandsp/Config.in
```kconfig
config FREETZ_LIB_libspandsp
	bool "libspandsp (libspandsp.so)"
	default n
	select FREETZ_LIB_libm if FREETZ_TARGET_UCLIBC_HAS_multiple_libs
	select FREETZ_LIB_libtiff
	help
		SpanDSP is a library of DSP functions for telephony, in the 8000 sample per
		second world of E1s, T1s, and higher order PCM channels. It contains low level
		functions, such as basic filters. It also contains higher level functions, such
		as cadenced supervisory tone detection, and a complete software FAX machine.
```

## make/libs/speex/Config.in
```kconfig
config FREETZ_LIB_libspeex
	bool "libspeex (libspeex.so)"
	select FREETZ_LIB_libm if FREETZ_TARGET_UCLIBC_HAS_multiple_libs
	default n
	help
		Speex is an Open Source/Free Software patent-free audio compression format
		designed for speech. This package contains the shared codec library.

config FREETZ_LIB_libspeexdsp
	bool "libspeexdsp (libspeexdsp.so)"
	select FREETZ_LIB_libm if FREETZ_TARGET_UCLIBC_HAS_multiple_libs
	default n
	help
		Speex is an Open Source/Free Software patent-free audio compression format
		designed for speech. This package contains the shared dsp library.
```

## make/libs/srtp/Config.in
```kconfig
config FREETZ_LIB_libsrtp
	bool "libsrtp (libsrtp.so)"
	default n
	help
		SRTP is a security profile for RTP that adds confidentiality, message authentication,
		and replay protection to that protocol. It is specified in RFC 3711.
		LibSRTP provides an implementation of the Secure Real-Time Transport Protocol (SRTP),
		the Universal Security Transform (UST), and a supporting cryptographic kernel.
```

## make/libs/sysfsutils/Config.in
```kconfig
config FREETZ_LIB_libsysfs
	bool "libsysfs (libsysfs.so)"
	default n
	help
		The library's purpose is to provide a consistant and stable interface
		for querying system device information exposed through sysfs.
```

## make/libs/taglib/Config.in
```kconfig
config FREETZ_LIB_libtag
	bool "taglib (libtag.so)"
	select FREETZ_LIB_STDCXXLIB
	select FREETZ_LIB_STDCXXLIB_WITH_WCHAR
	select FREETZ_LIB_libm
	select FREETZ_LIB_libz
	default n
	help
		TagLib is a library for reading and editing the meta-data of several
		popular audio formats. Currently it supports both ID3v1 and ID3v2
		for MP3 files, Ogg Vorbis comments and ID3 tags and Vorbis comments
		in FLAC, MPC, Speex, WavPack TrueAudio, WAV, AIFF, MP4 and ASF files.
```

## make/libs/tiff/Config.in
```kconfig
config FREETZ_LIB_libtiff
	bool "TIFF library (libtiff.so)"
	select FREETZ_LIB_libz
	select FREETZ_LIB_libjpeg
	default n
	help
		libtiff is a library for handling the TIFF image format
```
