## make/lighttpd/Config.in
```kconfig
config FREETZ_PACKAGE_LIGHTTPD
	bool "lighttpd 1.4.54"
	select FREETZ_LIB_libpthread
	select FREETZ_LIB_libpcre
	select FREETZ_PACKAGE_LIGHTTPD_MOD_ACCESS
	select FREETZ_PACKAGE_LIGHTTPD_MOD_INDEXFILE
	select FREETZ_PACKAGE_LIGHTTPD_MOD_STATICFILE
	select FREETZ_PACKAGE_LIGHTTPD_MOD_DIRLISTING
	select FREETZ_BUSYBOX_MD5SUM
	default n
	help
		Security, speed, compliance, and flexibility -- all of these describe lighttpd
		(pron. lighty) which is rapidly redefining efficiency of a webserver; as it is
		designed and optimized for high performance environments. With a small memory
		footprint compared to other web-servers, effective management of the cpu-load,
		and advanced feature set (FastCGI, SCGI, Auth, Output-Compression,
		URL-Rewriting and many more) lighttpd is the perfect solution for every server
		that is suffering load problems.
		In case you want to configure virtual hosts, you may want to
		consider the package onlinechanged-cgi which allows you to
		configure multiple DynDNS entries for your box.

config FREETZ_PACKAGE_LIGHTTPD_WITH_SSL
	bool "build with SSL support"
	depends on FREETZ_PACKAGE_LIGHTTPD
	select FREETZ_PACKAGE_LIGHTTPD_MOD_OPENSSL
	default n
	help
		This option enables SSL support for lighttpd.

config FREETZ_PACKAGE_LIGHTTPD_ACME
	bool "Select ACME.sh (letsencrypt)"
	depends on FREETZ_PACKAGE_LIGHTTPD_WITH_SSL
	select FREETZ_PACKAGE_ACME
	default n
	help
		This selects ACME.sh package for Let's Encrypt certificates.

config FREETZ_PACKAGE_LIGHTTPD_DEHYDRATED
	bool "Select dehydrated (letsencrypt)"
	depends on FREETZ_PACKAGE_LIGHTTPD_WITH_SSL
	select FREETZ_PACKAGE_DEHYDRATED
	default n
	help
		This selects dehydrated package for Let's Encrypt certificates.

config FREETZ_PACKAGE_LIGHTTPD_LDD
	bool "Include LDD support"
	depends on FREETZ_PACKAGE_LIGHTTPD
	select FREETZ_PACKAGE_LDD
	default n
	help
		This option includes the /usr/bin/ldd application which is used
		to automatically copy php-cgi and all libraries it depends on
		into the chroot in case a chroot is configured for with the
		lighttpd frontend and php-cgi is configured to be used.

config FREETZ_PACKAGE_LIGHTTPD_WITH_LUA
	bool "build with LUA support"
	depends on FREETZ_PACKAGE_LIGHTTPD
	select FREETZ_LIB_liblua
	default n
	help
		This option enables LUA support for lighttpd.
		mod_cml and mod_magnet modules depend on it.

menu "lighttpd Modules"
depends on FREETZ_PACKAGE_LIGHTTPD

comment "Select the modules you want to be included in the image"
	depends on FREETZ_PACKAGE_LIGHTTPD

config FREETZ_PACKAGE_LIGHTTPD_MOD_ACCESS
	bool "include mod_access (required module)"
	depends on FREETZ_PACKAGE_LIGHTTPD
	default y
	help
		This option adds mod_access.so to the image.
		This is a required module, it cannot be deselected.
		Please see http://redmine.lighttpd.net/wiki/1/Docs:ModAccess
		for more information on this module.

config FREETZ_PACKAGE_LIGHTTPD_MOD_DIRLISTING
	bool "include mod_dirlisting (required module)"
	depends on FREETZ_PACKAGE_LIGHTTPD
	default y
	help
		This option adds mod_dirlisting.so to the image.
		Please see http://redmine.lighttpd.net/wiki/1/Docs:ModDirListing
		for more information on this module.

config FREETZ_PACKAGE_LIGHTTPD_MOD_INDEXFILE
	bool "include mod_indexfile (required module)"
	depends on FREETZ_PACKAGE_LIGHTTPD
	default y
	help
		This option adds mod_indexfile.so to the image.
		This is a required module, it cannot be deselected.
		Please see http://redmine.lighttpd.net/wiki/1/Docs:ModIndexFile
		for more information on this module.

config FREETZ_PACKAGE_LIGHTTPD_MOD_STATICFILE
	bool "include mod_staticfile (required module)"
	depends on FREETZ_PACKAGE_LIGHTTPD
	default y
	help
		This option adds mod_staticfile.so to the image.
		This is a required module, it cannot be deselected.
		Please see http://redmine.lighttpd.net/projects/1/wiki/
		for more information on this module.

config FREETZ_PACKAGE_LIGHTTPD_MOD_ACCESSLOG
	bool "include mod_accesslog (adds about 17kb)"
	depends on FREETZ_PACKAGE_LIGHTTPD
	default y
	help
		This option adds mod_accesslog.so to the image.
		Please see http://redmine.lighttpd.net/wiki/1/Docs:ModAccessLog
		for more information on this module.

config FREETZ_PACKAGE_LIGHTTPD_MOD_ALIAS
	bool "include mod_alias (adds about 8kb)"
	depends on FREETZ_PACKAGE_LIGHTTPD
	default y
	help
		This option adds mod_alias.so to the image.
		Please see http://redmine.lighttpd.net/wiki/1/Docs:ModAlias
		for more information on this module.

config FREETZ_PACKAGE_LIGHTTPD_MOD_AUTH
	bool "include mod_auth (adds about 29kb)"
	depends on FREETZ_PACKAGE_LIGHTTPD
	default y
	help
		This option adds mod_auth.so to the image.
		Please see http://redmine.lighttpd.net/wiki/1/Docs:ModAuth
		for more information on this module.

config FREETZ_PACKAGE_LIGHTTPD_MOD_AUTHN_FILE
	bool "include mod_authn_file (adds about 13kb)"
	depends on FREETZ_PACKAGE_LIGHTTPD
	default y

#requires GSS-API/Kerberos not (yet) available in freetz
#config FREETZ_PACKAGE_LIGHTTPD_MOD_AUTHN_GSSAPI
#	bool "include mod_authn_gssapi"
#	depends on FREETZ_PACKAGE_LIGHTTPD
#	default n

#requires LDAP not (yet) available in freetz
#config FREETZ_PACKAGE_LIGHTTPD_MOD_AUTHN_LDAP
#	bool "include mod_authn_ldap"
#	depends on FREETZ_PACKAGE_LIGHTTPD
#	default n

#requires mysql not (yet) available in freetz
#config FREETZ_PACKAGE_LIGHTTPD_MOD_AUTHN_MYSQL
#	bool "include mod_authn_mysql"
#	depends on FREETZ_PACKAGE_LIGHTTPD
#	default n

config FREETZ_PACKAGE_LIGHTTPD_MOD_CGI
	bool "include mod_cgi (adds about 25kb)"
	depends on FREETZ_PACKAGE_LIGHTTPD
	default y
	help
		This option adds mod_cgi.so to the image.
		Please see http://redmine.lighttpd.net/wiki/1/Docs:ModCGI
		for more information on this module.

config FREETZ_PACKAGE_LIGHTTPD_MOD_CML
	bool "include mod_cml (adds about 58kb)"
	depends on FREETZ_PACKAGE_LIGHTTPD_WITH_LUA
	default y
	help
		This option adds mod_cml.so to the image.
		Please see http://redmine.lighttpd.net/wiki/1/Docs:ModCML
		for more information on this module.

config FREETZ_PACKAGE_LIGHTTPD_MOD_COMPRESS
	bool "include mod_compress (adds about 10kb)"
	depends on FREETZ_PACKAGE_LIGHTTPD
	select FREETZ_LIB_libz
	default y
	help
		This option adds mod_compress.so to the image.
		Please see http://redmine.lighttpd.net/wiki/1/Docs:ModCompress
		for more information on this module.

config FREETZ_PACKAGE_LIGHTTPD_MOD_DEFLATE
	bool "include mod_deflate (adds about 13kb)"
	depends on FREETZ_PACKAGE_LIGHTTPD
	select FREETZ_LIB_libz
	default n
	help
		This option adds mod_deflate.so to the image.
		Please see http://redmine.lighttpd.net/wiki/1/Docs:ModDeflate
		for more information on this module.

config FREETZ_PACKAGE_LIGHTTPD_MOD_EVASIVE
	bool "include mod_evasive (adds about 7kb)"
	depends on FREETZ_PACKAGE_LIGHTTPD
	default y
	help
		This option adds mod_evasive.so to the image.
		Please see http://redmine.lighttpd.net/wiki/1/Docs:ModEvasive
		for more information on this module.

config FREETZ_PACKAGE_LIGHTTPD_MOD_EVHOST
	bool "include mod_evhost (adds about 10kb)"
	depends on FREETZ_PACKAGE_LIGHTTPD
	default y
	help
		This option adds mod_evhost.so to the image.
		Please see http://redmine.lighttpd.net/wiki/1/Docs:ModEVhost
		for more information on this module.

config FREETZ_PACKAGE_LIGHTTPD_MOD_EXPIRE
	bool "include mod_expire (adds about 11kb)"
	depends on FREETZ_PACKAGE_LIGHTTPD
	default y
	help
		This option adds mod_expire.so to the image.
		Please see http://redmine.lighttpd.net/wiki/1/Docs:ModExpire
		for more information on this module.

config FREETZ_PACKAGE_LIGHTTPD_MOD_EXTFORWARD
	bool "include mod_extforward (adds about 11kb)"
	depends on FREETZ_PACKAGE_LIGHTTPD
	default y
	help
		This option adds mod_extforward.so to the image.
		Please see http://redmine.lighttpd.net/wiki/1/Docs:ModExtForward
		for more information on this module.

config FREETZ_PACKAGE_LIGHTTPD_MOD_FASTCGI
	bool "include mod_fastcgi (adds about 55kb)"
	depends on FREETZ_PACKAGE_LIGHTTPD
	default y
	help
		This option adds mod_fastcgi.so to the image.
		Please see http://redmine.lighttpd.net/wiki/1/Docs:ModFastCGI
		for more information on this module.

config FREETZ_PACKAGE_LIGHTTPD_MOD_FLV_STREAMING
	bool "include mod_flv_streaming (adds about 10kb)"
	depends on FREETZ_PACKAGE_LIGHTTPD
	default y
	help
		This option adds mod_flv_streaming.so to the image.
		Please see http://redmine.lighttpd.net/wiki/1/Docs:ModFLVStreaming
		for more information on this module.

#requires libGeoIP not (yet) available in freetz
#config FREETZ_PACKAGE_LIGHTTPD_MOD_GEOIP
#	bool "include mod_geoip"
#	depends on FREETZ_PACKAGE_LIGHTTPD
#	default n

#requires libmaxminddb not (yet) available in freetz
#config FREETZ_PACKAGE_LIGHTTPD_MOD_MAXMINDDB
#	bool "include mod_maxminddb"
#	depends on FREETZ_PACKAGE_LIGHTTPD
#	default n

config FREETZ_PACKAGE_LIGHTTPD_MOD_MAGNET
	bool "include mod_magnet (adds about 58kb)"
	depends on FREETZ_PACKAGE_LIGHTTPD_WITH_LUA
	default y
	help
		This option adds mod_magnet.so to the image.
		Please see http://redmine.lighttpd.net/wiki/1/Docs:ModMagnet
		for more information on this module.

#requires mysql not (yet) available in freetz
#config FREETZ_PACKAGE_LIGHTTPD_MOD_MYSQL_VHOST
#	bool "include mod_mysql_vhost (adds about 5kb)"
#	depends on FREETZ_PACKAGE_LIGHTTPD
#	default y
#	help
#		This option adds mod_mysql_vhost.so to the image.
#		Please see http://redmine.lighttpd.net/wiki/1/Docs:ModMySQLVhost
#		for more information on this module.

config FREETZ_PACKAGE_LIGHTTPD_MOD_OPENSSL
	bool "include mod_openssl (adds about 43kb)"
	depends on FREETZ_PACKAGE_LIGHTTPD && FREETZ_PACKAGE_LIGHTTPD_WITH_SSL
	select FREETZ_LIB_libcrypto
	select FREETZ_LIB_libssl
	default n
	help
		This option adds mod_openssl.so to the image.
		Please see http://redmine.lighttpd.net/wiki/1/Docs:SSL
		for more information on this module.

config FREETZ_PACKAGE_LIGHTTPD_MOD_PROXY
	bool "include mod_proxy (adds about 24kb)"
	depends on FREETZ_PACKAGE_LIGHTTPD
	default y
	help
		This option adds mod_proxy.so to the image.
		Please see http://redmine.lighttpd.net/wiki/1/Docs:ModProxy
		for more information on this module.

config FREETZ_PACKAGE_LIGHTTPD_MOD_REDIRECT
	bool "include mod_redirect (adds about 8kb)"
	depends on FREETZ_PACKAGE_LIGHTTPD
	default y
	help
		This option adds mod_redirect.so to the image.
		Please see http://redmine.lighttpd.net/wiki/1/Docs:ModRedirect
		for more information on this module.

config FREETZ_PACKAGE_LIGHTTPD_MOD_REWRITE
	bool "include mod_rewrite (adds about 9kb)"
	depends on FREETZ_PACKAGE_LIGHTTPD
	default y
	help
		This option adds mod_rewrite.so to the image.
		Please see http://redmine.lighttpd.net/wiki/1/Docs:ModRewrite
		for more information on this module.

config FREETZ_PACKAGE_LIGHTTPD_MOD_RRDTOOL
	bool "include mod_rrdtool (adds about 48kb)"
	depends on FREETZ_PACKAGE_LIGHTTPD
	select FREETZ_PACKAGE_RRDTOOL
	default y
	help
		This option adds mod_rrdtool.so to the image.
		Please see http://redmine.lighttpd.net/wiki/1/Docs:ModRRDTool
		for more information on this module.

config FREETZ_PACKAGE_LIGHTTPD_MOD_SCGI
	bool "include mod_scgi (adds about 43kb)"
	depends on FREETZ_PACKAGE_LIGHTTPD
	default y
	help
		This option adds mod_scgi.so to the image.
		Please see http://redmine.lighttpd.net/wiki/1/Docs:ModSCGI
		for more information on this module.

config FREETZ_PACKAGE_LIGHTTPD_MOD_SECDOWNLOAD
	bool "include mod_secdownload (adds about 10kb)"
	depends on FREETZ_PACKAGE_LIGHTTPD
	default y
	help
		This option adds mod_secdownload.so to the image.
		Please see http://redmine.lighttpd.net/wiki/1/Docs:ModSecDownload
		for more information on this module.

config FREETZ_PACKAGE_LIGHTTPD_MOD_SETENV
	bool "include mod_setenv (adds about 9kb)"
	depends on FREETZ_PACKAGE_LIGHTTPD
	default y
	help
		This option adds mod_setenv.so to the image.
		Please see http://redmine.lighttpd.net/wiki/1/Docs:ModSetEnv
		for more information on this module.

config FREETZ_PACKAGE_LIGHTTPD_MOD_SIMPLE_VHOST
	bool "include mod_simple_vhost (adds about 10kb)"
	depends on FREETZ_PACKAGE_LIGHTTPD
	default y
	help
		This option adds mod_simple_vhost.so to the image.
		Please see http://redmine.lighttpd.net/wiki/1/Docs:ModSimpleVhost
		for more information on this module.

config FREETZ_PACKAGE_LIGHTTPD_MOD_SSI
	bool "include mod_ssi (adds about 23kb)"
	depends on FREETZ_PACKAGE_LIGHTTPD
	default y
	help
		This option adds mod_ssi.so to the image.
		Please see http://redmine.lighttpd.net/wiki/1/Docs:ModSSI
		for more information on this module.

config FREETZ_PACKAGE_LIGHTTPD_MOD_STATUS
	bool "include mod_status (adds about 56kb)"
	depends on FREETZ_PACKAGE_LIGHTTPD
	default y
	help
		This option adds mod_status.so to the image.
		Please see http://redmine.lighttpd.net/wiki/1/Docs:ModStatus
		for more information on this module.

#requires libgdbm or libmemcached, both not (yet) available in freetz
#config FREETZ_PACKAGE_LIGHTTPD_MOD_TRIGGER_B4_DL
#	bool "include mod_trigger_b4_dl (adds about 8kb)"
#	depends on FREETZ_PACKAGE_LIGHTTPD
#	default y
#	help
#		This option adds mod_trigger_b4_dl.so to the image.
#		Please see http://redmine.lighttpd.net/projects/1/wiki/
#		for more information on this module.

config FREETZ_PACKAGE_LIGHTTPD_MOD_UPLOADPROGRESS
	bool "include mod_uploadprogress (adds about 8kb)"
	depends on FREETZ_PACKAGE_LIGHTTPD
	default n
	help
		This option adds mod_userdir.so to the image.
		Please see http://redmine.lighttpd.net/wiki/1/Docs:ModUploadprogress
		for more information on this module.

config FREETZ_PACKAGE_LIGHTTPD_MOD_USERDIR
	bool "include mod_userdir (adds about 10kb)"
	depends on FREETZ_PACKAGE_LIGHTTPD
	default y
	help
		This option adds mod_userdir.so to the image.
		Please see http://redmine.lighttpd.net/wiki/1/Docs:ModUserDir
		for more information on this module.

config FREETZ_PACKAGE_LIGHTTPD_MOD_USERTRACK
	bool "include mod_usertrack (adds about 10kb)"
	depends on FREETZ_PACKAGE_LIGHTTPD
	default y
	help
		This option adds mod_usertrack.so to the image.
		Please see http://redmine.lighttpd.net/wiki/1/Docs:ModUserTrack
		for more information on this module.

config FREETZ_PACKAGE_LIGHTTPD_MOD_WEBDAV
	bool "include mod_webdav (adds about 27kb)"
	depends on FREETZ_PACKAGE_LIGHTTPD
	default y
	help
		This option adds mod_webdav.so to the image.
		Please see http://redmine.lighttpd.net/wiki/1/Docs:ModWebDav
		for more information on this module.

config FREETZ_PACKAGE_LIGHTTPD_MOD_WEBDAV_WITH_PROPS
	bool "enable properties support in mod_webdav"
	depends on FREETZ_PACKAGE_LIGHTTPD_MOD_WEBDAV
	select FREETZ_LIB_libxml2
	select FREETZ_LIB_libsqlite3
	default n
	help
		This option enables properties support in mod_webdav.

config FREETZ_PACKAGE_LIGHTTPD_MOD_WEBDAV_WITH_LOCKS
	bool "enable locks in mod_webdav"
	depends on FREETZ_PACKAGE_LIGHTTPD_MOD_WEBDAV_WITH_PROPS
	select FREETZ_LIB_libuuid
	default n
	help
		This option enables locks in mod_webdav.

endmenu
```

## make/lsof/Config.in
```kconfig
config FREETZ_PACKAGE_LSOF
	bool "lsof 4.89"
	default n
	select FREETZ_REMOVE_LSOF if FREETZ_AVM_HAS_LSOF
	help
		lsof (LiSt Open Files)
		The lsof tool lists information about files opened by
		processes.
```

## make/ltrace/Config.in
```kconfig
config FREETZ_PACKAGE_LTRACE
	bool "ltrace 0.7.3checkpoint1-git (binary only)"
	default n
	depends on FREETZ_TARGET_GCC_4_7_MIN
	select FREETZ_LIB_libelf
	help
		ltrace - library call tracer

		ltrace is a debugging tool, similar to strace, but it traces library
		calls instead of system calls.
```

## make/lua/Config.in
```kconfig
config DS_PACKAGE_LUA
	bool "lua 5.1.1 (binary only)"
	select DS_LIB_libncurses
	select DS_LIB_libreadline
	select DS_LIB_libhistory
	default n
	help
	    Lua Scripting Language
```
