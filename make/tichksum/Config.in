## make/tiff/Config.in
```kconfig
config FREETZ_PACKAGE_TIFF
	bool "TIFF utils 4.0.7 (binary only)"
	default n
	help
		Various utilities to manupulate/convert images to/from TIFF format.

config FREETZ_PACKAGE_TIFF_fax2ps
	depends on FREETZ_PACKAGE_TIFF
	select FREETZ_LIB_libtiff
	bool "fax2ps"

config FREETZ_PACKAGE_TIFF_fax2tiff
	depends on FREETZ_PACKAGE_TIFF
	select FREETZ_LIB_libtiff
	bool "fax2tiff"

config FREETZ_PACKAGE_TIFF_ppm2tiff
	depends on FREETZ_PACKAGE_TIFF
	select FREETZ_LIB_libtiff
	bool "ppm2tiff"

config FREETZ_PACKAGE_TIFF_raw2tiff
	depends on FREETZ_PACKAGE_TIFF
	select FREETZ_LIB_libtiff
	bool "raw2tiff"

config FREETZ_PACKAGE_TIFF_tiff2bw
	depends on FREETZ_PACKAGE_TIFF
	select FREETZ_LIB_libtiff
	bool "tiff2bw"

config FREETZ_PACKAGE_TIFF_tiff2pdf
	depends on FREETZ_PACKAGE_TIFF
	select FREETZ_LIB_libtiff
	bool "tiff2pdf"

config FREETZ_PACKAGE_TIFF_tiff2ps
	depends on FREETZ_PACKAGE_TIFF
	select FREETZ_LIB_libtiff
	bool "tiff2ps"

config FREETZ_PACKAGE_TIFF_tiffinfo
	depends on FREETZ_PACKAGE_TIFF
	select FREETZ_LIB_libtiff
	bool "tiffinfo"

config FREETZ_PACKAGE_TIFF_tiffsplit
	depends on FREETZ_PACKAGE_TIFF
	select FREETZ_LIB_libtiff
	bool "tiffsplit"
```

## make/tinc/Config.in
```kconfig
comment "Tinc (not available, needs kernel modules)"
	depends on !(FREETZ_REPLACE_MODULE_AVAILABLE || !FREETZ_AVM_HAS_BUGON_IN_NET_CORE)

comment "Tinc (not available, needs OpenSSL 1.0 or newer)"
	depends on  (FREETZ_REPLACE_MODULE_AVAILABLE || !FREETZ_AVM_HAS_BUGON_IN_NET_CORE) && !FREETZ_OPENSSL_VERSION_1_MIN

config FREETZ_PACKAGE_TINC
	bool "Tinc 1.0.36/1.1pre17"
	default n
	depends on  (FREETZ_REPLACE_MODULE_AVAILABLE || !FREETZ_AVM_HAS_BUGON_IN_NET_CORE) &&  FREETZ_OPENSSL_VERSION_1_MIN
	select FREETZ_LIB_libm      if !FREETZ_PACKAGE_TINC_STATIC && FREETZ_PACKAGE_TINC_VERSION_1_1
	select FREETZ_LIB_liblzo2   if !FREETZ_PACKAGE_TINC_STATIC
	select FREETZ_LIB_libz      if !FREETZ_PACKAGE_TINC_STATIC
	select FREETZ_LIB_libcrypto if !FREETZ_PACKAGE_TINC_STATIC
	select FREETZ_MODULE_yf_patchkernel if FREETZ_AVM_HAS_BUGON_IN_NET_CORE
	help
		Tinc is a Virtual Private Network (VPN) daemon that uses tunneling
		and encryption to create a secure private network between hosts on
		the Internet.

if FREETZ_PACKAGE_TINC

choice
	prompt "Version"
	default FREETZ_PACKAGE_TINC_VERSION_1_0

	config FREETZ_PACKAGE_TINC_VERSION_1_0
	bool "1.0.36"

	config FREETZ_PACKAGE_TINC_VERSION_1_1
	bool "1.1pre17 - EXPERIMENTAL"
endchoice

config FREETZ_PACKAGE_TINC_tinc
	bool "Include tinc control utility"
	depends on FREETZ_PACKAGE_TINC_VERSION_1_1
	default n
	select FREETZ_LIB_libreadline if !FREETZ_PACKAGE_TINC_STATIC
	select FREETZ_LIB_libncurses  if !FREETZ_PACKAGE_TINC_STATIC

config FREETZ_PACKAGE_TINC_STATIC
	bool "Link statically"
	default n
	help
		Tinc needs the following shared libraries which can be linked in statically
		by activating this switch:
		- liblzo2.so
		- libcrypto.so
		- libz.so

endif # FREETZ_PACKAGE_TINC
```

## make/tinyproxy/Config.in
```kconfig
config FREETZ_PACKAGE_TINYPROXY
	bool "Tinyproxy 1.8.2"
	select FREETZ_LIB_libresolv
	select FREETZ_LIB_libnsl
	default n
	help
		Tinyproxy is a lightweight HTTP and HTTPS proxy.
		http://tinyproxy.sourceforge.net

config FREETZ_PACKAGE_TINYPROXY_WITH_TRANSPARENT_PROXY
	bool "Enable transparent proxying"
	depends on REETZ_PACKAGE_TINYPROXY
	default y

config FREETZ_PACKAGE_TINYPROXY_WITH_FILTER
	bool "Enable filtering support"
	depends on REETZ_PACKAGE_TINYPROXY
	default y

config FREETZ_PACKAGE_TINYPROXY_WITH_UPSTREAM
	bool "Enable upstream support"
	depends on REETZ_PACKAGE_TINYPROXY
	default n

#config FREETZ_PACKAGE_TINYPROXY_WITH_SOCKS
#	bool "Enable SOCKS support"
#	depends on REETZ_PACKAGE_TINYPROXY
#	default n

config FREETZ_PACKAGE_TINYPROXY_WITH_REVERSE
	bool "Enable reverse proxy support"
	depends on REETZ_PACKAGE_TINYPROXY
	default n

config FREETZ_PACKAGE_TINYPROXY_STATIC
	bool "Build statically linked binary"
	depends on REETZ_PACKAGE_TINYPROXY
	default n
```

## make/tmux/Config.in
```kconfig
config FREETZ_PACKAGE_TMUX
	bool "tmux 3.3 (binary only)"
	select FREETZ_LIB_libutil     if ! FREETZ_PACKAGE_TMUX_STATIC && FREETZ_TARGET_UCLIBC_HAS_multiple_libs
	select FREETZ_LIB_libncurses  if ! FREETZ_PACKAGE_TMUX_STATIC
	select FREETZ_LIB_libevent    if ! FREETZ_PACKAGE_TMUX_STATIC
	select FREETZ_SHARE_terminfo
	default n
	help
		tmux, a BSD-licensed alternative to GNU screen.
		Uses ncurses.

config FREETZ_PACKAGE_TMUX_STATIC
	bool "Link statically"
	depends on FREETZ_PACKAGE_TMUX
	default n
	help
		TMUX will be linked statically to run without libraries
```

## make/tor/Config.in
```kconfig
config FREETZ_PACKAGE_TOR
	bool "Tor 0.4.2.7"
	select FREETZ_LIB_libm if ! FREETZ_PACKAGE_TOR_STATIC
	select FREETZ_LIB_libevent if ! FREETZ_PACKAGE_TOR_STATIC
	select FREETZ_LIB_libcrypto if ! FREETZ_PACKAGE_TOR_STATIC
	select FREETZ_LIB_libcrypto_WITH_EC
	select FREETZ_LIB_libssl if ! FREETZ_PACKAGE_TOR_STATIC
	select FREETZ_LIB_libz if ! FREETZ_PACKAGE_TOR_STATIC
	select FREETZ_OPENSSL_VERSION_PROMPT
	select FREETZ_OPENSSL_VERSION_1_REQUIRED
	default n
	help
		The Onion Router

		Anonymous Internet communication system.

config FREETZ_PACKAGE_TOR_GEOIP
	bool "Select features required for automatic fetching of GeoIP database"
	depends on FREETZ_PACKAGE_TOR
	select FREETZ_WGET
	default n
	help
		This option activates features required
		for automatic fetching of GeoIP database.

config FREETZ_PACKAGE_TOR_STATIC
	bool "Statically link libraries"
	depends on FREETZ_PACKAGE_TOR
	default n
	help
		Build tor binary with statically linked libraries.
```

## make/transmission-cgi/Config.in
```kconfig
config FREETZ_PACKAGE_TRANSMISSION_CGI
	bool "Transmission CGI 0.0.4"
	depends on FREETZ_PACKAGE_TRANSMISSION_DAEMON
	select FREETZ_BUSYBOX_START_STOP_DAEMON
	default n
	help
		Provides a simple configuration interface
		for transmission-daemon.
```

## make/transmission/Config.in
```kconfig
config FREETZ_PACKAGE_TRANSMISSION
	bool "Transmission 3.00 (binary only)"
	default n
	#
	select FREETZ_PACKAGE_TRANSMISSION_WITH_OPENSSL  if FREETZ_LIB_libcurl_WITH_OPENSSL  || !FREETZ_LIB_libcurl_WITH_SSL
	select FREETZ_PACKAGE_TRANSMISSION_WITH_MBEDTLS  if FREETZ_LIB_libcurl_WITH_MBEDTLS
	#
	select FREETZ_LIB_libcurl    if !FREETZ_PACKAGE_TRANSMISSION_STATIC
	select FREETZ_LIB_libevent   if !FREETZ_PACKAGE_TRANSMISSION_STATIC
	select FREETZ_LIB_libm       if !FREETZ_PACKAGE_TRANSMISSION_STATIC && FREETZ_TARGET_UCLIBC_HAS_multiple_libs
	select FREETZ_LIB_libpthread if !FREETZ_PACKAGE_TRANSMISSION_STATIC && FREETZ_TARGET_UCLIBC_HAS_multiple_libs
	select FREETZ_LIB_librt      if !FREETZ_PACKAGE_TRANSMISSION_STATIC && FREETZ_TARGET_UCLIBC_HAS_multiple_libs
	select FREETZ_LIB_libz       if !FREETZ_PACKAGE_TRANSMISSION_STATIC
	help
		If needed, remember to change the base directory as well
		as the installation directory on the webif.

if FREETZ_PACKAGE_TRANSMISSION

config FREETZ_PACKAGE_TRANSMISSION_WITH_OPENSSL
	bool
	default n
	select FREETZ_LIB_libcrypto          if !FREETZ_PACKAGE_TRANSMISSION_STATIC
	select FREETZ_LIB_libssl             if !FREETZ_PACKAGE_TRANSMISSION_STATIC
	select FREETZ_LIB_libdl              if !FREETZ_PACKAGE_TRANSMISSION_STATIC && FREETZ_TARGET_UCLIBC_HAS_multiple_libs
	select FREETZ_LIB_libcrypto_WITH_RC4

config FREETZ_PACKAGE_TRANSMISSION_WITH_MBEDTLS
	bool
	default n
	select FREETZ_LIB_libmbedcrypto      if !FREETZ_PACKAGE_TRANSMISSION_STATIC

config FREETZ_PACKAGE_TRANSMISSION_CLIENT
	bool "Transmission interactive client"
	default n
	help
		Torrent client (interactive)

		Note: transmission client is deprecated (see http://trac.transmissionbt.com/ticket/2983)
		and will be removed in one of the next releases. Consider using web-interface controlled
		daemon instead.

config FREETZ_PACKAGE_TRANSMISSION_DAEMON
	bool "Transmission daemon"
	default y
	help
		Torrent client (daemon)

config FREETZ_PACKAGE_TRANSMISSION_REMOTE
	bool "Transmission remote"
	depends on FREETZ_PACKAGE_TRANSMISSION_DAEMON
	default n
	help
		A remote control utility for transmission-daemon

config FREETZ_PACKAGE_TRANSMISSION_CREATE
	bool "transmission-create"
	default n
	help
		A command-line utility to create .torrent files

config FREETZ_PACKAGE_TRANSMISSION_EDIT
	bool "transmission-edit"
	default n
	help
		A command-line utility to modify .torrent files' announce URLs

config FREETZ_PACKAGE_TRANSMISSION_SHOW
	bool "transmission-show"
	default n
	help
		A command-line utility to show .torrent file metadata

config FREETZ_PACKAGE_TRANSMISSION_STATIC
	bool "Link statically"
	default n
	help
		Build transmission binaries with statically linked libraries.

config FREETZ_PACKAGE_TRANSMISSION_WEBINTERFACE
	bool "Transmission web interface"
	depends on FREETZ_PACKAGE_TRANSMISSION_DAEMON
	default y
	help
		The official web interface for transmission called clutch

config FREETZ_PACKAGE_TRANSMISSION_SELECT_CGI
	bool "Select Transmission CGI"
	select FREETZ_PACKAGE_TRANSMISSION_CGI
	select FREETZ_PACKAGE_TRANSMISSION_DAEMON
	default y
	help
		Configuration web interface for Freetz.

endif # FREETZ_PACKAGE_TRANSMISSION
```

## make/tree/Config.in
```kconfig
config FREETZ_PACKAGE_TREE
	bool "tree 1.5.2.1 (binary only)"
	default n
	help
		Tree is a recursive directory listing program
		that produces a depth indented listing of files,
		which is colorized ala dircolors if the LS_COLORS
		environment variable is set and output is to tty.
```

## make/trickle/Config.in
```kconfig
config FREETZ_PACKAGE_TRICKLE
	bool "trickle 1.07 (binary only)"
	select FREETZ_LIB_libevent
	select FREETZ_LIB_libtirpc    if !FREETZ_TARGET_UCLIBC_SUPPORTS_rpc
	select FREETZ_LIB_libdl       if FREETZ_TARGET_UCLIBC_HAS_multiple_libs
	select FREETZ_LIB_libpthread  if FREETZ_TARGET_UCLIBC_HAS_multiple_libs
	default n
	help
		trickle is a simple and portable lightweight userspace bandwidth
		shaper, to rate limit the TCP connections of a given process or
		group of processes. It can run in collaborative mode (together with
		trickled) or in stand alone mode. trickle works by taking
		advantage of the unix loader preloading. Essentially it
		provides to the application, a new version of the functionality
		that is required to send and receive data through sockets. It
		then limits traffic based on delaying the sending and receiving
		of data over a socket. trickle runs entirely in userspace and does
		not require root privileges.
		*** Does NOT support statically linked executables!!
		WWW: http://monkey.org/~marius/trickle/
```

## make/truecrypt/Config.in
```kconfig
comment "truecrypt (not available, needs at least kernel 2.6.28)"
	depends on FREETZ_KERNEL_VERSION_2_6_19_MAX

comment "truecrypt (not available, needs libstdc++ as the Standard C++ Library)"
	depends on FREETZ_KERNEL_VERSION_2_6_28_MIN && !FREETZ_STDCXXLIB_USE_GNULIBSTDCXX

config FREETZ_PACKAGE_TRUECRYPT
	bool "truecrypt 7.1a (binary only)"
	depends on FREETZ_STDCXXLIB_USE_GNULIBSTDCXX && FREETZ_KERNEL_VERSION_2_6_28_MIN
	select FREETZ_LIB_libdl                 if !FREETZ_PACKAGE_TRUECRYPT_STATIC
	select FREETZ_LIB_libpthread            if !FREETZ_PACKAGE_TRUECRYPT_STATIC
	select FREETZ_LIB_STDCXXLIB             if !FREETZ_PACKAGE_TRUECRYPT_STATIC
	select FREETZ_LIB_STDCXXLIB_WITH_WCHAR
	select FREETZ_LIB_libwx_baseu           if !FREETZ_PACKAGE_TRUECRYPT_STATIC
	select FREETZ_PACKAGE_FUSE
	select FREETZ_LIB_libfuse               if !FREETZ_PACKAGE_TRUECRYPT_STATIC
	select FREETZ_MODULE_fuse
	default n
	help
		TrueCrypt is a software system for establishing and maintaining
		an on-the-fly-encrypted volume (data storage device).

config FREETZ_PACKAGE_TRUECRYPT_STATIC
	bool "create statically linked binary"
	depends on FREETZ_PACKAGE_TRUECRYPT
	default n
	help
		Causes all libraries truecrypt depends on to be linked in statically.
```

## make/udpxy/Config.in
```kconfig
config FREETZ_PACKAGE_UDPXY
	bool "udpxy 1.0 Chipmunk 16 (binary only)"
	default n
	help
		Small-footprint UNIX/Linux daemon to relay multicast
		UDP traffic to client's TCP (HTTP) connection.
```

## make/umurmur/Config.in
```kconfig
config FREETZ_PACKAGE_UMURMUR
	bool "umurmur 0.2.14"
	select FREETZ_LIB_libconfig
	select FREETZ_LIB_libprotobuf_c
	select FREETZ_LIB_libcrypto if ! FREETZ_PACKAGE_UMURMUR_USE_POLARSSL
	select FREETZ_LIB_libssl if ! FREETZ_PACKAGE_UMURMUR_USE_POLARSSL
	default n
	help
		umurmur is a minimalistic Mumble server primarily
		targeted to run on routers using less resources.
		It targets to fill the needs of a pretty small group
		of users communicating, which in part originates from
		the other goal of working well on a small system with
		a limited CPU and limited amount of disk space. It also
		aims to minimize writing to the disk since these kinds
		of systems usually only has a flash memory for disk.
		umurmur supports a subset of the features of Murmur.
		http://code.google.com/p/umurmur/

config FREETZ_PACKAGE_UMURMUR_USE_POLARSSL
	bool "Use polarssl instead of openssl"
	depends on FREETZ_PACKAGE_UMURMUR
	select FREETZ_LIB_libpolarssl13
	default n
	help
		Use lightweight PolarSSL as SSL library.
```

## make/unfs3/Config.in
```kconfig
comment "unfs3 (not available, you have selected incompatible package nfsd)"
	depends on FREETZ_PACKAGE_NFSD_CGI

config FREETZ_PACKAGE_UNFS3
	bool "unfs3 0.9.22"
	depends on !FREETZ_PACKAGE_NFSD_CGI
	select FREETZ_PACKAGE_PORTMAP
	help
		Userspace NFS v3 Server.
```

## make/unrar/Config.in
```kconfig
config FREETZ_PACKAGE_UNRAR
	bool "unrar 5.2.3 (binary only)"
	select FREETZ_LIB_STDCXXLIB if ! FREETZ_PACKAGE_UNRAR_STATIC
	default n
	help
		Unarchiver for .rar files

config FREETZ_PACKAGE_UNRAR_STATIC
	bool "create statically linked binary"
	depends on FREETZ_PACKAGE_UNRAR
	default n
	help
		Causes all libraries unrar depends on to be linked in statically
```

## make/usbids/Config.in
```kconfig
config FREETZ_PACKAGE_USBIDS
	bool "USB IDs"
	default n
	help
		This package provides up-to-date version of the usb.ids file
		needed by many usb related packages.

config FREETZ_PACKAGE_USBIDS_FORCE_DOWNLOAD
	bool "Force update on each build"
	depends on FREETZ_PACKAGE_USBIDS
	default y
	help
		Download the latest version of usb.ids each time freetz is built.
```

## make/usbip/Config.in
```kconfig
config FREETZ_PACKAGE_USBIP
	bool "USB/IP 0.1.8"
	depends on FREETZ_KERNEL_VERSION_2_6_32_MAX
	depends on FREETZ_REPLACE_MODULE_AVAILABLE
	default n
	select FREETZ_LIB_libglib_2
	select FREETZ_LIB_libsysfs
	select FREETZ_MODULE_usbip if !FREETZ_AVM_HAS_USB_IP_HOST_BUILTIN
	select FREETZ_PACKAGE_USBIDS
	help
		USB/IP Project aims to develop a general USB
		device sharing system over IP network. To share
		USB devices between computers with their full
		functionality, USB/IP encapsulates "USB I/O messages"
		into IP packets and transmits them between computers.

		If you plan to share a printer with this package, consider
		to remove AVM's printserv, but not the usblp kernel module.

config FREETZ_PACKAGE_USBIP_WRAPPER
	bool "replace printserv"
	depends on FREETZ_AVM_HAS_USB_HOST
	depends on FREETZ_PACKAGE_USBIP
	default n
	select FREETZ_REMOVE_PRINTSERV
	help
		This replaces AVM's printserv by a wrapper to
		automatically share connected printers.
```
