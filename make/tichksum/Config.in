## make/usbroot/Config.in
```kconfig
config FREETZ_PACKAGE_USBROOT
	bool "USB root 0.2"
	depends on FREETZ_HAS_USB_HOST
	default n
	help
		Mount an ext{2,3} filesystem (fs) from an USB stick and use it
		as root fs which may be fully writable and basically unlimited
		in size. The Linux kernel will still be loaded from your box
		and during the first phase of the init process the SquashFS on
		the box is still used, but after the USB root is mounted, we
		pivot_root into it and it becomes the new root fs. The default
		is to unmount the read-only fs on the box to conserve memory,
		but if desired, it can be still be accessed under /oldroot
		(though this is absolutely not necessary anymore after
		pivot_root).

		Having said that, it should be clear that the usb stick	should
		contain everything necessary to run the box. Usually you just
		create a full copy of a target filesystem (e.g. from
		build/modified/filesystem or from an unpacked firmware image)
		and start modifying it as needed. The binaries (kernel modules,
		executables, shared libraries) used therein just have to fit
		the kernel installed on the box.

		Note: The webinterface makes it pretty easy to (de-)activate and
		configure the functionality of this package. However, USB root
		is an expert thing! See also the help screen of
		/etc/init.d/rc.usbroot for further description. As some config
		data is stored in bootloader environment, this package is
		special anyway.
```

## make/usbutils/Config.in
```kconfig
config FREETZ_PACKAGE_USBUTILS
	bool "usbutils 007 (binary only)"
	select FREETZ_LIB_libusb_1
	select FREETZ_PACKAGE_USBIDS
	default n
	help
		USB devices listing utilities

		To avoid name conflicts with AVM's lsusb the binary is renamed to lsusb-freetz.
```

## make/util-linux-ng/Config.in
```kconfig
config FREETZ_PACKAGE_UTIL_LINUX_NG
	bool "util-linux-ng"
	default n
	help
		Provides blkid and findfs utils from util-linux-ng project
```

## make/util-linux/Config.in
```kconfig
config FREETZ_PACKAGE_UTIL_LINUX
	bool "util-linux (binary only)"
	depends on FREETZ_PATCH_FREETZMOUNT
	# TODO: util-linux' libsysfs requires fdopendir, which is missing in uClibc-0.9.28/0.9.29
	depends on !FREETZ_TARGET_UCLIBC_0_9_28 && !FREETZ_TARGET_UCLIBC_0_9_29
	default n
	help
		Provides blkid util from util-linux project
```

## make/vermagic/Config.in
```kconfig
config FREETZ_PACKAGE_VERMAGIC
	bool "vermagic"
	default n
	help
		vermagic allows dumping of kernel module's .modinfo section as well as changing
                the vermagic string contained therein, see https://github.com/D1W0U/vermagic
```

## make/vim/Config.in
```kconfig
config FREETZ_PACKAGE_VIM
	bool "vim (VI Improved) (binary only)"
	select FREETZ_LIB_libdl
	select FREETZ_LIB_libm
	select FREETZ_LIB_libncurses
	default n
	help
		An improved version of VI

choice
	prompt "vim executable feature set"
		default FREETZ_PACKAGE_VIM_TINY
		depends on FREETZ_PACKAGE_VIM
		help
			Select your vim flavour here.

			tiny = simple (v) improved editing functionality.
			normal = simple (v) improved editing functionality + colors + folding
			huge = simple (v) improved editing functionality + colors + folding + scripts + plugins

			This option only makes the executable larger,
			it does not copy the runtime files. Those would not fit on your box either.
			It's up to you to get it to /usr/share/vim, eg. bind mounts.

		config FREETZ_PACKAGE_VIM_TINY
			bool "tiny"

		config FREETZ_PACKAGE_VIM_NORMAL
			depends on FREETZ_SHOW_ADVANCED
			bool "normal - EXPERIMENTAL"

		config FREETZ_PACKAGE_VIM_HUGE
			depends on FREETZ_SHOW_ADVANCED
			bool "huge - EXPERIMENTAL"

endchoice

config FREETZ_PACKAGE_VIM_MULTIBYTE
	depends on FREETZ_PACKAGE_VIM
	bool "Enable multibyte encodings support"
	default n
	help
		Enables support for multibyte encodings (like UTF-8) in vim.

		Note: enabling this option increases binary size by about 65KB.
```

## make/virtualip-cgi/Config.in
```kconfig
config DS_PACKAGE_VIRTUALIP_CGI
	bool "Virtual IP CGI 0.4.1"
	default n
	help
		Creates a virtual network interface. This is needed to comfortably open
		server ports on the Fritz!Box itself via AVM web interface.

		The package is also equipped with a configuration interface for the
		DS-Mod web configurator which lets you choose the IP address and
		net mask of the virtual interface as well as toggle auto-start.
```

## make/vnstat/Config.in
```kconfig
config FREETZ_PACKAGE_VNSTAT
	bool "vnstat 1.10 (binary only)"
	default n
	select FREETZ_LIB_libm
	help
		vnStat is a console-based network traffic monitor. It keeps a log of
		hourly, daily and monthly network traffic for the selected interface(s).
		However, it isn't a packet sniffer. The traffic information is analyzed
		from the proc(5) filesystem. That way vnStat can be used even
		without root permissions.
		WWW: http://humdi.net/vnstat/

config FREETZ_PACKAGE_VNSTAT_DAEMON
	bool "vnstat 1.10 daemon"
	depends on FREETZ_PACKAGE_VNSTAT
	default n
	help
		This is a daemon for collection data

config FREETZ_PACKAGE_VNSTAT_IMAGE
	bool "vnstat 1.10 image"
	depends on FREETZ_PACKAGE_VNSTAT
	default n
	select FREETZ_LIB_libgd
	help
		This component is for creating images
```
