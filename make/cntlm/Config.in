## make/dtmfbox/Config.in
```kconfig
config FREETZ_PACKAGE_DTMFBOX
	depends on FREETZ_LANG_DE || ! FREETZ_SELECTED_LANG_ONLY
	bool "dtmfbox v0.5.0"
	select FREETZ_LIB_libcapi20
	select FREETZ_PACKAGE_DTMFBOX_WITH_G711_CODEC
	default n
	help		
		dtmfbox is a small softswitch application, that can be used to 
		control different tasks over telephone keyboard (via DTMF).
		The DTMF signals are handed over to a scriptfile or a plugin.
		
		While scriptfile/plugin running, you can answer an incoming call, 
		record or play a wave file, make another call, bridge calls, etc.
		
		The scriptfiles included in this package, contain an 
		answering machine, callback/callthrough script, reverse lookup, 
		anti-callcenter script, weather forecast, webradio ...

		The application can also be configured as registrar, to allow 
		SIP client connects.

		http://dtmfbox.v3v.de

menu "CAPI/SIP"
	depends on FREETZ_PACKAGE_DTMFBOX

config FREETZ_PACKAGE_DTMFBOX_WITH_CAPI
	bool "CAPI support"
	depends on FREETZ_PACKAGE_DTMFBOX
	default y
	help
		Compile dtmfbox with CAPI support (ISDN/Analog)

#config FREETZ_PACKAGE_DTMFBOX_WITH_REMOTE_CAPI
#	bool "Remote CAPI support"	
#	depends on FREETZ_PACKAGE_DTMFBOX_WITH_CAPI
#	default n
#	help
#		Compile dtmfbox with Remote-CAPI support (ISDN/Analog).		
#		You can connect two Fritz!Boxes via capiotcp daemon (eg. repeater and base).
#		
#		You will get 5 controllers additionally:
#		1-5 are the internal controllers. 6-10 are the remote controllers.

config FREETZ_PACKAGE_DTMFBOX_WITH_VOIP
	bool "SIP support"
	depends on FREETZ_PACKAGE_DTMFBOX
	default y
	help
		Compile dtmfbox with VoIP support (SIP)

config FREETZ_PACKAGE_DTMFBOX_WITH_ICE
	bool "ICE support"
	depends on FREETZ_PACKAGE_DTMFBOX_WITH_VOIP
	default y
	help
		Compile dtmfbox with ICE support (~90 kb)

endmenu


menu "Codecs"
	depends on FREETZ_PACKAGE_DTMFBOX

config FREETZ_PACKAGE_DTMFBOX_WITH_G711_CODEC
	bool "G711"
	depends on FREETZ_PACKAGE_DTMFBOX
	default y
	help
		Include G711 codec (default)

config FREETZ_PACKAGE_DTMFBOX_WITH_SPEEX_CODEC
	bool "SPEEX (not tested)"
	depends on FREETZ_PACKAGE_DTMFBOX
	default n
	help
		Include SPEEX codec

config FREETZ_PACKAGE_DTMFBOX_WITH_GSM_CODEC
	bool "GSM (not tested)"
	depends on FREETZ_PACKAGE_DTMFBOX
	default n
	help
		Include GSM codec

#config FREETZ_PACKAGE_DTMFBOX_WITH_ILBC_CODEC
#	bool "iLBC (not tested)"
#	depends on FREETZ_PACKAGE_DTMFBOX
#	default n
#	help
#		Include iLBC codec

endmenu

menu "Misc"
	depends on FREETZ_PACKAGE_DTMFBOX

config FREETZ_PACKAGE_DTMFBOX_SVN
	depends on FREETZ_PACKAGE_DTMFBOX
	bool "Download from SVN"
	default n
	help		
		Download latest dtmfbox from subversion repository.
		This is the current development trunk.

config FREETZ_PACKAGE_DTMFBOX_SVN_FORCE_LATEST_REV
	depends on FREETZ_PACKAGE_DTMFBOX_SVN
	bool "Always checkout latest revision and compile"
	default y
	help
		Always latest revision from SVN repository without 
		running 'dtmfbox-dirclean'.
		
		Everytime you run 'make', a complete checkout and
		recompilation is performed.

config FREETZ_PACKAGE_DTMFBOX_USE_DIFF_PATCH
	depends on FREETZ_PACKAGE_DTMFBOX && FREETZ_REPLACE_BUSYBOX
	bool "Use busybox patch and diff"
	select FREETZ_BUSYBOX_DIFF 
	select FREETZ_BUSYBOX_PATCH
	default n
	help
		Compile busybox with patch and diff.
		This saves some flash memory when using dtmfbox without usb.

config FREETZ_PACKAGE_DTMFBOX_WITH_WEBPHONE
	bool "Webphone Applet (beta)"
	depends on FREETZ_PACKAGE_DTMFBOX
	default y
	help
		Java Applet to make phone calls over webinterface. 
		Beta!!
		
		+ 64 kb (Binary only)

config FREETZ_PACKAGE_DTMFBOX_WITH_HELP
	bool "Help"
	depends on FREETZ_PACKAGE_DTMFBOX
	default y
	help
		Include online help

config FREETZ_PACKAGE_DTMFBOX_WITH_ESPEAK
	bool "eSpeak support"
	depends on FREETZ_PACKAGE_DTMFBOX
	select FREETZ_PACKAGE_ESPEAK
	default n
	help
		Add package "eSpeak" to support Text2Speech.		
		Attention: eSpeak is also supported over webstream!

config FREETZ_PACKAGE_DTMFBOX_WITH_MADPLAY
	bool "madplay support"
	depends on FREETZ_PACKAGE_DTMFBOX
	select FREETZ_PACKAGE_MADPLAY
	default n
	help
		Add package "madplay" to support webradio and podcasts

endmenu
```
