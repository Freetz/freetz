## make/cntlm/Config.in
```kconfig
config FREETZ_PACKAGE_CNTLM
	bool "Cntlm 0.93beta5 (binary only)"
	default n
	select FREETZ_LIB_libpthread if FREETZ_TARGET_UCLIBC_HAS_multiple_libs
	help
		Cntlm is an NTLM / NTLM Session Response / NTLMv2 authenticating HTTP proxy.
```

## make/collectd/Config.in
```kconfig
config FREETZ_PACKAGE_COLLECTD
	bool "Collectd 4.0.7"
	default n
	help
		Collectd collects information about the system it is running on and 
		stores this information. The information can then be used to do find
		current performance bottlenecks (i. e. performance analysis) and
		predict future system load (i. e. capacity planning). Or if you just 
		want pretty graphs of your private server and are fed up with some
		homegrown solution you're at the right place, too.
```

## make/comgt/Config.in
```kconfig
config FREETZ_PACKAGE_COMGT
	bool "comgt 0.32 (binary only)"
	default n
	help
		Option GlobeTrotter GPRS/EDGE/3G/HSDPA and Vodafone 3G/GPRS datacard control tool.
		comgt is a scripting language interpreter useful for establishing communications
		on serial lines and through PCMCIA modems as well as GPRS and 3G datacards.
```

## make/cpmaccfg-cgi/Config.in
```kconfig
config FREETZ_PACKAGE_CPMACCFG_CGI
	bool "Cpmaccfg CGI 1.0"
	depends on FREETZ_PACKAGE_CPMACCFG_AVAILABLE
	select FREETZ_PACKAGE_CPMACCFG
	select FREETZ_PACKAGE_BRIDGE_UTILS
	default n
	help
		Configuration front-end to cpmaccfg

		This frontend shows the current settings of the LAN ports
		and gives a very simple way to set VLAN, portmode and
		WLAN assigment.

		Additional to this, you can set IP addresses for the VLAN
		interfaces eth0-eth3 if needed.
```

## make/cpmaccfg/Config.in
```kconfig
config DS_PACKAGE_CPMACCFG
	bool "cpmaccfg"
	default n
	help
	    With a patched kernel and this tool it is possible to
	    configure the ADM6996L switch (at least FB 7170, maybe
	    other FBs with 4 LAN ports work too) to support VLANs
	    and/or to split the LAN ports into different subnets.
```

## make/cryptsetup/Config.in
```kconfig
comment "cryptsetup (not available, needs replace kernel)"
	depends on FREETZ_KERNEL_VERSION_2_6_13_MAX && !FREETZ_REPLACE_KERNEL

comment "cryptsetup (not available, needs kernel modules)"
	depends on FREETZ_KERNEL_VERSION_2_6_19_MIN && !FREETZ_REPLACE_MODULE_AVAILABLE

config FREETZ_PACKAGE_CRYPTSETUP
	bool "cryptsetup 1.7.5 (binary only)"
	depends on \
		(FREETZ_KERNEL_VERSION_2_6_13_MAX && FREETZ_REPLACE_KERNEL) || \
		(FREETZ_KERNEL_VERSION_2_6_19_MIN && FREETZ_REPLACE_MODULE_AVAILABLE)
	select FREETZ_AUTOMOUNT_LUKS if FREETZ_USBSTORAGE_AUTOMOUNT
	select FREETZ_LIB_libdevmapper
	select FREETZ_LIB_libgcrypt
	select FREETZ_LIB_libpopt
	select FREETZ_LIB_libuuid
	select FREETZ_MODULE_dm_crypt        if !FREETZ_AVM_HAS_DM_CRYPT_BUILTIN
	select FREETZ_MODULE_aes             if !FREETZ_AVM_HAS_CRYPTO_AES_BUILTIN      &&  FREETZ_KERNEL_VERSION_2_6_13
	select FREETZ_MODULE_sha256          if !FREETZ_AVM_HAS_CRYPTO_SHA256_BUILTIN   &&  FREETZ_KERNEL_VERSION_2_6_19_MAX
	select FREETZ_MODULE_sha256_generic  if !FREETZ_AVM_HAS_CRYPTO_SHA256_BUILTIN   &&  FREETZ_KERNEL_VERSION_2_6_28_MIN && !FREETZ_KERNEL_VERSION_2_6_39
	select FREETZ_MODULE_cbc             if !FREETZ_AVM_HAS_CRYPTO_CBC_BUILTIN      && (FREETZ_KERNEL_VERSION_2_6_19 || FREETZ_KERNEL_VERSION_2_6_32_MIN)
	select FREETZ_MODULE_cryptomgr       if !FREETZ_AVM_HAS_CRYPTO_MANAGER_BUILTIN  &&  FREETZ_KERNEL_VERSION_2_6_19
	default n 
	help
		cryptsetup is used to conveniently setup dm-crypt managed
		block devices under Linux.
		Hint: Don't forget to insmod all selected modules.

config FREETZ_CRYPTSETUP_LOOP
	bool "support for container files"
	depends on FREETZ_PACKAGE_CRYPTSETUP
	select FREETZ_MODULE_loop if !FREETZ_AVM_HAS_BLK_DEV_LOOP_BUILTIN
	select FREETZ_BUSYBOX_LOSETUP
	help
		This is required to mount container *files*.
```

## make/ctorrent/Config.in
```kconfig
config FREETZ_PACKAGE_CTORRENT
	bool "Ctorrent dnh3.3.2 (binary only)"
	select FREETZ_LIB_STDCXXLIB
	default n
	help
		CTorrent is a BitTorrent client written in the C programming
		language, known to be a very robust and mature programming
		language, which produces fast and optimized application.
```

## make/curl/Config.in
```kconfig
config FREETZ_PACKAGE_CURL
	bool "Curl 7.69.1 (binary only)"
	default n
	select FREETZ_LIB_libcurl if ! FREETZ_PACKAGE_CURL_STATIC
	help
		Curl is a command line tool for transferring files with URL syntax,
		supporting FTP, FTPS, HTTP, HTTPS, GOPHER, TELNET, DICT, FILE and LDAP.
		Curl supports HTTPS certificates, HTTP POST, HTTP PUT, FTP uploading,
		kerberos, HTTP form based upload, proxies, cookies, user+password
		authentication, file transfer resume, http proxy tunneling and a
		busload of other useful tricks.

config FREETZ_PACKAGE_CURL_STATIC
	bool "create statically linked binary"
	depends on FREETZ_PACKAGE_CURL
	default n
	help
		Causes all libraries curl binary depends on to be linked in statically
```

## make/curlftpfs/Config.in
```kconfig
config FREETZ_PACKAGE_CURLFTPFS
	bool "CurlFtpFS 0.9.2"
	depends on FREETZ_REPLACE_MODULE_AVAILABLE
	depends on !FREETZ_TARGET_UCLIBC_0_9_28
	default n
	select FREETZ_LIB_libiconv   if !FREETZ_PACKAGE_CURLFTPFS_STATIC && FREETZ_TARGET_UCLIBC_0_9_28 
	select FREETZ_LIB_libcurl    if !FREETZ_PACKAGE_CURLFTPFS_STATIC
	select FREETZ_LIB_libglib_2  if !FREETZ_PACKAGE_CURLFTPFS_STATIC
	select FREETZ_LIB_libcrypto  if !FREETZ_PACKAGE_CURLFTPFS_STATIC
	select FREETZ_LIB_libssl     if !FREETZ_PACKAGE_CURLFTPFS_STATIC
	select FREETZ_PACKAGE_FUSE
	help
		CurlFtpFS is a filesystem for accessing FTP hosts based on FUSE and libcurl.
		Website: http://curlftpfs.sourceforge.net/
		Features:
		 - SSLv3 and TLSv1 support
		 - connecting through tunneling HTTP proxies
		 - automatically reconnection if the server times out
		 - transform absolute symlinks to point back into the ftp file system

config FREETZ_PACKAGE_CURLFTPFS_STATIC
	bool "Link statically"
	depends on FREETZ_PACKAGE_CURLFTPFS
	default n
	help
		By activating this switch the following shared libraries will be linked in statically:
		 - libfuse
		 - libglib2
		 - libcurl
		 - libcrypto
		 - libssl
		 * libiconv

config FREETZ_PACKAGE_CURLFTPFS_REMOVE_WEBIF
	bool "remove webinterface"
	depends on FREETZ_PACKAGE_CURLFTPFS
	default n
	help
		This option removes the webinterface
```

## make/dante/Config.in
```kconfig
config FREETZ_PACKAGE_DANTE
	bool "Dante 1.4.3 (binary only)"
	select FREETZ_LIB_libcrypt  if FREETZ_TARGET_UCLIBC_HAS_multiple_libs
	select FREETZ_LIB_libdl     if FREETZ_TARGET_UCLIBC_HAS_multiple_libs
	default n
	help
		socks proxy daemon
```

## make/davfs2/Config.in
```kconfig
config FREETZ_PACKAGE_DAVFS2
	bool "davfs 1.5.2/1.6.1"
	depends on FREETZ_REPLACE_MODULE_AVAILABLE
	select FREETZ_LIB_libiconv if FREETZ_TARGET_UCLIBC_0_9_28
	select FREETZ_LIB_libneon
	select FREETZ_MODULE_fuse if ! FREETZ_MODULE_coda && !FREETZ_AVM_HAS_FUSE_FS_BUILTIN
	select FREETZ_BUSYBOX_FEATURE_MOUNT_HELPERS
	select FREETZ_BUSYBOX_FEATURE_MOUNT_LABEL
	select FREETZ_REMOVE_WEBDAV if FREETZ_AVM_HAS_WEBDAV
	default n
	help
		davfs is a Linux file system driver that allows you to mount a
		WebDAV server as a disk drive. WebDAV is an extension to
		HTTP/1.1 that allows remote collaborative authoring of Web
		resources, defined in RFC 4918.

if FREETZ_PACKAGE_DAVFS2

	choice
		prompt "Version"
			default FREETZ_PACKAGE_DAVFS2_VERSION_CURRENT

		config FREETZ_PACKAGE_DAVFS2_VERSION_ABANDON
			bool "1.5.2"
			depends on FREETZ_KERNEL_VERSION_2_MAX

		config FREETZ_PACKAGE_DAVFS2_VERSION_CURRENT
			bool "1.6.1"
			depends on !FREETZ_KERNEL_VERSION_2_MAX

	endchoice

	config FREETZ_PACKAGE_DAVFS2_REMOVE_WEBIF
		bool "remove webinterface"
		default n
		help
			This option removes the webinterface

	config FREETZ_PACKAGE_DAVFS2_WITH_SSL
		bool "build with SSL support"
		select FREETZ_LIB_libneon_WITH_SSL
		default y
		help
			This option enables SSL support.

		config FREETZ_PACKAGE_DAVFS2_CA_BUNDLE
			bool "Select CA-bundle"
			depends on FREETZ_PACKAGE_DAVFS2_WITH_SSL
			default y
			select FREETZ_PACKAGE_CA_BUNDLE

	config FREETZ_PACKAGE_DAVFS2_WITH_ZLIB
		bool "build with zlib support"
		select FREETZ_LIB_libneon_WITH_ZLIB
		default n
		help
			This option enables zlib support.

endif # FREETZ_PACKAGE_DAVFS2
```

## make/dbus/Config.in
```kconfig
config FREETZ_PACKAGE_DBUS
	bool "D-Bus 1.13.18"
	default n
	select FREETZ_LIB_libexpat
	select FREETZ_LIB_libpthread if FREETZ_TARGET_UCLIBC_HAS_multiple_libs
	help
		D-Bus is a message bus system, a simple way for applications
		to talk to one another. In addition to interprocess
		communication, D-Bus helps coordinate process lifecycle;
		it makes it simple and reliable to code a "single instance"
		application or daemon, and to launch applications and daemons
		on demand when their services are needed.

if FREETZ_PACKAGE_DBUS

	config FREETZ_PACKAGE_DBUS_monitor
		bool "dbus-monitor"
		default n
		select FREETZ_LIB_libdbus
		select FREETZ_LIB_libpthread if FREETZ_TARGET_UCLIBC_HAS_multiple_libs
		help
			dbus-monitor allows to monitor messages sent over a D-Bus message bus.

	config FREETZ_PACKAGE_DBUS_send
		bool "dbus-send"
		default n
		select FREETZ_LIB_libdbus
		select FREETZ_LIB_libpthread if FREETZ_TARGET_UCLIBC_HAS_multiple_libs
		help
			dbus-send allows to send messages to a D-Bus message bus.

	config FREETZ_PACKAGE_DBUS_uuidgen
		bool "dbus-uuidgen"
		default n
		select FREETZ_LIB_libdbus
		select FREETZ_LIB_libpthread if FREETZ_TARGET_UCLIBC_HAS_multiple_libs
		help
			dbus-uuidgen generates or reads a universally unique ID.

endif # FREETZ_PACKAGE_DBUS
```

## make/debootstrap/Config.in
```kconfig
config FREETZ_PACKAGE_DEBOOTSTRAP
	bool "Debootstrap (binary only)"
	select FREETZ_BUSYBOX_AR
	select FREETZ_BUSYBOX_BUNZIP2
	select FREETZ_BUSYBOX_CHROOT
	select FREETZ_BUSYBOX_SHA1SUM
	select FREETZ_BUSYBOX_UNIQ
	default n
	help
		debootstrap is used to create a Debian base system from scratch,
		without requiring the availability of dpkg or apt. It does this by
		downloading .deb files from a mirror site, and carefully unpacking
		them into a directory which can eventually be chrooted into.
```

## make/deco/Config.in
```kconfig
config FREETZ_PACKAGE_DECO
	bool "Deco 1.3.9"
	depends on FREETZ_LANG_DE || FREETZ_LANG_EN || ! FREETZ_SELECTED_LANG_ONLY
	select FREETZ_LIB_libncurses
	default n
	help
		Norton commander clone. Compared with Midnight Commander (mc) it is
		considerably smaller, but also significantly less powerful and less
		fancy-looking. Use it if you want to trade power for file and memory
		footprint, but still feel like requiring a file manager instead of a
		plain UNIX shell. Uses about 149K uncompressed space.
```
