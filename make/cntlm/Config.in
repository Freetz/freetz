## make/decrypt-fritzos-cfg/Config.in
```kconfig
config FREETZ_PACKAGE_DECRYPT_FRITZOS_CFG
	bool "decrypt FRITZ!OS configs 0.4-git"
	default n
	help
		This package provides a set of tools making it possible to decrypt
		encrypted parts (usually credentials) of FRITZ!OS configuration
		files. See
		 https://github.com/PeterPawn/decode_passwords,
		 http://www.ip-phone-forum.de/showthread.php?t=276183,
		 http://www.ip-phone-forum.de/showthread.php?t=295101
		for usage details and technical background.

		NO RESPONSIBILITY DISCLAIMER:
		  Adding easy usable tools like these (to emphasize it once
		  more - tools providing password decryption capabilities)
		  decreases the SECURITY of your box.
		  Use it on YOUR OWN RISK, Freetz is not responsible
		  for any potential losses or damages resulting/arising
		  from adding these tools to your firmware.

if FREETZ_PACKAGE_DECRYPT_FRITZOS_CFG
comment "WARNING: See help for the NO RESPONSIBILITY DISCLAIMER."
endif

choice
	depends on FREETZ_PACKAGE_DECRYPT_FRITZOS_CFG
	prompt "Crypto library"
	default FREETZ_PACKAGE_DECRYPT_FRITZOS_CFG_NETTLE

	config FREETZ_PACKAGE_DECRYPT_FRITZOS_CFG_NETTLE
		bool "Nettle"
		select FREETZ_LIB_libnettle if FREETZ_PACKAGE_DECRYPT_FRITZOS_CFG_ALL_DYN

	config FREETZ_PACKAGE_DECRYPT_FRITZOS_CFG_OPENSSL
		bool "OpenSSL"
		select FREETZ_LIB_libcrypto if FREETZ_PACKAGE_DECRYPT_FRITZOS_CFG_ALL_DYN
endchoice

choice
	depends on FREETZ_PACKAGE_DECRYPT_FRITZOS_CFG
	prompt "Link"
	default FREETZ_PACKAGE_DECRYPT_FRITZOS_CFG_CRYPTO_STAT

	config FREETZ_PACKAGE_DECRYPT_FRITZOS_CFG_ALL_DYN
		bool "all libraries dynamically"

	config FREETZ_PACKAGE_DECRYPT_FRITZOS_CFG_CRYPTO_STAT
		bool "crypto libraries statically"

	config FREETZ_PACKAGE_DECRYPT_FRITZOS_CFG_ALL_STAT
		bool "all libraries statically"
endchoice

menu "symlinks to create for faster access to contained tools"
	depends on FREETZ_PACKAGE_DECRYPT_FRITZOS_CFG

# Freetz alias for decode_secrets
config FREETZ_PACKAGE_DECRYPT_FRITZOS_CFG_decrypt_fritzos_cfg
	bool
	default y

config FREETZ_PACKAGE_DECRYPT_FRITZOS_CFG_checksum
	bool "checksum              - compute the checksum of an export file"
	help
		This program computes the CRC-32 value for a FRITZ!OS export file.

config FREETZ_PACKAGE_DECRYPT_FRITZOS_CFG_decode_secrets
	bool "decode_secrets        - decrypt ciphertext values"
	default n
	help
		This is a filter and copies all data from STDIN to STDOUT while decryptable
		cipher-text occurrences are replaced with their clear-text values.

config FREETZ_PACKAGE_DECRYPT_FRITZOS_CFG_decode_export
	bool "decode_export         - decrypt settings export files"
	default n
	help
		This is a filter and copies all data from STDIN to STDOUT while decryptable
		cipher-text occurrences are replaced with their clear-text values.
		It's a replacement for 'decode_secrets' with automatic handling of the special
		encryption for the export password.

config FREETZ_PACKAGE_DECRYPT_FRITZOS_CFG_split_export
	bool "split_export          - split an export file into sub-files, a single file for each settings file"
	default n
	help
		This program splits a single export file into the settings files contained therein.

config FREETZ_PACKAGE_DECRYPT_FRITZOS_CFG_decode_cryptedbinfile
	bool "decode_cryptedbinfile - decrypt data portion of encrypted file sections within an export file"
	default n
	help
		This is a filter and decrypts the content (hexadecimal strings) from a CRYPTEDBINFILE
		entry in an exported settings file.

config FREETZ_PACKAGE_DECRYPT_FRITZOS_CFG_decode_secret
	bool "decode_secret         - decrypt a single value"
	default n
	help
		This function expects the encrypted data and the key as command line arguments.

config FREETZ_PACKAGE_DECRYPT_FRITZOS_CFG_user_password
	bool "user_password         - create a decryption key from a specified password"

config FREETZ_PACKAGE_DECRYPT_FRITZOS_CFG_device_password
	bool "device_password       - create a decryption key from specified device properties"

config FREETZ_PACKAGE_DECRYPT_FRITZOS_CFG_password_from_device
	bool "password_from_device  - create a decryption key from device properties"

config FREETZ_PACKAGE_DECRYPT_FRITZOS_CFG_privatekeypassword
	bool "privatekeypassword    - compute the private key used for '/var/flash/websrv_ssl_key.pem'"
	help
		This program computes the secret key used to encrypt the file '/var/flash/websrv_ssl_key.pem'.


config FREETZ_PACKAGE_DECRYPT_FRITZOS_CFG_HEXUTIL
	bool "hexdec/hexenc         - convert from hexadecimal to binary and vice versa"
	select FREETZ_PACKAGE_DECRYPT_FRITZOS_CFG_hexdec
	select FREETZ_PACKAGE_DECRYPT_FRITZOS_CFG_hexenc

config FREETZ_PACKAGE_DECRYPT_FRITZOS_CFG_hexdec
	bool
config FREETZ_PACKAGE_DECRYPT_FRITZOS_CFG_hexenc
	bool

config FREETZ_PACKAGE_DECRYPT_FRITZOS_CFG_B64UTIL
	bool "b64dec/b64enc         - convert from Base64 to binary and vice versa"
	select FREETZ_PACKAGE_DECRYPT_FRITZOS_CFG_b64dec
	select FREETZ_PACKAGE_DECRYPT_FRITZOS_CFG_b64enc

config FREETZ_PACKAGE_DECRYPT_FRITZOS_CFG_b64dec
	bool
config FREETZ_PACKAGE_DECRYPT_FRITZOS_CFG_b64enc
	bool

config FREETZ_PACKAGE_DECRYPT_FRITZOS_CFG_B32UTIL
	bool "b32dec/b32enc         - convert from Base32 to binary and vice versa"
	select FREETZ_PACKAGE_DECRYPT_FRITZOS_CFG_b32dec
	select FREETZ_PACKAGE_DECRYPT_FRITZOS_CFG_b32enc

config FREETZ_PACKAGE_DECRYPT_FRITZOS_CFG_b32dec
	bool
config FREETZ_PACKAGE_DECRYPT_FRITZOS_CFG_b32enc
	bool

endmenu

config FREETZ_PACKAGE_DECRYPT_FRITZOS_CFG_allcfgconv_c
	bool "allcfgconv-c - allcfgconv with decryption support"
	depends on FREETZ_PACKAGE_DECRYPT_FRITZOS_CFG && !FREETZ_AVM_HAS_ALLCFGCONV_WITH_DECRYPTION_SUPPORT
	default n
	help
		allcfgconv-c is a wrapper script for the AVM's allcfgconv utility
		which readds password decryption capabilities (removed by AVM
		some Fritz!OS versions ago) back to it.

		The main purpose of this script is to simplify the migration of
		the tools used allcfgconv so far and relied on this functionality.

		Just replace all invocations of allcfgconv with allcfgconv-c,
		and that's it.
```

## make/digitemp/Config.in
```kconfig
config FREETZ_PACKAGE_DIGITEMP
	bool "DigiTemp 3.7.2 (binary only)"
	default n
	help
		digitemp for 1-wire modules

		You could use RRDstats for data collection and visualisation

comment "CAUTION: Use 'replace kernel' to avoid mem leak!"
	depends on FREETZ_PACKAGE_DIGITEMP && FREETZ_KERNEL_VERSION_2_6_19 && !FREETZ_REPLACE_KERNEL

choice
	prompt "digitemp"
	default FREETZ_PACKAGE_DIGITEMP_DS9097
	depends on FREETZ_PACKAGE_DIGITEMP
	help
		digitemp for 1-wire modules

config FREETZ_PACKAGE_DIGITEMP_DS2490
	select FREETZ_LIB_libusb_0
	bool "digitemp for ds2490 (USB)"

config FREETZ_PACKAGE_DIGITEMP_DS9097U
	bool "digitemp for ds9097u"

config FREETZ_PACKAGE_DIGITEMP_DS9097
	bool "digitemp for ds9097"

endchoice
```

## make/dns2tcp/Config.in
```kconfig
config FREETZ_PACKAGE_DNS2TCP
	bool "dns2tcp 0.5 (binary only)"
	select FREETZ_LIB_libcrypto if ! FREETZ_PACKAGE_DNS2TCP_STATIC
	default n
	help
		Dns2tcp is a network tool designed to relay TCP connections
		through DNS traffic. Encapsulation is done on the TCP level,
		thus no specific driver is needed (i.e: TUN/TAP).

config FREETZ_PACKAGE_DNS2TCP_STATIC
	bool "Statically link libraries"
	depends on FREETZ_PACKAGE_DNS2TCP
	default n
	help
		Build dns2tcp binary with statically linked libraries.
```

## make/dnscrypt-proxy/Config.in
```kconfig
config FREETZ_PACKAGE_DNSCRYPT_PROXY
	bool "dnscrypt 1.6.1 (binary only)"
	select FREETZ_LIB_libsodium
	default n
	help
		DNSCrypt is a protocol that authenticates communications between a DNS client
		and a DNS resolver. It prevents DNS spoofing. It uses cryptographic signatures
		to verify that responses originate from the chosen DNS resolver and haven't
		been tampered with.

config FREETZ_PACKAGE_DNSCRYPT_PROXY_RESOLVERS
	bool "install resolvers list"
	depends on FREETZ_PACKAGE_DNSCRYPT_PROXY
	default y
	help
		Install dnscrypt-resolvers.csv to /usr/share/dnscrypt-proxy/dnscrypt-resolvers.csv
```

## make/dnsd-cgi/Config.in
```kconfig
config FREETZ_PACKAGE_DNSD_CGI
	bool "dnsd-cgi"
	depends on FREETZ_REPLACE_BUSYBOX
	select FREETZ_BUSYBOX_DNSD
	default n
	help
		WebIF for dnsd (busybox applet)
```

## make/dnsmasq/Config.in
```kconfig
config FREETZ_PACKAGE_DNSMASQ
	bool "Dnsmasq 2.81"
	depends on FREETZ_TARGET_IPV6_SUPPORT
	default n
	help
		Combined DHCP, DNS and TFTP server.

config FREETZ_PACKAGE_DNSMASQ_WITH_DNSSEC
	bool "Enable DNSSEC support"
	depends on FREETZ_PACKAGE_DNSMASQ
	default n
	help
		Build with DNSSEC support enabled.

comment "HINT: Don't forget to enable a dns/dhcp server."
depends on FREETZ_PACKAGE_DNSMASQ && \
	( FREETZ_AVMDAEMON_DISABLE_DNS || FREETZ_AVMDAEMON_DISABLE_DHCP )

config FREETZ_PACKAGE_DNSMASQ_DISABLE_DNS
	bool "Disable multid's DNS"
	depends on FREETZ_PACKAGE_DNSMASQ
	select FREETZ_AVMDAEMON_DISABLE_MULTIDPORTS
	select FREETZ_AVMDAEMON_DISABLE_DNS
	select FREETZ_AVMDAEMON_DISABLE_LLMNR
	default y
	help
		This selects the remapping of multid's DNS (and LLMNR) ports.

config FREETZ_PACKAGE_DNSMASQ_DISABLE_DHCP
	bool "Disable multid's DHCP"
	depends on FREETZ_PACKAGE_DNSMASQ
	select FREETZ_AVMDAEMON_DISABLE_MULTIDPORTS
	select FREETZ_AVMDAEMON_DISABLE_DHCP
	default y
	help
		This selects the remapping of multid's DHCP port.
```

## make/dosfstools/Config.in
```kconfig
config FREETZ_PACKAGE_DOSFSTOOLS
	bool "dosfstools 3.0.9"
	default n
	help
		utilities to create, check and label MS-DOS FAT filesystems

config FREETZ_PACKAGE_DOSFSTOOLS_DOSFSCK
	bool "check"
	depends on FREETZ_PACKAGE_DOSFSTOOLS
	default n
	help
		This option enables the checking utility for MS-DOS FAT filesystems

config FREETZ_PACKAGE_DOSFSTOOLS_DOSFSLABEL
	bool "label"
	depends on FREETZ_PACKAGE_DOSFSTOOLS
	default n
	help
		This option enables labeling utility for MS-DOS FAT filesystems

config FREETZ_PACKAGE_DOSFSTOOLS_MKDOSFS
	bool "create"
	depends on FREETZ_PACKAGE_DOSFSTOOLS
	default n
	help
		This option enables the creation utility for MS-DOS FAT filesystems
```

## make/downloader/Config.in
```kconfig
config FREETZ_PACKAGE_DOWNLOADER
	bool "Downloader CGI"
	default n
	help
		Download files from HTTP or FTP server during the boot process.

		This is particularly useful for binary packages which do not fit into
		the firmware image, but should be used on the box anyway. As long as
		they fit into the RAM disk this solution helps to automate the
		downloads and keeps them out of debug.cfg.

		by hermann72pb (ip-phone-forum.de)
		Support thread: http://www.ip-phone-forum.de/showthread.php?t=134934
```

## make/dropbear/Config.in
```kconfig
config FREETZ_PACKAGE_DROPBEAR
	bool "Dropbear 0.52"
	select FREETZ_LIB_libutil
	select FREETZ_PACKAGE_AUTHORIZED_KEYS
	select FREETZ_REPLACE_KERNEL if FREETZ_TYPE_SPEEDPORT_W501V
	default n
	help
		Dropbear SSH server and client

		Dropbear is a relatively small SSH 2 server and client. It runs on a
		variety of POSIX-based platforms. Dropbear is open source software,
		distributed under a MIT-style license. Dropbear is particularly useful
		for "embedded"-type Linux (or other Unix) systems, such as wireless
		routers.

		Features
		  - A small memory footprint suitable for memory-constrained
		    environments - Dropbear can compile to a 110kB statically linked
		    binary with uClibc on x86 (only minimal options selected)
		  - Dropbear server implements X11 forwarding, and authentication-agent
		    forwarding for OpenSSH clients
		  - Can run from inetd or standalone
		  - Compatible with OpenSSH ~/.ssh/authorized_keys public key
		    authentication
		  - The server, client, keygen, and key converter can be compiled into a
		    single binary (a la busybox)
		  - Features can easily be disabled when compiling to save space
		    TCP forwarding support 

config FREETZ_PACKAGE_DROPBEAR_SERVER_ONLY
	bool "Without scp & ssh client"
	depends on FREETZ_PACKAGE_DROPBEAR
	default n

config FREETZ_PACKAGE_DROPBEAR_WITH_ZLIB
	bool "With zlib Compression"
	depends on FREETZ_PACKAGE_DROPBEAR
	select FREETZ_LIB_libz
	default n
	help
		ZLIB Compression for SSH Traffic

config FREETZ_PACKAGE_DROPBEAR_DISABLE_HOST_LOOKUP
	bool "Disable DNS reverse-lookup of the client"
	depends on FREETZ_PACKAGE_DROPBEAR 
	default y
	help
		With this option, a connection between the client and
		the server is established faster.	

		Without this option selected, the ssh server performs a DNS
		reverse lookup of the client's IP address.
```

## make/dtmfbox-cgi/Config.in
```kconfig
config FREETZ_PACKAGE_DTMFBOX_CGI
	depends on FREETZ_PACKAGE_DTMFBOX
	bool "dtmfbox-cgi"
	default n
	help
		Web configuration interface for DTMFBOX

config FREETZ_PACKAGE_DTMFBOX_WITH_WEBPHONE
        bool "Webphone Applet (beta)"
        depends on FREETZ_PACKAGE_DTMFBOX_CGI
        default y
        help
                Java Applet to make phone calls over webinterface.
                Beta!!

config FREETZ_PACKAGE_DTMFBOX_WITH_HELP
        bool "Help"
        depends on FREETZ_PACKAGE_DTMFBOX_CGI
        default y
        help
                Include online help
```
