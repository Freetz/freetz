## make/dvbsnoop/Config.in
```kconfig
config FREETZ_PACKAGE_DVBSNOOP
	bool "dvbsnoop 1.4.50 (binary only)"
	default n
	help
		DVB analyzer / MPEG analyzer program to monitor, analyze, debug, dump
		or view dvb/mpeg/dsm-cc/mhp stream information (TS, PES, SECTION) (e.g.
		digital television) send via satellite, cable or terrestrial.
```

## make/e2fsprogs/Config.in
```kconfig
config FREETZ_PACKAGE_E2FSPROGS
	bool "e2fsprogs 1.41.9 (binary only)"
	default n
	help
		This package contains essential ext2, ext3 and ext4 filesystem
		utilities which consists of e2fsck, mke2fs, debugfs, dumpe2fs,
		tune2fs, and most of the other core ext2 filesystem utilities.
		Homepage: http://e2fsprogs.sourceforge.net/

config FREETZ_PACKAGE_E2FSPROGS_STATIC
	bool "link all e2fsprog-libraries statically"
	default y
	depends FREETZ_PACKAGE_E2FSPROGS
	help
		This option causes all e2fsprog-libraries to be linked in statically.
		Other libraries, e.g. libuClibc, libgcc, are still linked in dynamically.

		Deactivating this option causes dynamic versions of all e2fsprog-libraries
		to be created and copied into the image. By using dynamic libraries you
		can save upto 650KB (uncompressed) in the image provided you include more
		than one tool in it, that is by including only one tool you don't save
		anything, the image may even become bigger (and it actually does).

		NB: Once again for those who don't read long explanations, DON'T deactivate
		this option, if e2fsck is the only tool you actually include in the image.

config FREETZ_PACKAGE_E2FSPROGS_E2FSCK
	bool "e2fsck"
	default y
	depends FREETZ_PACKAGE_E2FSPROGS
	select FREETZ_LIB_libblkid if ! FREETZ_PACKAGE_E2FSPROGS_STATIC
	select FREETZ_LIB_libcom_err if ! FREETZ_PACKAGE_E2FSPROGS_STATIC
	select FREETZ_LIB_libe2p if ! FREETZ_PACKAGE_E2FSPROGS_STATIC
	select FREETZ_LIB_libext2fs if ! FREETZ_PACKAGE_E2FSPROGS_STATIC
	select FREETZ_LIB_libuuid if ! FREETZ_PACKAGE_E2FSPROGS_STATIC
	help
		Copy e2fsck to image

config FREETZ_PACKAGE_E2FSPROGS_E2MAKING
	bool "Making tools"
	default y
	depends FREETZ_PACKAGE_E2FSPROGS
	select FREETZ_LIB_libblkid if ! FREETZ_PACKAGE_E2FSPROGS_STATIC
	select FREETZ_LIB_libcom_err if ! FREETZ_PACKAGE_E2FSPROGS_STATIC
	select FREETZ_LIB_libe2p if ! FREETZ_PACKAGE_E2FSPROGS_STATIC
	select FREETZ_LIB_libext2fs if ! FREETZ_PACKAGE_E2FSPROGS_STATIC
	select FREETZ_LIB_libuuid if ! FREETZ_PACKAGE_E2FSPROGS_STATIC
	help
		Copy mke2fs and mklost+found to image

config FREETZ_PACKAGE_E2FSPROGS_E2TUNING
	bool "Tuning tools"
	default y
	depends FREETZ_PACKAGE_E2FSPROGS
	select FREETZ_LIB_libblkid if ! FREETZ_PACKAGE_E2FSPROGS_STATIC
	select FREETZ_LIB_libcom_err if ! FREETZ_PACKAGE_E2FSPROGS_STATIC
	select FREETZ_LIB_libe2p if ! FREETZ_PACKAGE_E2FSPROGS_STATIC
	select FREETZ_LIB_libext2fs if ! FREETZ_PACKAGE_E2FSPROGS_STATIC
	select FREETZ_LIB_libuuid if ! FREETZ_PACKAGE_E2FSPROGS_STATIC
	help
		Copy tune2fs, chattr, lsattr and dumpe2fs to image

config FREETZ_PACKAGE_E2FSPROGS_E2DEBUG
	bool "Debugging tools"
	default n
	depends FREETZ_PACKAGE_E2FSPROGS
	select FREETZ_LIB_libblkid if ! FREETZ_PACKAGE_E2FSPROGS_STATIC
	select FREETZ_LIB_libcom_err if ! FREETZ_PACKAGE_E2FSPROGS_STATIC
	select FREETZ_LIB_libe2p if ! FREETZ_PACKAGE_E2FSPROGS_STATIC
	select FREETZ_LIB_libext2fs if ! FREETZ_PACKAGE_E2FSPROGS_STATIC
	select FREETZ_LIB_libss if ! FREETZ_PACKAGE_E2FSPROGS_STATIC
	select FREETZ_LIB_libuuid if ! FREETZ_PACKAGE_E2FSPROGS_STATIC
	help
		Copy e2image, e2undo, debugfs and logsave to image

config FREETZ_PACKAGE_E2FSPROGS_BLKID
	bool "blkid"
	default n
	depends FREETZ_PACKAGE_E2FSPROGS
	select FREETZ_LIB_libblkid if ! FREETZ_PACKAGE_E2FSPROGS_STATIC
	select FREETZ_LIB_libext2fs if ! FREETZ_PACKAGE_E2FSPROGS_STATIC
	help
		Copy blkid to image

config FREETZ_PACKAGE_E2FSPROGS_E2FIXING
	bool "Repair and misc. tools"
	default n
	depends FREETZ_PACKAGE_E2FSPROGS
	select FREETZ_PACKAGE_E2FSPROGS_BLKID
	select FREETZ_LIB_libext2fs if ! FREETZ_PACKAGE_E2FSPROGS_STATIC
	select FREETZ_LIB_libcom_err if ! FREETZ_PACKAGE_E2FSPROGS_STATIC
	select FREETZ_LIB_libuuid if ! FREETZ_PACKAGE_E2FSPROGS_STATIC
	help
		Copy badblocks, filefrag, uuidd and uuidgen to image
```

## make/emailrelay/Config.in
```kconfig
config FREETZ_PACKAGE_EMAILRELAY
	bool "E-MailRelay 1.9"
	select FREETZ_STDCXXLIB_FORCE_GNULIBSTDCXX
	select FREETZ_LIB_libcrypto
	select FREETZ_LIB_libssl
	select FREETZ_LIB_libz
	select FREETZ_LIB_STDCXXLIB
	default n
	help
		E-MailRelay is a simple store-and-forward message
		transfer agent and proxy server. It runs on Unix-like
		operating systems (including Linux), and on Windows.

		When used as proxy server the E-MailRelay program
		(emailrelay) runs in the background and accepts e-mail
		from local e-mail client programs (KMail, Outlook etc.)
		or from the outside world, using the SMTP protocol. As
		soon as an e-mail message is received it is forwarded
		on to the next SMTP server for onward delivery. This
		becomes more useful when you add in your own message
		processing: as each message is received it can be passed
		one of your programs for editing, filtering, encrypting etc.

		When used as a store-and-forward transfer agent E-Mail-
		Relay runs in two modes: the storage daemon part, and the
		forwarding agent. The storage daemon waits for incoming
		mail and stores anything it receives in a spool directory.
		As a forwarding agent E-MailRelay pulls messages out
		of the	spool directory and passes them on to a remote
		server -- perhaps your ISP mail server.
		E-MailRelay can also run as a POP3 server so that e-mail
		client programs can read the spooled messages.
```

## make/espeak/Config.in
```kconfig
config FREETZ_PACKAGE_ESPEAK
	bool "eSpeak 1.48.04 (binary only)"
	select FREETZ_LIB_libm if FREETZ_TARGET_UCLIBC_HAS_multiple_libs
	select FREETZ_LIB_STDCXXLIB
	default n
	help
		eSpeak is a compact open source software speech
		synthesizer for English and other languages.

config FREETZ_PACKAGE_ESPEAK_ALL_LANGUAGES
	bool "all languages"
	depends on FREETZ_PACKAGE_ESPEAK
	default n
	help
		By default only german language is available.
```

## make/ffmpeg/Config.in
```kconfig
config FREETZ_PACKAGE_FFMPEG
	bool "FFmpeg 4.4.2"
	default n
	help
		FFmpeg is a complete, cross-platform solution to record,
		convert and stream audio and video.

if FREETZ_PACKAGE_FFMPEG

config FREETZ_PACKAGE_FFMPEG_ffmpeg
	bool "Include ffmpeg"
	select FREETZ_LIB_libdl       if FREETZ_TARGET_UCLIBC_HAS_multiple_libs
	select FREETZ_LIB_libm        if FREETZ_TARGET_UCLIBC_HAS_multiple_libs
	select FREETZ_LIB_libpthread  if FREETZ_TARGET_UCLIBC_HAS_multiple_libs
	select FREETZ_LIB_libavcodec
	select FREETZ_LIB_libavdevice
	select FREETZ_LIB_libavfilter
	select FREETZ_LIB_libavformat
	select FREETZ_LIB_libavutil
	select FREETZ_LIB_libpostproc
	select FREETZ_LIB_libswresample
	select FREETZ_LIB_libswscale
	default n

config FREETZ_PACKAGE_FFMPEG_ffserver
	bool "Include ffserver (FFmpeg streaming server)"
	select FREETZ_LIB_libdl       if FREETZ_TARGET_UCLIBC_HAS_multiple_libs
	select FREETZ_LIB_libm        if FREETZ_TARGET_UCLIBC_HAS_multiple_libs
	select FREETZ_LIB_libpthread  if FREETZ_TARGET_UCLIBC_HAS_multiple_libs
	select FREETZ_LIB_libavcodec
	select FREETZ_LIB_libavdevice
	select FREETZ_LIB_libavfilter
	select FREETZ_LIB_libavformat
	select FREETZ_LIB_libavutil
	select FREETZ_LIB_libpostproc
	select FREETZ_LIB_libswresample
	select FREETZ_LIB_libswscale
	select FREETZ_PACKAGE_FFMPEG_MUXER_ffm
	select FREETZ_PACKAGE_FFMPEG_DEMUXER_ffm
	select FREETZ_PACKAGE_FFMPEG_DEMUXER_rtsp
	select FREETZ_PACKAGE_FFMPEG_PROTOCOL_rtp
	default n

config FREETZ_PACKAGE_FFMPEG_EVERYTHING
	bool "everything"
	depends on !FREETZ_TARGET_UCLIBC_0_9_28
	depends on !FREETZ_TARGET_UCLIBC_0_9_29
	depends on FREETZ_OPENSSL_VERSION_1
	select FREETZ_LIB_liblzma
	select FREETZ_LIB_libopenjpeg
	default n

if !FREETZ_PACKAGE_FFMPEG_EVERYTHING

config FREETZ_PACKAGE_FFMPEG_PATENTED
	bool "Include patented codecs and technologies"
	default n

config FREETZ_PACKAGE_FFMPEG_LIBDLNA_SUPPORT
	bool "Include support for libdlna/ushare"
	depends on FREETZ_PACKAGE_FFMPEG_PATENTED
	select FREETZ_PACKAGE_FFMPEG_DECODER_ac3
	select FREETZ_PACKAGE_FFMPEG_DECODER_atrac3
	select FREETZ_PACKAGE_FFMPEG_DECODER_h264
	select FREETZ_PACKAGE_FFMPEG_DECODER_jpegls
	select FREETZ_PACKAGE_FFMPEG_DECODER_mp2
	select FREETZ_PACKAGE_FFMPEG_DECODER_mp3
	select FREETZ_PACKAGE_FFMPEG_DECODER_mpeg1video
	select FREETZ_PACKAGE_FFMPEG_DECODER_mpeg2video
	select FREETZ_PACKAGE_FFMPEG_DECODER_mpeg4
	select FREETZ_PACKAGE_FFMPEG_DECODER_mpegvideo
	select FREETZ_PACKAGE_FFMPEG_DECODER_wmav1
	select FREETZ_PACKAGE_FFMPEG_DECODER_wmav2
	select FREETZ_PACKAGE_FFMPEG_DECODER_png
	select FREETZ_PACKAGE_FFMPEG_DEMUXER_ac3
	select FREETZ_PACKAGE_FFMPEG_DEMUXER_avi
	select FREETZ_PACKAGE_FFMPEG_DEMUXER_h264
	select FREETZ_PACKAGE_FFMPEG_DEMUXER_matroska
	select FREETZ_PACKAGE_FFMPEG_DEMUXER_mp3
	select FREETZ_PACKAGE_FFMPEG_DEMUXER_mpegvideo
	select FREETZ_PACKAGE_FFMPEG_PROTOCOL_file
	default n

comment "Encoders ---"

config FREETZ_PACKAGE_FFMPEG_ENCODER_ac3
	bool "AC3"
	depends on FREETZ_PACKAGE_FFMPEG_PATENTED
	select FREETZ_PACKAGE_FFMPEG_PARSER_ac3

config FREETZ_PACKAGE_FFMPEG_ENCODER_jpegls
	bool "JPEG-LS"

config FREETZ_PACKAGE_FFMPEG_ENCODER_mjpeg
	bool "MJPEG"

config FREETZ_PACKAGE_FFMPEG_ENCODER_mpeg1video
	bool "MPEG-1 Video"

config FREETZ_PACKAGE_FFMPEG_ENCODER_mpeg2video
	bool "MPEG-2 Video"
	depends on FREETZ_PACKAGE_FFMPEG_PATENTED

config FREETZ_PACKAGE_FFMPEG_ENCODER_mpeg4
	bool "MPEG-4"
	depends on FREETZ_PACKAGE_FFMPEG_PATENTED

config FREETZ_PACKAGE_FFMPEG_ENCODER_pcm_s16be
	bool "PCM signed 16-bit big-endian"

config FREETZ_PACKAGE_FFMPEG_ENCODER_pcm_s16le
	bool "PCM signed 16-bit little-endian"

config FREETZ_PACKAGE_FFMPEG_ENCODER_png
	bool "PNG"
	select FREETZ_PACKAGE_FFMPEG_ENCODER_zlib

config FREETZ_PACKAGE_FFMPEG_ENCODER_vorbis
	bool "Vorbis"

config FREETZ_PACKAGE_FFMPEG_ENCODER_zlib
	bool "Zlib"

comment "Decoders ---"

config FREETZ_PACKAGE_FFMPEG_DECODER_aac
	bool "AAC (Advanced Audio Coding)"
	depends on FREETZ_PACKAGE_FFMPEG_PATENTED
	select FREETZ_PACKAGE_FFMPEG_PARSER_aac

config FREETZ_PACKAGE_FFMPEG_DECODER_ac3
	bool "AC3"
	depends on FREETZ_PACKAGE_FFMPEG_PATENTED
	select FREETZ_PACKAGE_FFMPEG_PARSER_ac3

config FREETZ_PACKAGE_FFMPEG_DECODER_atrac3
	bool "ATRAC3"
	depends on FREETZ_PACKAGE_FFMPEG_PATENTED

config FREETZ_PACKAGE_FFMPEG_DECODER_gif
	bool "GIF"

config FREETZ_PACKAGE_FFMPEG_DECODER_h264
	bool "H.264"
	depends on FREETZ_PACKAGE_FFMPEG_PATENTED

config FREETZ_PACKAGE_FFMPEG_DECODER_jpegls
	bool "JPEG-LS"

config FREETZ_PACKAGE_FFMPEG_DECODER_libopenjpeg
	bool "JPEG-2000"
	select FREETZ_LIB_libopenjpeg

config FREETZ_PACKAGE_FFMPEG_DECODER_mjpeg
	bool "MJPEG"

config FREETZ_PACKAGE_FFMPEG_DECODER_mjpegb
	bool "MJPEGB"

config FREETZ_PACKAGE_FFMPEG_DECODER_mp2
	bool "MP2 (MPEG Audio Layer 2)"
	depends on FREETZ_PACKAGE_FFMPEG_PATENTED

config FREETZ_PACKAGE_FFMPEG_DECODER_mp3
	bool "MP3 (MPEG Audio Layer 2)"
	depends on FREETZ_PACKAGE_FFMPEG_PATENTED

config FREETZ_PACKAGE_FFMPEG_DECODER_mpegvideo
	bool "MPEG Video"

config FREETZ_PACKAGE_FFMPEG_DECODER_mpeg1video
	bool "MPEG-1 Video"

config FREETZ_PACKAGE_FFMPEG_DECODER_mpeg2video
	bool "MPEG-2 Video"
	depends on FREETZ_PACKAGE_FFMPEG_PATENTED

config FREETZ_PACKAGE_FFMPEG_DECODER_mpeg4
	bool "MPEG-4"
	depends on FREETZ_PACKAGE_FFMPEG_PATENTED

config FREETZ_PACKAGE_FFMPEG_DECODER_pcm_s16be
	bool "PCM signed 16-bit big-endian"

config FREETZ_PACKAGE_FFMPEG_DECODER_pcm_s16le
	bool "PCM signed 16-bit little-endian"

config FREETZ_PACKAGE_FFMPEG_DECODER_png
	bool "PNG"
	select FREETZ_PACKAGE_FFMPEG_DECODER_zlib

config FREETZ_PACKAGE_FFMPEG_DECODER_vorbis
	bool "Vorbis"

config FREETZ_PACKAGE_FFMPEG_DECODER_wmav1
	bool "WMAv1"
	depends on FREETZ_PACKAGE_FFMPEG_PATENTED

config FREETZ_PACKAGE_FFMPEG_DECODER_wmav2
	bool "WMAv2"
	depends on FREETZ_PACKAGE_FFMPEG_PATENTED

config FREETZ_PACKAGE_FFMPEG_DECODER_zlib
	bool "Zlib"

comment "Muxers ---"

config FREETZ_PACKAGE_FFMPEG_MUXER_ac3
	bool "AC3"
	depends on FREETZ_PACKAGE_FFMPEG_PATENTED

config FREETZ_PACKAGE_FFMPEG_MUXER_avi
	bool "AVI"

config FREETZ_PACKAGE_FFMPEG_MUXER_ffm
	bool "FFM (ffserver live feed)"

config FREETZ_PACKAGE_FFMPEG_MUXER_flv
	bool "FLV"

config FREETZ_PACKAGE_FFMPEG_MUXER_h264
	bool "H.264"
	depends on FREETZ_PACKAGE_FFMPEG_PATENTED

config FREETZ_PACKAGE_FFMPEG_MUXER_matroska
	bool "MATROSKA"

config FREETZ_PACKAGE_FFMPEG_MUXER_mjpeg
	bool "MJPEG"

config FREETZ_PACKAGE_FFMPEG_MUXER_mov
	bool "MOV"

config FREETZ_PACKAGE_FFMPEG_MUXER_mp3
	bool "MP3 (MPEG Audio Layer 3)"

config FREETZ_PACKAGE_FFMPEG_MUXER_mp4
	bool "MP4"

config FREETZ_PACKAGE_FFMPEG_MUXER_mpeg1video
	bool "MPEG-1 Video"

config FREETZ_PACKAGE_FFMPEG_MUXER_mpeg2video
	bool "MPEG-2 Video"

config FREETZ_PACKAGE_FFMPEG_MUXER_mpegts
	bool "MPEG-2 (TS)"

config FREETZ_PACKAGE_FFMPEG_MUXER_ogg
	bool "Ogg"

config FREETZ_PACKAGE_FFMPEG_MUXER_rtp
	bool "RTP"

comment "Demuxers ---"

config FREETZ_PACKAGE_FFMPEG_DEMUXER_ac3
	bool "AC3"

config FREETZ_PACKAGE_FFMPEG_DEMUXER_avi
	bool "AVI"

config FREETZ_PACKAGE_FFMPEG_DEMUXER_ffm
	bool "FFM (ffserver live feed)"

config FREETZ_PACKAGE_FFMPEG_DEMUXER_flv
	bool "FLV"

config FREETZ_PACKAGE_FFMPEG_DEMUXER_h264
	bool "H.264"
	depends on FREETZ_PACKAGE_FFMPEG_PATENTED

config FREETZ_PACKAGE_FFMPEG_DEMUXER_image2
	bool "Image2"
	select FREETZ_PACKAGE_FFMPEG_DECODER_gif
	select FREETZ_PACKAGE_FFMPEG_DECODER_jpegls
	select FREETZ_PACKAGE_FFMPEG_DECODER_mjpeg
	select FREETZ_PACKAGE_FFMPEG_DECODER_mjpegb
	select FREETZ_PACKAGE_FFMPEG_DECODER_png
	# optional because of an extra library
	# select FREETZ_PACKAGE_FFMPEG_DECODER_libopenjpeg

config FREETZ_PACKAGE_FFMPEG_DEMUXER_matroska
	bool "MATROSKA"

config FREETZ_PACKAGE_FFMPEG_DEMUXER_mjpeg
	bool "MJPEG"

config FREETZ_PACKAGE_FFMPEG_DEMUXER_mov
	bool "MOV"

config FREETZ_PACKAGE_FFMPEG_DEMUXER_mp3
	bool "MP3 (MPEG Audio Layer 3)"

config FREETZ_PACKAGE_FFMPEG_DEMUXER_mpegvideo
	bool "MPEG Video"

config FREETZ_PACKAGE_FFMPEG_DEMUXER_mpegps
	bool "MPEG-2 (PS)"

config FREETZ_PACKAGE_FFMPEG_DEMUXER_mpegts
	bool "MPEG-2 (TS)"

config FREETZ_PACKAGE_FFMPEG_DEMUXER_ogg
	bool "Ogg"

config FREETZ_PACKAGE_FFMPEG_DEMUXER_rm
	bool "RM"

config FREETZ_PACKAGE_FFMPEG_DEMUXER_rtsp
	bool "RTSP"
	select FREETZ_PACKAGE_FFMPEG_DEMUXER_rm
	select FREETZ_PACKAGE_FFMPEG_DEMUXER_sdp

config FREETZ_PACKAGE_FFMPEG_DEMUXER_sdp
	bool "SDP"
	select FREETZ_PACKAGE_FFMPEG_DEMUXER_mpegts

comment "Parsers ---"

config FREETZ_PACKAGE_FFMPEG_PARSER_aac
	bool "AAC (Advanced Audio Coding)"
	depends on FREETZ_PACKAGE_FFMPEG_PATENTED

config FREETZ_PACKAGE_FFMPEG_PARSER_ac3
	bool "AC3"

config FREETZ_PACKAGE_FFMPEG_PARSER_h264
	bool "H.264"
	depends on FREETZ_PACKAGE_FFMPEG_PATENTED
	select FREETZ_PACKAGE_FFMPEG_DECODER_h264

config FREETZ_PACKAGE_FFMPEG_PARSER_mjpeg
	bool "MJPEG"
	select FREETZ_PACKAGE_FFMPEG_DECODER_mjpeg

config FREETZ_PACKAGE_FFMPEG_PARSER_mpegaudio
	bool "MPEG Audio"

config FREETZ_PACKAGE_FFMPEG_PARSER_mpegvideo
	bool "MPEG Video"

config FREETZ_PACKAGE_FFMPEG_PARSER_mpeg4video
	bool "MPEG-4 Video"

comment "Protocols ---"

config FREETZ_PACKAGE_FFMPEG_PROTOCOL_file
	bool "file:"

config FREETZ_PACKAGE_FFMPEG_PROTOCOL_http
	bool "http:"

config FREETZ_PACKAGE_FFMPEG_PROTOCOL_pipe
	bool "pipe:"

config FREETZ_PACKAGE_FFMPEG_PROTOCOL_rtp
	bool "rtp:"
	select FREETZ_PACKAGE_FFMPEG_PROTOCOL_udp

config FREETZ_PACKAGE_FFMPEG_PROTOCOL_tcp
	bool "tcp:"

config FREETZ_PACKAGE_FFMPEG_PROTOCOL_udp
	bool "udp:"

endif # !FREETZ_PACKAGE_FFMPEG_EVERYTHING

endif # FREETZ_PACKAGE_FFMPEG
```
