## make/fhem/Config.in
```kconfig
config FREETZ_PACKAGE_FHEM
	select FREETZ_PACKAGE_PERL
	select FREETZ_BUSYBOX_START_STOP_DAEMON
	select FREETZ_BUSYBOX_FEATURE_START_STOP_DAEMON_FANCY
	bool "fhem -r16562 (5.8)"
	
	default n
	help
		fhem is a perl server for house automation,
		see web page http://fhem.de

if FREETZ_PACKAGE_FHEM

config FREETZ_PACKAGE_FHEM_WITH_STV
	bool "Enable STV module"
	select FREETZ_PACKAGE_PYTHON_SAMSUNGCTL
	default n
	help
		Enables the STV modul, ou might have to register.

config FREETZ_PACKAGE_FHEM_WITH_STV_IP
	string "enter ip address of samsung tv"
	default "192.168."
	help
		Patch ip address of samsung tv in regapp.pl to register
		samsungctl remote control to use with 70_STV.pm

endif # FREETZ_PACKAGE_FHEM
```

## make/firewall-cgi/Config.in
```kconfig
config DS_PACKAGE_FIREWALL_CGI
	bool "Firewall-CGI 0.5.2"
	default n

	# Be visible only if iptables is selected
	requires DS_PACKAGE_IPTABLES

	# Activate group menus for modules and libs before selecting sub-entries
	select DS_PACKAGE_IPTABLES_KERNEL_MODULES
	select DS_PACKAGE_IPTABLES_SHARED_LIBS

	# Kernel modules	
	select DS_MODULE_ip_tables
	select DS_MODULE_ip_conntrack
	select DS_MODULE_ip_conntrack_ftp
	select DS_MODULE_iptable_filter
	select DS_MODULE_ipt_iprange
	select DS_MODULE_ipt_LOG
	select DS_MODULE_ipt_mac
	select DS_MODULE_ipt_multiport
	select DS_MODULE_ipt_state

	# Shared libs
	select DS_LIB_libipt_iprange
	select DS_LIB_libipt_LOG
	select DS_LIB_libipt_mac
	select DS_LIB_libipt_multiport
	select DS_LIB_libipt_standard
	select DS_LIB_libipt_state
	select DS_LIB_libipt_tcp
	select DS_LIB_libipt_udp

	help
		Configuration front-end to iptables

		Note: This package is only selectable if iptables has been activated,
		otherwise it would not make sense to have a web configuration for it.
```

## make/fortune/Config.in
```kconfig
config FREETZ_PACKAGE_FORTUNE
	bool "fortune 1.2"
	default n
	help
		Fortune is a small game that is meant to lighten up your life.
		It can be used to display a random entry from a cookie file.

		After having installed the package, just put some fortune-
		files into a directory and create a symbolic link to
		/var/media/fortunes like this:
		ln -s /var/media/ftp/ExternalDisk/fortunes/ /var/media/fortunes

		For your convenience I have packed some fortune-files up and
		uploaded them here:
		http://homepages.tu-darmstadt.de/~pkrueger/fortunes.7z

		If you'd rather get your own files, you could start looking here:
		http://www.freebsd.org/cgi/cvsweb.cg...tune/datfiles/
```

## make/fstyp/Config.in
```kconfig
config DS_PACKAGE_FSTYP
	bool "fstyp 0.1 (binary only)"
	default n
	help
		fstyp can be used to heuristically detect which filesystem type a block
		device contains.
```

## make/fuse/Config.in
```kconfig
config FREETZ_PACKAGE_FUSE
	bool "FUSE (binary only)"
	depends on FREETZ_REPLACE_MODULE_AVAILABLE
	select FREETZ_MODULE_fuse
	select FREETZ_LIB_libfuse
	default n
	help
		Filesystem in Userspace (FUSE) is a free Unix kernel module that allows
		non-privileged users to create their own file systems without the need
		to write any kernel code. This is achieved by running the file
		systemcode in user space, while the FUSE module only provides a "bridge"
		to the actual kernel interfaces. FUSE was officially merged into the
		mainstream Linux kernel tree in kernel version 2.6.14.

		FUSE is particularly useful for writing virtual file systems. Unlike
		traditional filesystems which essentially save data to and retrieve data
		from disk, virtual filesystems do not actually store data themselves.
		They act as a view or translation of an existing filesystem or storage
		device. In principle, any resource available to FUSE implementation can
		be exported as a file system.

		In Freetz, the NTFS package depends on fuse, for example.

if FREETZ_PACKAGE_FUSE || FREETZ_LIB_libfuse

config FREETZ_PACKAGE_FUSE_VERSION_2_7
	bool
	depends on FREETZ_KERNEL_VERSION_2_6_13_MAX
	default y

config FREETZ_PACKAGE_FUSE_VERSION_2_9
	bool
	depends on FREETZ_KERNEL_VERSION_2_6_19_MIN
	default y

endif
```

## make/gdb/Config.in
```kconfig
config FREETZ_PACKAGE_GDB
	bool "GNU debugger gdb"

menu "binaries"
	depends on FREETZ_PACKAGE_GDB

config FREETZ_PACKAGE_GDB_GDB
	bool "Build gdb for target"
	select FREETZ_LIB_libdl
	select FREETZ_LIB_libm
	select FREETZ_LIB_libncurses
	select FREETZ_LIB_libreadline
	default n
	help
		Build the full gdb debugger to run on the target.

config FREETZ_PACKAGE_GDB_GDBSERVER
	bool "Build gdb server for target"
	select FREETZ_LIB_libthread_db
	default n
	help
		Build the gdbserver stub to run on the target.
		Full gdb is needed to debug a program.

config FREETZ_PACKAGE_GDB_HOST
	bool "Build gdb for host"
	default n
	help
		Build gdb to run on the host to debug programs run on the target.

endmenu

choice
depends on FREETZ_PACKAGE_GDB
	prompt "version"
	default FREETZ_GDB_VERSION_7_6
	help
		Select the version of gdb you wish to use.

	config FREETZ_GDB_VERSION_6_8
		bool "gdb 6.8"

	config FREETZ_GDB_VERSION_7_6
		bool "gdb 7.6.2"
endchoice
```

## make/getdns/Config.in
```kconfig
config FREETZ_PACKAGE_GETDNS
	bool "getdns 1.4.2 (binary only)"
	select FREETZ_LIB_libpthread
	#
	select FREETZ_OPENSSL_VERSION_PROMPT
	select FREETZ_OPENSSL_VERSION_1_REQUIRED
	select FREETZ_LIB_libcrypto
	select FREETZ_LIB_libcrypto_WITH_EC
	select FREETZ_LIB_libssl
	#
	select FREETZ_LIB_libyaml
	default n
	help
		getdns/Stubby is an application that acts as a local DNS
		Privacy stub resolver (using DNS-over-TLS). Stubby encrypts
		DNS queries sent from a client machine (desktop or laptop)
		to a DNS Privacy resolver increasing end user privacy.
```

## make/git/Config.in
```kconfig
config FREETZ_PACKAGE_GIT
	bool "Git 2.38.0"
	select FREETZ_BUSYBOX_START_STOP_DAEMON
	select FREETZ_LIB_libpthread if FREETZ_TARGET_UCLIBC_HAS_multiple_libs
	select FREETZ_LIB_libcurl
	select FREETZ_LIB_libexpat
	select FREETZ_LIB_libiconv if FREETZ_TARGET_UCLIBC_0_9_28
	select FREETZ_LIB_libcrypto
	select FREETZ_LIB_libz
	default n
	help
		Git is a fast, scalable, distributed revision control system with an
		unusually rich command set that provides both high-level operations
		and full access to internals.

if FREETZ_PACKAGE_GIT

	config FREETZ_PACKAGE_GIT_REMOVE_WEBIF
		bool "remove webinterface"
		default n
		help
			This option removes the webinterface

	config FREETZ_PACKAGE_GIT_WITH_PCRE
		bool "build with pcre support"
		select FREETZ_LIB_libpcre
		default n
		help
			With this option enabled git-grep will be able to use
			Perl-compatible regular expressions (pcre).

			Note: git supports all kinds of POSIX regular expressions
			without libpcre. Most users want to say no here.

endif # FREETZ_PACKAGE_GIT
```

## make/gnu-make/Config.in
```kconfig
config FREETZ_PACKAGE_GNU_MAKE
	bool "GNU Make 4.2.1 (binary only)"
	default n
	help
		Make is a tool which controls the generation of executables and
		other non-source files of a program from the program's source files.
```

## make/gnutls/Config.in
```kconfig
config FREETZ_PACKAGE_GNUTLS
	bool "GnuTLS 3.6.16 (binary only)"
	select FREETZ_LIB_libgnutls
	default n
	help
		GnuTLS is a project that aims to develop a library which provides a
		secure layer, over a reliable transport layer. Currently the GnuTLS
		library implements TLS 1.3, 1.2, 1.1, 1.0 protocols and SSL 3.0.

config FREETZ_PACKAGE_GNUTLS_CERTTOOL
	bool "certtool"
	depends on FREETZ_PACKAGE_GNUTLS
	default n
	help
		Provides GnuTLS certtool utility.

config FREETZ_PACKAGE_GNUTLS_UTILS
	bool "utils"
	depends on FREETZ_PACKAGE_GNUTLS
	default n
	help
		Provides gnutls-cli, gnutls-serv, psktool and srptool utilities.
```

## make/gocr/Config.in
```kconfig
config FREETZ_PACKAGE_GOCR
	bool "gocr 0.49 (binary only)"
	select FREETZ_LIB_libnetpbm
	default n
	help
		GOCR is an optical character recognition program, released under
		the GNU General Public License. It reads images in many formats
		and outputs a text file.
```

## make/gptfdisk/Config.in
```kconfig
config FREETZ_PACKAGE_GPTFDISK
	bool "gptfdisk 1.0.1"
	select FREETZ_LIB_libm if FREETZ_TARGET_UCLIBC_HAS_multiple_libs
	select FREETZ_LIB_STDCXXLIB
	select FREETZ_LIB_libuuid
	default n
	help
		Interactive GUID partition table (GPT) manipulator
```

## make/gw6/Config.in
```kconfig
config FREETZ_PACKAGE_GW6
	bool "Gateway6 client"
	depends on FREETZ_TARGET_IPV6_SUPPORT
	select FREETZ_BUSYBOX_IP
	select FREETZ_BUSYBOX_FEATURE_IP_ADDRESS
	select FREETZ_LIB_libuClibc__
	default n
	help
		Client to build a tunnel to the ipv6 network (see http://go6.net).
		The binary will be installed as /usr/sbin/gw6c and CGI frontend
		will be provided for a simple configuration. A sample can be
		found in /usr/share/gw6/.
```

## make/haproxy/Config.in
```kconfig
config FREETZ_PACKAGE_HAPROXY
	bool "HAProxy 1.8.26"
	select FREETZ_LIB_libcrypt
	select FREETZ_BUSYBOX_START_STOP_DAEMON
	default n
	help
		haproxy is a loadbalancer.

config FREETZ_PACKAGE_HAPROXY_WITH_OPENSSL
	bool "with OpenSSL support"
	depends on FREETZ_PACKAGE_HAPROXY
	select FREETZ_LIB_libcrypto
	select FREETZ_LIB_libssl
	select FREETZ_OPENSSL_VERSION_PROMPT
	default n
	help
		This option enables SSL support in HAProxy.
```

## make/haserl/Config.in
```kconfig
config FREETZ_PACKAGE_HASERL
	bool "haserl 0.9.36 (binary only)"
	default y
	help
		Haserl is a small program that uses shell or Lua script to create
		cgi web scripts. It is intended for environments where PHP or ruby
		are too big. A typical use is to run cgi scripts in an embedded
		environment, using a small web server, such as mini-httpd, lighty,
		or the server built into busybox.
		This package is mandatory

config FREETZ_PACKAGE_HASERL_WITH_LUA
	bool "with lua support"
	depends on FREETZ_PACKAGE_HASERL
	select FREETZ_LIB_liblua
	default n
	help
		Build haserl with lua support.
```

## make/hd-idle/Config.in
```kconfig
config FREETZ_PACKAGE_HD_IDLE
	bool "hd-idle"
	default n
	depends on FREETZ_HAS_USB_HOST
#	select FREETZ_MODULE_scsi_mod
	help
		Another idle-daemon for attached hard drives if sg3utils doesn't
		work as expected. This can happen with most low-cost USB drives.
```

## make/hdparm/Config.in
```kconfig
config FREETZ_PACKAGE_HDPARM
	bool "hdparm 9.58 (binary only)"
	default n
	depends on FREETZ_AVM_HAS_USB_HOST
	help
		Hdparm can be used to show and set parameters of ATA-drives (e.g. hard disk drives). 
```

## make/hol/Config.in
```kconfig
config FREETZ_PACKAGE_HOL
	bool "Halt-On-Lan 0.1"
	default n
	select FREETZ_BUSYBOX_TELNET
	help
		Halt-On-Lan is a package to run predefined actions
		on a remote host: shutdown, reboot, logoff, lock
		For successfull action poweroff.exe from
		http://users.telenet.be/jbosman/poweroff/poweroff.htm
		or similar compatible script or binary must be installed
		and run as service on the remote host. Moreover, in case
		of requested interaction this service should understand
		the syntax of poweroff.exe
```

## make/html2text/Config.in
```kconfig
config FREETZ_PACKAGE_HTML2TEXT
	bool "html2text 1.3.2a (binary only)"
	select FREETZ_LIB_STDCXXLIB
	default n
	help
		html2text is a command line utility, written in C++, that converts
		HTML documents into plain text.
```
