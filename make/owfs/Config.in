## make/owfs/Config.in
```kconfig
comment "owfs (not available, needs kernel modules)"
	depends on !FREETZ_REPLACE_MODULE_AVAILABLE

config FREETZ_PACKAGE_OWFS
	bool "owfs 2.7p32 (binary only)"
	depends on FREETZ_REPLACE_MODULE_AVAILABLE
	select FREETZ_PACKAGE_FUSE
	select FREETZ_LIB_libusb_0
	select FREETZ_LIB_libm        if FREETZ_TARGET_UCLIBC_HAS_multiple_libs
	select FREETZ_LIB_libpthread  if FREETZ_TARGET_UCLIBC_HAS_multiple_libs
	default n
	help
		OWFS - 1-Wire Filesystem
		This package includes:
		- owserver for easy, world wide access to serial
		  and USB 1-wire bus masters and attached devices
		- httpd and ftpd to control owserver over http or ftp
		- shellprograms like owdir, owwrite, owread, owpresent
		  to control owserver via shell scripts
```

## make/pciutils/Config.in
```kconfig
config FREETZ_PACKAGE_PCIUTILS
	bool "pciutils 3.1.7 (binary only)"
	default n
	help
		The PCI Utilities are a collection of programs for inspecting
		and manipulating configuration of PCI devices, all based on a
		common portable library libpci which offers access to the PCI
		configuration space on a variety of operating systems.

		lspci displays detailed information about all PCI buses and
		devices in the system.

		setpci allows reading from and writing to PCI device
		configuration registers. For example, you can adjust the latency
		timers with it.

config FREETZ_PACKAGE_PCIUTILS_IDS
	bool "pci.ids"
	depends on FREETZ_PACKAGE_PCIUTILS
	default y
	help
		Add pci.ids file (~550 KB)
```

## make/pcsc-lite/Config.in
```kconfig
config FREETZ_PACKAGE_PCSC_LITE
	bool "pcscd 1.8.8 (binary only)"
	select FREETZ_LIB_libdl
	select FREETZ_LIB_libpthread
	select FREETZ_LIB_librt
	select FREETZ_LIB_libusb_1
	default n
	help
		The purpose of PCSC Lite is to provide a Windows(R)
		SCard interface in a very small form factor for
		communicating to smart cards and readers.
```

## make/perl/Config.in
```kconfig
menuconfig FREETZ_PACKAGE_PERL
	bool "Perl 5.32.1 (binary only)"
	default n
	help
		Perl without operating-specific functions such as readdir.

if FREETZ_PACKAGE_PERL

	config FREETZ_PACKAGE_PERL_MODULES
		string "Perl modules"
		default ""
		help
			List of perl modules to copy to the rootfs.
			E.g.
			warnings.pm warnings/register.pm strict.pm constant.pm vars.pm
			Exporter.pm Exporter/Heavy.pm Carp.pm Getopt/Long.pm

	config FREETZ_PACKAGE_PERL_ADDITIONAL_EXTRA_MODULES
		string "Cpan modules"
		default ""
		help
			List of extra perl modules from CPAN.
			E.g.
			Modul::Name

	comment " Add modules:"

	config FREETZ_PACKAGE_PERL_CLASSINSPECTOR
		bool "Class::Inspector"
		default y
		help
			Class::Inspector - Get information about a class and its structure

	config FREETZ_PACKAGE_PERL_CRYPTCBC
		bool "Crypt::CBC and Crypt::OpenSSL::AES"
		select FREETZ_PACKAGE_OPENSSL
		default y
		help
			Crypt::CBC - Encrypt Data with Cipher Block Chaining Mode
			Crypt::OpenSSL::AES - A Perl wrapper around OpenSSL's AES library

	config FREETZ_PACKAGE_PERL_CRYPTRIJNDAEL
		bool "Crypt::Rijndael"
		default y
		help
			Crypt::Rijndael - Crypt::CBC compliant Rijndael encryption module

	config FREETZ_PACKAGE_PERL_DATAUUID
		bool "Data::UUID"
		default y
		help
			Data::UUID - Globally/Universally Unique Identifiers (GUIDs/UUIDs)

	config FREETZ_PACKAGE_PERL_DBDSQLITE
		bool "DBD-SQLite"
		select FREETZ_PACKAGE_SQLITE
		default y
		help
			Add DBD-SQLite - Self-contained RDBMS in a DBI Driver.

	config FREETZ_PACKAGE_PERL_DBI
		bool "DBI"
		select FREETZ_PACKAGE_SQLITE
		default y
		help
			Add DBI - Database independent interface for Perl.

	config FREETZ_PACKAGE_PERL_ENCODELOCALE
		bool "Encode::Locale"
		default y
		help
			Encode::Locale - Determine the locale encoding

	config FREETZ_PACKAGE_PERL_HTMLPARSER
		bool "HTML-Parser"
		default y
		help
			HTML-Parser - distribution is is a collection of modules that parse and extract information from HTML documents

	config FREETZ_PACKAGE_PERL_HTTPCOOKIES
		bool "HTTP::Cookies"
		default y
		help
			HTTP::Cookies - HTTP cookie jars

	config FREETZ_PACKAGE_PERL_HTTPDAEMON
		bool "HTTP::Daemon"
		select FREETZ_PACKAGE_PERL_LWPMEDIATYPES
		default y
		help
			HTTP::Daemon - a simple http server class

	config FREETZ_PACKAGE_PERL_HTTPDATE
		bool "HTTP::Date"
		default y
		help
			HTTP::Date - date conversion routines

	config FREETZ_PACKAGE_PERL_HTTPMESSAGE
		bool "HTTP::Message"
		default y
		help
			HTTP::Message - HTTP style message (base class)

	config FREETZ_PACKAGE_PERL_HTTPNEGOTIATE
		bool "HTTP::Negotiate"
		default y
		help
			HTTP::Negotiate - choose a variant to serve

	config FREETZ_PACKAGE_PERL_IOHTML
		bool "IO::HTML"
		default y
		help
			IO::HTML - Open an HTML file with automatic charset detection

	config FREETZ_PACKAGE_PERL_IOINTERFACE
		bool "IO::Interface"
		default y
		help
			IO::Interface - Perl extension for access to network card configuration information

	config FREETZ_PACKAGE_PERL_IOSOCKETIP
		bool "IO::Socket::IP"
		default y
		help
			IO::Socket::IP - Family-neutral IP socket supporting both IPv4 and IPv6

	config FREETZ_PACKAGE_PERL_IOSOCKETSSL
		bool "IO::Socket::SSL"
		select FREETZ_PACKAGE_OPENSSL
		default y
		help
			Add IO::Socket::SSL -- Nearly transparent SSL encapsulation for IO::Socket::INET.

	config FREETZ_PACKAGE_PERL_LIBWWWPERL
		bool "libwww-perl"
		select FREETZ_PACKAGE_PERL_HTTPCOOKIES
		select FREETZ_PACKAGE_PERL_HTTPMESSAGE
		select FREETZ_PACKAGE_PERL_HTTPDATE
		select FREETZ_PACKAGE_PERL_TRYTINY
		select FREETZ_PACKAGE_PERL_HTTPDAEMON
		select FREETZ_PACKAGE_PERL_IOHTML
		select FREETZ_PACKAGE_PERL_NETHTTP
		select FREETZ_PACKAGE_PERL_HTTPNEGOTIATE
		default y
		help
			libwww-perl - The World-Wide Web library for Perl 

	config FREETZ_PACKAGE_PERL_LOCALECODES
		bool "Locale::Codes"
		default y
		help
			Locale::Codes - a distribution of modules to handle locale codes

	config FREETZ_PACKAGE_PERL_LWPMEDIATYPES
		bool "LWP::MediaTypes"
		default y
		help
			LWP::MediaTypes - guess media type for a file or a URL

	config FREETZ_PACKAGE_PERL_NETHTTP
		bool "Net::HTTP"
		default y
		help
			Net::HTTP - Low-level HTTP connection (client)

	config FREETZ_PACKAGE_PERL_NETSSLEY
		bool "Net::SSLEY"
		select FREETZ_PACKAGE_OPENSSL
		default y
		help
			Add Net:SSLEY -- High level functions for accessing web servers

	config FREETZ_PACKAGE_PERL_NETTELNET
		bool "Net::Telnet"
		default y
		help
			Net::Telnet - interact with TELNET port or other TCP ports

	config FREETZ_PACKAGE_PERL_PODSIMPLE
		bool "Pod::Simple"
		default y
		help
			Pod::Simple - framework for parsing Pod

	config FREETZ_PACKAGE_PERL_SCALARLISTUTILS
		bool "Scalar-List-Utils"
		default y
		help
			Scalar-List-Utils - This package contains a selection of subroutines that people have
			expressed would be nice to have in the perl core.

	config FREETZ_PACKAGE_PERL_SOAPLITE
		bool "SOAP::Lite"
		select FREETZ_PACKAGE_PERL_CLASSINSPECTOR
		default y
		help
			SOAP::Lite - Perl's Web Services Toolkit 

	config FREETZ_PACKAGE_PERL_TRYTINY
		bool "Try::Tiny"
		default y
		help
			Try::Tiny - Minimal try/catch with proper preservation of $@

	config FREETZ_PACKAGE_PERL_URIESCAPE
		bool "URI::Escape"
		default y
		help
			URI::Escape - Percent-encode and percent-decode unsafe characters.

	config FREETZ_PACKAGE_PERL_XMLNAMESPACESUPPORT
		bool "XML::NamespaceSupport"
		default y
		help
			XML::NamespaceSupport - A simple generic namespace processor

	config FREETZ_PACKAGE_PERL_XMLPARSER
		bool "XML::Parser"
		select FREETZ_PACKAGE_PERL_XMLSAXEXPAT
		default y
		help
			XML::Parser - A perl module for parsing XML documents

	config FREETZ_PACKAGE_PERL_XMLPARSERLITE
		bool "XML::Parser::Lite"
		default y
		help
			XML::Parser::Lite - Lightweight pure-perl XML Parser (based on regexps)

	config FREETZ_PACKAGE_PERL_XMLSIMPLE
		bool "XML::Simple"
		select FREETZ_PACKAGE_PERL_SCALARLISTUTILS
		select FREETZ_PACKAGE_PERL_XMLSAX
		select FREETZ_PACKAGE_PERL_XMLSAXEXPAT
		default y
		help
			XML::Simple - An API for simple XML files 

	config FREETZ_PACKAGE_PERL_XMLSAX
		bool "XML::SAX"
		select FREETZ_PACKAGE_PERL_XMLSAXBASE
		select FREETZ_PACKAGE_PERL_XMLNAMESPACESUPPORT
		default y
		help
			XML::SAX - Simple API for XML

	config FREETZ_PACKAGE_PERL_XMLSAXBASE
		bool "XML::SAX::Base"
		default y
		help
			XML::SAX::Base - Base class SAX Drivers and Filters 

	config FREETZ_PACKAGE_PERL_XMLSAXEXPAT
		bool "XML::SAX::Expat"
		default y
		help
			XML::SAX::Expat - SAX2 Driver for Expat (XML::Parser)

endif # FREETZ_PACKAGE_PERL
```

## make/phonebook-tools/Config.in
```kconfig
config FREETZ_PACKAGE_PHONEBOOK_TOOLS
	bool "Phone book tools"
	select FREETZ_BUSYBOX_GETOPT
	select FREETZ_BUSYBOX_GREP
	select FREETZ_BUSYBOX_FEATURE_GREP_EGREP_ALIAS
	select FREETZ_BUSYBOX_SED
	select FREETZ_BUSYBOX_TR
	default n
	help
		A set of tools for reading and converting Fritz!Box phone book
		to such (easy parseable) formats like:
		 - .csv (comma-separated values), or
		 - .tsv (tab-separated values).
```

## make/php/Config.in
```kconfig
config FREETZ_PACKAGE_PHP
	bool "PHP (binary only)"
	select FREETZ_PACKAGE_PHP_cgi
	default n
	help
		PHP: Hypertext Preprocessor

		PHP is a widely-used general-purpose scripting language that is especially
		suited for Web development and can be embedded into HTML. Much of its syntax
		is borrowed from C, Java and Perl with a couple of unique PHP-specific features
		thrown in. The goal of the language is to allow web developers to write
		dynamically generated pages quickly.

choice
	depends on FREETZ_PACKAGE_PHP
	prompt "version"
	default FREETZ_PHP_VERSION_5_5

	config FREETZ_PHP_VERSION_5_3
		bool "php 5.3.29"
	config FREETZ_PHP_VERSION_5_4
		bool "php 5.4.38"
	config FREETZ_PHP_VERSION_5_5
		bool "php 5.5.22"
endchoice

menu "Binaries"
depends on FREETZ_PACKAGE_PHP

config FREETZ_PACKAGE_PHP_cgi
	bool "PHP CGI"
	select FREETZ_LIB_libpcre if ! FREETZ_PACKAGE_PHP_STATIC
	default y

config FREETZ_PACKAGE_PHP_cli
	bool "PHP CLI"
	select FREETZ_LIB_libpcre if ! FREETZ_PACKAGE_PHP_STATIC
	default n

config FREETZ_PACKAGE_PHP_apxs2
	bool "Apache2 module"
	select FREETZ_LIB_libpcre
	select FREETZ_LIB_libcurl            if FREETZ_PACKAGE_PHP_WITH_CURL
	select FREETZ_LIB_libgd              if FREETZ_PACKAGE_PHP_WITH_GD
	select FREETZ_LIB_libiconv           if FREETZ_PACKAGE_PHP_WITH_LIBICONV
	select FREETZ_LIB_libsqlite3         if FREETZ_PACKAGE_PHP_WITH_SQLITE3
	select FREETZ_LIB_libcrypto          if FREETZ_PACKAGE_PHP_WITH_SSL
	select FREETZ_LIB_libssl             if FREETZ_PACKAGE_PHP_WITH_SSL
	select FREETZ_OPENSSL_VERSION_PROMPT if FREETZ_PACKAGE_PHP_WITH_SSL
	select FREETZ_LIB_libxml2            if FREETZ_PACKAGE_PHP_WITH_LIBXML
	select FREETZ_LIB_libz               if FREETZ_PACKAGE_PHP_WITH_ZLIB
	default n

endmenu

menu "PHP features"
depends on FREETZ_PACKAGE_PHP

config FREETZ_PACKAGE_PHP_WITH_CURL
	bool "build with CURL support"
	select FREETZ_LIB_libcurl if ! FREETZ_PACKAGE_PHP_STATIC
	default n
	help
		This option enables the CURL support for PHP

config FREETZ_PACKAGE_PHP_WITH_FILEINFO
	bool "build with FILEINFO support"
	default n
	help
		This option enables the FILEINFO support for PHP

config FREETZ_PACKAGE_PHP_WITH_GD
	bool "build with GD support"
	select FREETZ_LIB_libgd if ! FREETZ_PACKAGE_PHP_STATIC
	default n
	help
		This option enables the GD support for PHP

config FREETZ_PACKAGE_PHP_WITH_ICONV
	bool "build with ICONV support"
	select FREETZ_PACKAGE_PHP_WITH_LIBICONV if FREETZ_TARGET_UCLIBC_0_9_28
	default n
	help
		This option enables the ICONV support for PHP

config FREETZ_PACKAGE_PHP_WITH_LIBICONV
	depends on FREETZ_PACKAGE_PHP_WITH_ICONV
	bool "prefer libiconv to libc"
	select FREETZ_LIB_libiconv if ! FREETZ_PACKAGE_PHP_STATIC
	default n
	help
		This option causes PHP to use libiconv implementation of iconv function
		instead of the libc one. Select this option if you need more charsets
		than supported by libc (ISO-8859-1 and UTF-8 only) or your application
		relies on libiconv specific features like TRANSLIT, IGNORE, etc.

config FREETZ_PACKAGE_PHP_WITH_JSON
	bool "build with JSON support"
	default n
	help
		This option enables the JSON support for PHP

config FREETZ_PACKAGE_PHP_WITH_MEMORY_LIMIT
	bool "build with MEMORY_LIMIT support"
	default n
	help
		This option enables the MEMORY_LIMIT support for PHP

config FREETZ_PACKAGE_PHP_WITH_MHASH
	bool "build with MHASH support"
	default n
	help
		This option enables the MHASH support for PHP

config FREETZ_PACKAGE_PHP_WITH_PCNTL
	bool "build with PCNTL support"
	default n
	help
		This option enables the PCNTL support for PHP

config FREETZ_PACKAGE_PHP_WITH_SESSION
	bool "build with SESSION support"
	default n
	help
		This option enables the SESSION support for PHP

config FREETZ_PACKAGE_PHP_WITH_SOCKETS
	bool "build with SOCKETS support"
	default n
	help
		This option enables the SOCKETS support for PHP

config FREETZ_PACKAGE_PHP_WITH_SQLITE2
	bool "build with SQLite (v2) support"
	depends on FREETZ_PHP_VERSION_5_3
	default n
	help
		This option enables the SQLite (v2) support for PHP
		NB: SQLite v2 is somewhat deprecated. If you're developing
		a new application you probably don't want to activate this option.

config FREETZ_PACKAGE_PHP_WITH_SQLITE3
	bool "build with SQLite (v3) support"
	select FREETZ_LIB_libsqlite3 if ! FREETZ_PACKAGE_PHP_STATIC
	default n
	help
		This option enables the SQLite (v3) support for PHP

config FREETZ_PACKAGE_PHP_WITH_SSL
	bool "build with SSL support"
	select FREETZ_LIB_libcrypto if ! FREETZ_PACKAGE_PHP_STATIC
	select FREETZ_LIB_libssl if ! FREETZ_PACKAGE_PHP_STATIC
	select FREETZ_OPENSSL_VERSION_PROMPT if FREETZ_PACKAGE_PHP_STATIC
	default n
	help
		This option enables the SSL support for PHP

config FREETZ_PACKAGE_PHP_WITH_SYSVIPC
	bool "build with SYSVIPC support"
	default n
	help
		This option enables the SYSVIPC support for PHP

config FREETZ_PACKAGE_PHP_WITH_LIBXML
	bool "build with XML support"
	select FREETZ_LIB_libxml2 if ! FREETZ_PACKAGE_PHP_STATIC
	default n
	help
		This option enables the XML support for PHP

config FREETZ_PACKAGE_PHP_WITH_ZLIB
	bool "build with ZLIB support"
	select FREETZ_LIB_libz if ! FREETZ_PACKAGE_PHP_STATIC
	default n
	help
		This option enables the ZLIB support for PHP

config FREETZ_PACKAGE_PHP_WITH_ZIP
	bool "build with ZIP support"
	select FREETZ_PACKAGE_PHP_WITH_ZLIB
	default n
	help
		This option enables the ZIP support for PHP

endmenu

config FREETZ_PACKAGE_PHP_STATIC
	bool "Create statically linked binary"
	depends on FREETZ_PACKAGE_PHP
	default n
	help
		Causes all libraries PHP depends on to be linked in statically.
```

## make/phpxmail/Config.in
```kconfig
config FREETZ_PACKAGE_PHPXMAIL
	bool "PHPXmail 1.5"
	default n
	select FREETZ_PACKAGE_PHP
	select FREETZ_PACKAGE_PHP_WITH_SESSION
	select FREETZ_PACKAGE_XMAIL
	help
		Web configuration interface for XMail from the phpxmail team. Accessible
		via the URL http://fritz.box:81/phpxmail, it enables you to configure your
		XMail server locally on the fritz.box or any other remote host. This GUI
		needs PHP, so it is automaticaly selected. Used web server is busybox httpd.
```

## make/pingtunnel/Config.in
```kconfig
config FREETZ_PACKAGE_PINGTUNNEL
	bool "Pingtunnel 0.72"
	default n
	select FREETZ_LIB_libpcap
	help
		Ptunnel is an application that allows you to reliably tunnel TCP
		connections to a remote host using ICMP echo request and reply packets,
		commonly known as ping requests and replies. At first glance, this might
		seem like a rather useless thing to do, but it can actually come in
		handy in some cases.
```
