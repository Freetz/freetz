## make/pkgs/addhole/Config.in
```kconfig
comment "Addhole (needs dnsmasq)"
	depends on !FREETZ_PACKAGE_DNSMASQ

config FREETZ_PACKAGE_ADDHOLE
	bool "Addhole (for dnsmasq)"
	depends on FREETZ_PACKAGE_DNSMASQ
	select FREETZ_BUSYBOX_DOS2UNIX
	select FREETZ_PACKAGE_WGET
	select FREETZ_PACKAGE_WGET_WITH_SSL
	select FREETZ_PACKAGE_WGET_CA_BUNDLE
	default n
	help
		Downloads block lists and adds them to dnsmasq.
		Warning:
		If you enable all included lists, dnsmasq will
		need 25 MB of RAM instead of 1MB without them.
```

## make/pkgs/asterisk-chan-capi/Config.in
```kconfig
config FREETZ_PACKAGE_ASTERISK_CHAN_CAPI
	bool "chan_capi: ISDN API 2.0 module for asterisk"
	depends on FREETZ_PACKAGE_ASTERISK
	select FREETZ_LIB_libpthread if FREETZ_TARGET_UCLIBC_HAS_multiple_libs
	select FREETZ_LIB_libcapi20
	default n
	help
		Common ISDN API 2.0 module for asterisk
```

## make/pkgs/autossh/Config.in
```kconfig
config FREETZ_PACKAGE_AUTOSSH
	bool "autossh 1.4g (binary only)"
	default n
	help
		autossh is a program to start a copy of ssh and monitor it,
		restarting it as necessary should it die or stop passing traffic.
```

## make/pkgs/avm-firewall/Config.in
```kconfig
config FREETZ_PACKAGE_AVM_FIREWALL
	bool "AVM-firewall"
	depends on FREETZ_AVM_HAS_DSLD
	depends on !FREETZ_REMOVE_DSLD
	depends on FREETZ_AVM_VERSION_05_5X_MAX
	default n
	help
		Configuration front-end for AVM-firewall.
		This front-end is used for managing firewall rules for the AVM standard firewall.
		You can also modify the ar7.cfg file manually. But a better way is to use this GUI.
```

## make/pkgs/avm-portfw/Config.in
```kconfig
config FREETZ_PACKAGE_AVM_PORTFW
	bool "AVM-portfw"
	depends on FREETZ_AVM_HAS_DSLD
	depends on !FREETZ_REMOVE_DSLD
	depends on FREETZ_AVM_VERSION_06_8X_MIN
	default n
	help
		Configuration of port forwardings to the FritzBox itself
		by using internet_forwardrules.
		Warning:
		This package changes the ar7.cfg. On syntax errors AVM
		will reset the whole file to default, including default
		password and default ip. Backup you config before!
```

## make/pkgs/bird/Config.in
```kconfig
config FREETZ_PACKAGE_BIRD
	bool "BIRD 1.6.8"
	default n
	help
		The BIRD Internet Routing Daemon

if FREETZ_PACKAGE_BIRD

	config FREETZ_PACKAGE_BIRD_DEBUG
		bool "Debugging code (recommended)"
		default y
		help
			Enables additional debugging code. This is highly recommended.
			Increases binary size by around 3 KB.

	config FREETZ_PACKAGE_BIRDC
		bool "birdc"
		select FREETZ_LIB_libncurses
		select FREETZ_LIB_libreadline
		select FREETZ_LIB_libhistory
		default n
		help
			birdc (command-line interface for bird)

endif # FREETZ_PACKAGE_BIRD
```

## make/pkgs/bittwist/Config.in
```kconfig
config FREETZ_PACKAGE_BITTWIST
	bool "bittwist 1.1 (binary only)"
	select FREETZ_LIB_libpcap
	default n
	help
		bittwist is designed to complement tcpdump, which
		by itself has done a great job in capturing network
		traffic. bittwist can regenerate the captured traffic
		onto a live network (the packets are generated from
		tcpdump trace file, generating a .pcap file).
		bittwist also comes with a comprehensive trace file
		editor to allow to change the contents of a trace file
		on the fly. Generally, a packet generator is useful in
		simulating networking traffic or scenario, testing firewall,
		IDS, and IPS, and troubleshooting various network problems.
		http://bittwist.sourceforge.net/doc.html
```

## make/pkgs/bluez-utils/Config.in
```kconfig
config FREETZ_PACKAGE_BLUEZ_UTILS
	bool "bluez-utils 2.25 (binary only, incl. Pin-Change and NAP)"
	depends on FREETZ_REPLACE_MODULE_AVAILABLE
	select FREETZ_LIB_libbluetooth
	select FREETZ_MODULE_btusb    if !FREETZ_AVM_HAS_BT_HCIBTUSB_BUILTIN   && FREETZ_KERNEL_VERSION_2_6_28_MIN
	select FREETZ_MODULE_hci_usb  if !FREETZ_AVM_HAS_BT_HCIUSB_SCO_BUILTIN && FREETZ_KERNEL_VERSION_2_6_19_MAX
	select FREETZ_MODULE_bnep     if !FREETZ_AVM_HAS_BTBT_BNEP_BUILTIN
	select FREETZ_MODULE_rfcomm   if !FREETZ_AVM_HAS_BT_RFCOMM_BUILTIN
	select FREETZ_BUSYBOX_BRCTL if ! FREETZ_PACKAGE_BRIDGE_UTILS
	default n
	help
		This package contains utilities for configuring bluetooth
		connections.
```

## make/pkgs/cifsmount/Config.in
```kconfig
comment "Cifsmount (not available, needs kernel modules)"
	depends on !(FREETZ_AVM_HAS_CIFS_BUILTIN || FREETZ_REPLACE_MODULE_AVAILABLE)

config FREETZ_PACKAGE_CIFSMOUNT
	bool "Cifsmount 7.0"
	depends on FREETZ_AVM_HAS_CIFS_BUILTIN || FREETZ_REPLACE_MODULE_AVAILABLE
	select FREETZ_MODULE_cifs if !FREETZ_AVM_HAS_CIFS_BUILTIN
	default n
	help
		User space helper for mounting remote CIFS shares + CGI web interface
		for easy configuration of up to three mounts incl. (auto-) start/stop.

		CIFS is an extended version of SMB, the well-known protocol used by
		MS Windows and Samba for sharing folders, files and printers.
		Thus, cifsmount is a replacement for smbmount, having the advantage
		of being significantly smaller than smbmount. So if you want to mount
		Windows or Samba shares from your router box, this package is for you.

		If this does not work, enable replace-kernel!

config FREETZ_PACKAGE_CIFSMOUNT_REMOVE_WEBIF
	bool "remove webinterface"
	depends on FREETZ_PACKAGE_CIFSMOUNT
	default n
	help
		This option removes the webinterface
```

## make/pkgs/collectd/Config.in
```kconfig
menuconfig FREETZ_PACKAGE_COLLECTD
	bool "Collectd 4.10.3"
	select FREETZ_LIB_libdl       if FREETZ_TARGET_UCLIBC_HAS_multiple_libs
	select FREETZ_LIB_libltdl
	select FREETZ_LIB_libm        if FREETZ_TARGET_UCLIBC_HAS_multiple_libs
	select FREETZ_LIB_libpthread  if FREETZ_TARGET_UCLIBC_HAS_multiple_libs
	select FREETZ_PACKAGE_COLLECTD_PLUGIN_rrdtool
	select FREETZ_PACKAGE_COLLECTD_PLUGIN_syslog
	default n
	help
		Collectd collects information about the system it is running on and
		stores this information. The information can then be used to do find
		current performance bottlenecks (i. e. performance analysis) and
		predict future system load (i. e. capacity planning). Or if you just
		want pretty graphs of your private server and are fed up with some
		homegrown solution you're at the right place, too.

if FREETZ_PACKAGE_COLLECTD

config FREETZ_PACKAGE_COLLECTD_PLUGIN_apache
	bool "apache"
	select FREETZ_LIB_libcurl

config FREETZ_PACKAGE_COLLECTD_PLUGIN_contextswitch
	bool "contextswitch"

config FREETZ_PACKAGE_COLLECTD_PLUGIN_cpu
	bool "cpu"

config FREETZ_PACKAGE_COLLECTD_PLUGIN_csv
	bool "csv"

config FREETZ_PACKAGE_COLLECTD_PLUGIN_df
	bool "df"

config FREETZ_PACKAGE_COLLECTD_PLUGIN_disk
	bool "disk"

config FREETZ_PACKAGE_COLLECTD_PLUGIN_entropy
	bool "entropy"

config FREETZ_PACKAGE_COLLECTD_PLUGIN_exec
	bool "exec"

config FREETZ_PACKAGE_COLLECTD_PLUGIN_fritzbox
	bool "fritzbox"

config FREETZ_PACKAGE_COLLECTD_PLUGIN_interface
	bool "interface"

config FREETZ_PACKAGE_COLLECTD_PLUGIN_irq
	bool "irq"

config FREETZ_PACKAGE_COLLECTD_PLUGIN_load
	bool "load"

config FREETZ_PACKAGE_COLLECTD_PLUGIN_memory
	bool "memory"

config FREETZ_PACKAGE_COLLECTD_PLUGIN_network
	bool "network"

config FREETZ_PACKAGE_COLLECTD_PLUGIN_ping
	bool "ping"
	select FREETZ_LIB_liboping

config FREETZ_PACKAGE_COLLECTD_PLUGIN_rrdtool
	bool "rrdtool"
	select FREETZ_LIB_librrd_th
	select FREETZ_PACKAGE_RRDTOOL

config FREETZ_PACKAGE_COLLECTD_PLUGIN_syslog
	bool "syslog"

config FREETZ_PACKAGE_COLLECTD_PLUGIN_uptime
	bool "uptime"

endif # FREETZ_PACKAGE_COLLECTD
```

## make/pkgs/cpmaccfg/Config.in
```kconfig
config FREETZ_PACKAGE_CPMACCFG_AVAILABLE
	bool
	depends on (FREETZ_SYSTEM_TYPE_AR7_OHIO || FREETZ_SYSTEM_TYPE_UR8) && FREETZ_KERNEL_VERSION_2_6_19_MAX
	default y

config FREETZ_PACKAGE_CPMACCFG
	bool "Cpmaccfg 0.6 (binary only)"
	depends on FREETZ_PACKAGE_CPMACCFG_AVAILABLE
	select FREETZ_BUSYBOX_BRCTL if ! FREETZ_PACKAGE_BRIDGE_UTILS
	default n
	help
		With a patched kernel and this tool it is possible to
		configure the ADM6996L switch (at least FB 7170, maybe
		other FBs with 4 LAN ports work too) to support VLANs
		and/or to split the LAN ports into different subnets.
		It is also possible to view or set each ports power
		configuration and to disable auto media detection and
		to force a given media type for each port (10/100 Mbit,
		Half-/Full-Duplex). Some features are only available
		when Replace Kernel is selected.
		Since version 0.6 cpmaccfg detects the tantos switches
		used i.e. in F!B 7270. However, since there is not
		enough documentation (freely) available yet, it is not
		yet possible to configure this chipset.
```

## make/pkgs/deco/Config.in
```kconfig
config FREETZ_PACKAGE_DECO
	bool "Deco 1.3.9 (binary only)"
	select FREETZ_LIB_libncurses
	default n
	help
		Norton commander clone. Compared with Midnight Commander (mc) it is
		considerably smaller, but also significantly less powerful and less
		fancy-looking. Use it if you want to trade power for file and memory
		footprint, but still feel like requiring a file manager instead of a
		plain UNIX shell. Uses about 149K uncompressed space.
```

## make/pkgs/dehydrated/Config.in
```kconfig
config FREETZ_PACKAGE_DEHYDRATED
	bool "dehydrated 0.7.1 (letsencrypt)"
	select FREETZ_BUSYBOX_DIFF
	select FREETZ_BUSYBOX_HEXDUMP
	select FREETZ_BUSYBOX_MKTEMP
	select FREETZ_PACKAGE_BASH
	select FREETZ_PACKAGE_CA_BUNDLE
	select FREETZ_PACKAGE_CURL
	select FREETZ_PACKAGE_CURL_SELECT_SSL
	select FREETZ_PACKAGE_CURL_SELECT_CA_BUNDLE
	select FREETZ_PACKAGE_OPENSSL
	select FREETZ_LIB_libcrypto_WITH_EC
	default n
	help
		Dehydrated is a client for signing certificates with an
		ACME-server (e.g. Let's Encrypt) implemented as a 
		relatively simple (zsh-compatible) bash-script.
		This client supports both ACME v1 and the new ACME v2
		including support for wildcard certificates!
```

## make/pkgs/dns2tcp/Config.in
```kconfig
config FREETZ_PACKAGE_DNS2TCP
	bool "dns2tcp 0.5.2"
	default n
	help
		Dns2tcp is a network tool designed to relay TCP connections
		through DNS traffic. Encapsulation is done on the TCP level,
		thus no specific driver is needed (i.e: TUN/TAP).
```

## make/pkgs/dosfstools/Config.in
```kconfig
config FREETZ_PACKAGE_DOSFSTOOLS
	bool "dosfstools 3.0.28 (binary only)"
	select FREETZ_LIB_libiconv if FREETZ_TARGET_UCLIBC_0_9_28
	default n
	help
		utilities to create, check and label MS-DOS FAT filesystems

config FREETZ_PACKAGE_DOSFSTOOLS_fsck_fat
	bool "fsck.fat"
	depends on FREETZ_PACKAGE_DOSFSTOOLS
	default n
	help
		This option enables the checking utility for MS-DOS FAT filesystems

config FREETZ_PACKAGE_DOSFSTOOLS_fatlabel
	bool "fatlabel"
	depends on FREETZ_PACKAGE_DOSFSTOOLS
	default n
	help
		This option enables labeling utility for MS-DOS FAT filesystems

config FREETZ_PACKAGE_DOSFSTOOLS_mkfs_fat
	bool "mkfs.fat"
	depends on FREETZ_PACKAGE_DOSFSTOOLS
	default n
	help
		This option enables the creation utility for MS-DOS FAT filesystems
```

## make/pkgs/dtc/Config.in
```kconfig
config FREETZ_PACKAGE_DTC
	bool "dtc 1.6.1"
	default n
	help
		Device  Tree  Compiler,  dtc, takes as input a device-tree in a given format and outputs a
		device-tree in another format for booting kernels on  embedded  systems.   Typically,  the
		input  format  is  "dts",  a  human readable source format, and creates a "dtb", or binary
		format as output.

if FREETZ_PACKAGE_DTC

	config FREETZ_PACKAGE_DTC_fdtdump
		bool "fdtdump"
		default n

	config FREETZ_PACKAGE_DTC_fdtget
		bool "fdtget"
		default n

	config FREETZ_PACKAGE_DTC_fdtput
		bool "fdtput"
		default n

	config FREETZ_PACKAGE_DTC_fitdump
		bool "fitdump"
		default n

endif # FREETZ_PACKAGE_DTC
```

## make/pkgs/dvbstream/Config.in
```kconfig
config FREETZ_PACKAGE_DVBSTREAM
	bool "dvbstream 0.5 (binary only)"
	default n
	help
		DVB tools is a set of command-line tools for DVB cards such as the Hauppauge
		DVB-S and Nova-t. Includes RTP multicast streaming server.
		This package contains only dvbstream.
```
