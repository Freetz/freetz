## make/netatalk/Config.in
```kconfig
config FREETZ_PACKAGE_NETATALK
	bool "Netatalk 2.2.0"
	select FREETZ_LIB_libdl
	select FREETZ_LIB_libpthread
	select FREETZ_LIB_libdb
	default n
	help
		Netatalk is a kernel level implementation of the AppleTalk
		Protocol Suite which contains the AppleShare file server (AFP).

menu "netatalk options"
depends on FREETZ_PACKAGE_NETATALK

config FREETZ_PACKAGE_NETATALK_ENABLE_ZEROCONF
	bool "build with zeroconf support"
	select FREETZ_LIB_libdbus
	select FREETZ_PACKAGE_DBUS
	select FREETZ_PACKAGE_AVAHI
	default n
	help
		This option enables Zeroconf support for netatalk. Thus enables
		afpd to register its shares via dbus-daemon at avahi-daemon.
		You want to select this option, if you want your afpd shares
		and Time Machine shares being visible on the Apple/Finder and the
		Time Machine Menu. Adds 7KB for libdaemon 110KB for libdbus,
		120KB for avahi-daemon, 136KB for dbus-daemon (370 KB in sum).

config FREETZ_PACKAGE_NETATALK_DBD
	bool "build with cnid database repair tool"
	default n
	help
		This option adds the dbd utility, the CNID database and
		volume maintanance and intergrity check utility. Adds
		another 80KB to the squashfs.

config FREETZ_PACKAGE_NETATALK_DHX
	bool "build with uams_dhx"
	select FREETZ_LIB_libcrypt
	select FREETZ_LIB_libcrypto
	default n
	help
		This option enables the uams_dhx.so module for authentication purposes. See
		http://netatalk.sourceforge.net/2.2/htmldocs/configuration.html#id4167131
		for further details.

config FREETZ_PACKAGE_NETATALK_DHX2
	bool "build with uams_dhx2"
	select FREETZ_LIB_libcrypt
	select FREETZ_LIB_libgcrypt
	select FREETZ_LIB_libgcrypt_WITH_SYMMETRIC_CIPHER_cast5
	default n
	help
		This option enables the uams_dhx2.so module for authentication purposes.
		It requires libgcrypt to build (adds 114KB to the squashfs). See
		http://netatalk.sourceforge.net/2.2/htmldocs/configuration.html#id4167131
		for further details.

endmenu
```

## make/netcat/Config.in
```kconfig
config FREETZ_PACKAGE_NETCAT
	bool "netcat 0.7.1"
	default n
	help
		A feature-rich network debugging and exploration tool.
```

## make/netpbm/Config.in
```kconfig
config FREETZ_PACKAGE_NETPBM
	bool "Netpbm-tools 10.35.85 (binary only)"
	select FREETZ_LIB_libnetpbm
	default n
	help
		Provides the following tools from netpbm-suite: bmptopnm, giftopnm, jpegtopnm, pngtopnm, pnmtojpeg, pnmtopng

config FREETZ_PACKAGE_NETPBM_BMPTOPNM
	bool "Include bmptopnm"
	depends on FREETZ_PACKAGE_NETPBM
	default y
	help
		Include bmptopnm in the image

config FREETZ_PACKAGE_NETPBM_GIFTOPNM
	bool "Include giftopnm"
	depends on FREETZ_PACKAGE_NETPBM
	default y
	help
		Include giftopnm in the image

config FREETZ_PACKAGE_NETPBM_JPEGTOPNM
	bool "Include jpegtopnm"
	depends on FREETZ_PACKAGE_NETPBM
	select FREETZ_LIB_libjpeg
	default y
	help
		Include jpegtopnm in the image

config FREETZ_PACKAGE_NETPBM_PNGTOPNM
	bool "Include pngtopnm"
	depends on FREETZ_PACKAGE_NETPBM
	select FREETZ_LIB_libpng12
	select FREETZ_LIB_libz
	default y
	help
		Include pngtopnm in the image

config FREETZ_PACKAGE_NETPBM_PNMTOJPEG
	bool "Include pnmtojpeg"
	depends on FREETZ_PACKAGE_NETPBM
	select FREETZ_LIB_libjpeg
	default y
	help
		Include pnmtojpeg in the image

config FREETZ_PACKAGE_NETPBM_PNMTOPNG
	bool "Include pnmtopng"
	depends on FREETZ_PACKAGE_NETPBM
	select FREETZ_LIB_libpng12
	select FREETZ_LIB_libz
	default y
	help
		Include pnmtopng in the image
```

## make/netsnmp/Config.in
```kconfig
menuconfig FREETZ_PACKAGE_NETSNMP
	bool "Net-SNMP 5.9.1"
	select FREETZ_LIB_libm if FREETZ_TARGET_UCLIBC_HAS_multiple_libs
	default n
	help
		SNMP (Simple Network Management Protocol) daemon.
		SNMP is a widely used protocol for monitoring the health and welfare of network
		equipment (eg. routers), computer equipment and even devices like UPSs. Net-SNMP
		is a suite of applications used to implement SNMP v1, SNMP v2c and SNMP v3.

if FREETZ_PACKAGE_NETSNMP

	config FREETZ_PACKAGE_NETSNMP_WITH_64BIT
		bool "With 64-bit counter"
		default n
		help
			Enabled 64-bit counter for network interfaces.
			Works only with disabled avm packet-accelerator.

	config FREETZ_PACKAGE_NETSNMP_WITH_OPENSSL
		bool "With openssl encryption"
		select FREETZ_LIB_libcrypto
		default n
		help
			Openssl encryption for traffic

	config FREETZ_PACKAGE_NETSNMP_WITH_ZLIB
		bool "With zlib compression"
		select FREETZ_LIB_libz
		default n
		help
			Zlib compression for traffic

	config FREETZ_PACKAGE_NETSNMP_WITH_APPLICATIONS
		bool "Include applications"
		default n
		help
			Also build SNMP applications like setsnmp, snmpwalk ...

	if FREETZ_PACKAGE_NETSNMP_WITH_APPLICATIONS

		config FREETZ_PACKAGE_NETSNMP_encode_keychange
			bool "encode_keychange"
			default n
			help
				include binary encode_keychange

		config FREETZ_PACKAGE_NETSNMP_snmpbulkget
			bool "snmpbulkget"
			default n
			help
				include binary snmpbulkget

		config FREETZ_PACKAGE_NETSNMP_snmpbulkwalk
			bool "snmpbulkwalk"
			default n
			help
				include binary snmpbulkwalk

		config FREETZ_PACKAGE_NETSNMP_snmpdelta
			bool "snmpdelta"
			default n
			help
				include binary snmpdelta

		config FREETZ_PACKAGE_NETSNMP_snmpdf
			bool "snmpdf"
			default n
			help
				include binary snmpdf

		config FREETZ_PACKAGE_NETSNMP_snmpget
			bool "snmpget"
			default n
			help
				include binary snmpget

		config FREETZ_PACKAGE_NETSNMP_snmpgetnext
			bool "snmpgetnext"
			default n
			help
				include binary snmpgetnext

		config FREETZ_PACKAGE_NETSNMP_snmpset
			bool "snmpset"
			default n
			help
				include binary snmpset

		config FREETZ_PACKAGE_NETSNMP_snmpstatus
			bool "snmpstatus"
			default n
			help
				include binary snmpstatus

		config FREETZ_PACKAGE_NETSNMP_snmptable
			bool "snmptable"
			default n
			help
				include binary snmptable

		config FREETZ_PACKAGE_NETSNMP_snmptest
			bool "snmptest"
			default n
			help
				include binary snmptest

		config FREETZ_PACKAGE_NETSNMP_snmptranslate
			bool "snmptranslate"
			default n
			help
				include binary snmptranslate

		config FREETZ_PACKAGE_NETSNMP_snmptrap
			bool "snmptrap"
			default n
			help
				include binary snmptrap

		config FREETZ_PACKAGE_NETSNMP_snmptrapd
			bool "snmptrapd"
			default n
			help
				include binary snmptrapd

		config FREETZ_PACKAGE_NETSNMP_snmpusm
			bool "snmpusm"
			default n
			help
				include binary snmpusm

		config FREETZ_PACKAGE_NETSNMP_snmpvacm
			bool "snmpvacm"
			default n
			help
				include binary snmpvacm

		config FREETZ_PACKAGE_NETSNMP_snmpwalk
			bool "snmpwalk"
			default n
			help
				include binary snmpwalk

	endif # FREETZ_PACKAGE_NETSNMP_WITH_APPLICATIONS

endif # FREETZ_PACKAGE_NETSNMP
```

## make/nfs-utils/Config.in
```kconfig
comment "nfs-utils (not available, needs replace kernel)"
	depends on !FREETZ_NFS_SUPPORT_AVAILABLE &&  FREETZ_NFS_SUPPORT_NEEDS_REPLACE_KERNEL

comment "nfs-utils (not available, no sources by AVM)"
	depends on !FREETZ_NFS_SUPPORT_AVAILABLE && !FREETZ_NFS_SUPPORT_NEEDS_REPLACE_KERNEL

config FREETZ_PACKAGE_NFS_UTILS
	bool "nfs-utils 1.3.4 (binary only)"
	default n
	depends on FREETZ_NFS_SUPPORT_AVAILABLE
	select FREETZ_ADD_ETCSERVICES
	select FREETZ_PACKAGE_TCP_WRAPPERS
	select FREETZ_MODULE_nfsd if FREETZ_NFS_SUPPORT_AVAILABLE_AS_MODULE
	help
		Linux NFS utility package

		Select nfsd-cgi if you want a configuration web interface.
```

## make/nfsd-cgi/Config.in
```kconfig
comment "NFSD CGI (not available, needs kernel modules)"
	depends on !(FREETZ_AVM_HAS_NFSD_BUILTIN || FREETZ_REPLACE_MODULE_AVAILABLE)

config FREETZ_PACKAGE_NFSD_CGI
	bool "NFSD CGI 0.1"
	depends on FREETZ_AVM_HAS_NFSD_BUILTIN || FREETZ_REPLACE_MODULE_AVAILABLE
	select FREETZ_PACKAGE_NFS_UTILS
	select FREETZ_PACKAGE_PORTMAP if FREETZ_TARGET_UCLIBC_SUPPORTS_rpc
	select FREETZ_PACKAGE_RPCBIND if !FREETZ_TARGET_UCLIBC_SUPPORTS_rpc
	default n
	help
		Configuration frontend to NFS-server
		If this does not work, enable replace-kernel!
```

## make/ngircd/Config.in
```kconfig
config FREETZ_PACKAGE_NGIRCD
	bool "ngircd 14.1 (binary only)"
	default n
	help
		ngIRCd is an Open Source server for the Internet Relay Chat (IRC), which
		is developed and published under the terms of the GNU General Public
		Licence (URL: http://www.gnu.org/licenses/gpl.html). ngIRCd means "next
		generation IRC daemon", it's written from scratch and not deduced from the
		"grandfather of IRC daemons", the daemon of the IRCNet.
		For documentation see: http://ngircd.barton.de/documentation.php.de

config FREETZ_PACKAGE_NGIRCD_WITH_TCP_WRAPPERS
	bool "Add TCP_WRAPPERS support"
	depends on FREETZ_PACKAGE_NGIRCD
	select FREETZ_PACKAGE_TCP_WRAPPERS
	default n
	help
		This option adds TCP WRAPPERS support to ngircd
```

## make/nhipt/Config.in
```kconfig
config FREETZ_PACKAGE_NHIPT
	bool "NHIPT Iptables CGI 0.8.3a - EXPERIMENTAL"
	default n

	# Be visible only if iptables is selected
	depends on FREETZ_PACKAGE_IPTABLES

	# select standard set of iptable modules and libs
	select FREETZ_PACKAGE_IPTABLES_STANDARD_MODULES

	help
		New Iptables configuration interface.
```

## make/nmap/Config.in
```kconfig
config FREETZ_PACKAGE_NMAP
	bool "Nmap 4.68/5.51 (binary only)"
	select FREETZ_LIB_STDCXXLIB if ! FREETZ_PACKAGE_NMAP_STATIC
	select FREETZ_LIB_libpcap   if ! FREETZ_PACKAGE_NMAP_STATIC
	select FREETZ_LIB_libdnet   if ! FREETZ_PACKAGE_NMAP_STATIC
	select FREETZ_LIB_libm      if ! FREETZ_PACKAGE_NMAP_STATIC && FREETZ_TARGET_UCLIBC_HAS_multiple_libs
	select FREETZ_LIB_libdl     if ! FREETZ_PACKAGE_NMAP_STATIC && FREETZ_TARGET_UCLIBC_HAS_multiple_libs
	select FREETZ_PACKAGE_NMAP_services if ! FREETZ_ADD_ETCSERVICES && !FREETZ_AVM_HAS_ETCSERVICES
	select FREETZ_PACKAGE_NMAP_payloads if ! FREETZ_PACKAGE_NMAP_VERSION_4
	default n
	help
		Nmap ("Network Mapper") is a free and open source (license) utility for network
		exploration or security auditing. Many systems and network administrators also
		find it useful for tasks such as network inventory, managing service upgrade
		schedules, and monitoring host or service uptime. Nmap uses raw IP packets in
		novel ways to determine what hosts are available on the network, what services
		(application name and version) those hosts are offering, what operating systems
		(and OS versions) they are running, what type of packet filters/firewalls are in
		use, and dozens of other characteristics. It was designed to rapidly scan large
		networks, but works fine against single hosts. Nmap runs on all major computer
		operating systems, and both console and graphical versions are available.

if FREETZ_PACKAGE_NMAP

	choice
		depends on FREETZ_PACKAGE_NMAP
		prompt "Version"
		default FREETZ_PACKAGE_NMAP_VERSION_4

		config FREETZ_PACKAGE_NMAP_VERSION_4
			bool "4.68"

		config FREETZ_PACKAGE_NMAP_VERSION_5
			bool "5.51"
			select FREETZ_STDCXXLIB_FORCE_GNULIBSTDCXX
	endchoice

	menu "databases"
		config FREETZ_PACKAGE_NMAP_mac_prefixes
			bool "MAC-address to manufacturer mapping"
			default n

		config FREETZ_PACKAGE_NMAP_os_db
			bool "OS fingerprinting DB"
			default n

		config FREETZ_PACKAGE_NMAP_payloads
			depends on ! FREETZ_PACKAGE_NMAP_VERSION_4
			bool "Payload DB"
			default y

		config FREETZ_PACKAGE_NMAP_protocols
			bool "Protocol list"
			default n

		config FREETZ_PACKAGE_NMAP_rpc
			bool "RPC grinding DB"
			default n

		config FREETZ_PACKAGE_NMAP_service_probes
			bool "Service detection probe list"
			default n

		config FREETZ_PACKAGE_NMAP_services
			bool "Service list"
			default y
	endmenu

	config FREETZ_PACKAGE_NMAP_ncat
		bool "include ncat"
		depends on FREETZ_PACKAGE_NMAP && FREETZ_PACKAGE_NMAP_VERSION_5
		default n
		help
			Include ncat (a much-improved reimplementation of Netcat)

	config FREETZ_PACKAGE_NMAP_nping
		bool "include nping"
		depends on FREETZ_PACKAGE_NMAP && FREETZ_PACKAGE_NMAP_VERSION_5
		default n
		help
			Include nping (a network packet generation tool / ping utility)

	config FREETZ_PACKAGE_NMAP_WITH_SHARED_LUA
		bool "Use system (shared) liblua"
		depends on FREETZ_PACKAGE_NMAP
		select FREETZ_LIB_liblua if ! FREETZ_PACKAGE_NMAP_STATIC
		default y
		help
			Causes system (dynamic) liblua to be used instead of the bundled one.

	config FREETZ_PACKAGE_NMAP_WITH_SHARED_PCRE
		bool "Use system (shared) libpcre"
		depends on FREETZ_PACKAGE_NMAP
		select FREETZ_LIB_libpcre if ! FREETZ_PACKAGE_NMAP_STATIC
		default y
		help
			Causes system (dynamic) libpcre to be used instead of the bundled one.

	config FREETZ_PACKAGE_NMAP_STATIC
		bool "Link statically"
		depends on FREETZ_PACKAGE_NMAP
		default n
		help
			Causes all libraries to be linked in statically.

endif # FREETZ_PACKAGE_NMAP
```

## make/noip/Config.in
```kconfig
config FREETZ_PACKAGE_NOIP
	bool "noip 2.1.9-1 (binary only)"
	select FREETZ_WGET
	default n
	help
		This is No-IP.com's dynamic DNS update client. When configured correctly,
		the client will check the local IP address at a given time interval for
		any changes. If the local IP address has changed it will notify the DNS
		servers at No-IP.com and update the IP corresponding to your No-IP/No-IP+
		hostname.
```

## make/ntfs/Config.in
```kconfig
config FREETZ_PACKAGE_NTFS
	bool "NTFS-3G 1.2712 (binary only)"
	select FREETZ_MODULE_fuse
	default n
	help
		The NTFS-3G driver is an open source, freely available read/write NTFS
		driver for Linux, FreeBSD, OS X, and NetBSD. It provides safe and fast
		handling of the Windows XP, Windows Server 2003, Windows 2000 and 
		Windows Vista file systems. Most POSIX file system operations are
		supported, with the exception of full file ownership and access right
		support.
		This binary is needed for ntfs automount feature thus there is no
		webinterface.
```

## make/nzbget/Config.in
```kconfig
comment "NZBGet (not available, needs libstdc++ as Standard C++ Library)"
	depends on !FREETZ_STDCXXLIB_USE_GNULIBSTDCXX

config FREETZ_PACKAGE_NZBGET
	bool "NZBGet 21.0"
	depends on FREETZ_STDCXXLIB_USE_GNULIBSTDCXX
	select FREETZ_LIB_libxml2            if !FREETZ_PACKAGE_NZBGET_STATIC
	select FREETZ_LIB_libpthread         if !FREETZ_PACKAGE_NZBGET_STATIC && FREETZ_TARGET_UCLIBC_HAS_multiple_libs
	select FREETZ_LIB_libz               if !FREETZ_PACKAGE_NZBGET_STATIC
	select FREETZ_LIB_libm               if !FREETZ_PACKAGE_NZBGET_STATIC && FREETZ_TARGET_UCLIBC_HAS_multiple_libs
	select FREETZ_LIB_STDCXXLIB          if !FREETZ_PACKAGE_NZBGET_STATIC
	default n
	help
		NZBGet is a command-line based binary news grabber
		for nzb files, written in C++. It supports
		client/server mode, automatic par-check/-repair and
		web-interface (via additional package). NZBGet requires
		low system resources and runs great on routers,
		NAS-devices and media players.

config FREETZ_PACKAGE_NZBGET_WITH_CURSES
	bool "With curses user interface"
	depends on FREETZ_PACKAGE_NZBGET
	select FREETZ_LIB_libncurses if ! FREETZ_PACKAGE_NZBGET_STATIC
	default n
	help
		Enables a more comfortable curses-based user interface.

config FREETZ_PACKAGE_NZBGET_WITH_TLS
	bool "With SSL/TLS encryption support"
	depends on FREETZ_PACKAGE_NZBGET
	select FREETZ_LIB_libcrypto_WITH_EC if !FREETZ_PACKAGE_NZBGET_STATIC
	select FREETZ_LIB_libcrypto         if !FREETZ_PACKAGE_NZBGET_STATIC
	select FREETZ_LIB_libssl            if !FREETZ_PACKAGE_NZBGET_STATIC
	select FREETZ_LIB_libdl             if !FREETZ_PACKAGE_NZBGET_STATIC && FREETZ_TARGET_UCLIBC_HAS_multiple_libs
	default n
	help
		Enables SSL/TLS-encrypted connection support.

config FREETZ_PACKAGE_NZBGET_DISABLE_PAR_CHECK
	bool "Disable parity-check and -repair support"
	depends on FREETZ_PACKAGE_NZBGET
	default n
	help
		Disables parity checking and automatic
		repairing of downloaded files.

config FREETZ_PACKAGE_NZBGET_STATIC
	bool "Link statically"
	depends on FREETZ_PACKAGE_NZBGET
	default n
	help
		Link all libraries into the binary.
```

## make/obexftp/Config.in
```kconfig
config FREETZ_PACKAGE_OBEXFTP
	bool "ObexFTP 0.23 (binary only)"
	select FREETZ_LIB_libopenobex
	default n
	help
		This package contains an ObexFTP server.
```
