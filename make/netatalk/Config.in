## make/oidentd/Config.in
```kconfig
config FREETZ_PACKAGE_OIDENTD
	bool "oidentd 2.0.8"
	default n
	help
		From the README:
		"oidentd is an ident (rfc1413 compliant) daemon that runs on Linux,
		FreeBSD, OpenBSD and Solaris.  oidentd can handle IP masqueraded/NAT
		connections on Linux, FreeBSD (ipf only) and OpenBSD.  oidentd has a
		flexible mechanism for specifying ident responses.  Users can be
		granted permission to specify their own ident responses. Responses
		can be specified according to host and port pairs."
		WWW: http://ojnk.sourceforge.net/
```

## make/onlinechanged-cgi/Config.in
```kconfig
config FREETZ_PACKAGE_ONLINECHANGED_CGI
	bool "Onlinechanged-CGI"
	default n
	help
		When the online-status changes (e.g. a forced re-connect)
		this CGI allows you to specify arbitrary commands which are
		executed at that event. The following different change events
		are considered: initial start of the box, going online and
		going offline.
```

## make/openconnect/Config.in
```kconfig
config FREETZ_PACKAGE_OPENCONNECT
	bool "Openconnect 2.24 (binary only)"
	select FREETZ_LIB_libxml2
	select FREETZ_LIB_libz
        select FREETZ_LIB_libcrypto
        select FREETZ_LIB_libssl
	default n
	help
		Cisco AnyConnect VPN Client
```

## make/opendd/Config.in
```kconfig
config FREETZ_PACKAGE_OPENDD
	bool "OpenDD 0.7.9"
	default n
	help
		opendd is a DynDNS client, written in C, and especially designed
		for small gateway machines, like a Soekris box. Its main feature
		is that it does not require any Perl or Python interpreter.
		It supports HTTPS, can send a mail report, and can run as daemon.
		It is also very easy to deploy.
		WWW: http://www.bsdmon.com/wakka/OpenDD

config FREETZ_PACKAGE_OPENDD_WITH_SSL
	bool "with SSL encryption (port 443)"
	depends on FREETZ_PACKAGE_OPENDD
	select FREETZ_LIB_libcrypto
	select FREETZ_LIB_libssl
	default y
	help
		Build with SSL encryption (port 443)
```

## make/openntpd/Config.in
```kconfig
config FREETZ_PACKAGE_OPENNTPD
	bool "OpenNTPD 4.9.1p"
	select FREETZ_OPTIONS_ETCSERVICES
	select FREETZ_REMOVE_CHRONYD if FREETZ_HAS_CHRONYD
	default n
	help
		OpenNTPD is a FREE, easy to use implementation of the Network Time Protocol.

		This package automatically removes AVM'S chronyd if necessary.
```

## make/openssh/Config.in
```kconfig
menu "OpenSSH"
config FREETZ_PACKAGE_OPENSSH
	bool
	select FREETZ_LIB_libcrypt                if !FREETZ_PACKAGE_OPENSSH_STATIC
	select FREETZ_LIB_libutil                 if !FREETZ_PACKAGE_OPENSSH_STATIC
	select FREETZ_LIB_libz                    if !FREETZ_PACKAGE_OPENSSH_STATIC
	#
	select FREETZ_OPENSSL_VERSION_PROMPT
	select FREETZ_OPENSSL_VERSION_1_REQUIRED
	select FREETZ_LIB_libcrypto               if !FREETZ_PACKAGE_OPENSSH_INTERNAL_CRYPTO && !FREETZ_PACKAGE_OPENSSH_STATIC
	select FREETZ_LIB_libcrypto_WITH_EC       if !FREETZ_PACKAGE_OPENSSH_INTERNAL_CRYPTO
	#
	depends on FREETZ_PACKAGE_OPENSSH_sshd \
		|| FREETZ_PACKAGE_OPENSSH_ssh \
		|| FREETZ_PACKAGE_OPENSSH_scp \
		|| FREETZ_PACKAGE_OPENSSH_CLIENTUTILS \
		|| FREETZ_PACKAGE_OPENSSH_KEYUTILS \
		|| FREETZ_PACKAGE_OPENSSH_sftp \
		|| FREETZ_PACKAGE_OPENSSH_sftp_server
	default n

config FREETZ_PACKAGE_OPENSSH_sshd
	bool "Build OpenSSH server (sshd)"
	select FREETZ_PACKAGE_OPENSSH
	default n

comment "Build OpenSSH client (ssh) (not available, provided by dropbear)"
	depends on FREETZ_PACKAGE_DROPBEAR && !FREETZ_PACKAGE_DROPBEAR_SERVER_ONLY
config FREETZ_PACKAGE_OPENSSH_ssh
	bool "Build OpenSSH client (ssh)"
	depends on !FREETZ_PACKAGE_DROPBEAR || FREETZ_PACKAGE_DROPBEAR_SERVER_ONLY
	select FREETZ_PACKAGE_OPENSSH
	default n

comment "Build OpenSSH secure copy utility (scp) (not available, provided by dropbear)"
	depends on FREETZ_PACKAGE_DROPBEAR && !FREETZ_PACKAGE_DROPBEAR_SERVER_ONLY
config FREETZ_PACKAGE_OPENSSH_scp
	bool "Build OpenSSH secure copy utility (scp)"
	depends on !FREETZ_PACKAGE_DROPBEAR || FREETZ_PACKAGE_DROPBEAR_SERVER_ONLY
	select FREETZ_PACKAGE_OPENSSH
	select FREETZ_PACKAGE_OPENSSH_ssh
	default n

config FREETZ_PACKAGE_OPENSSH_CLIENTUTILS
	bool "Build OpenSSH client utilities (ssh-add, ssh-agent)"
	select FREETZ_PACKAGE_OPENSSH
	select FREETZ_PACKAGE_OPENSSH_ssh_add
	select FREETZ_PACKAGE_OPENSSH_ssh_agent
	default n

config FREETZ_PACKAGE_OPENSSH_ssh_add
	bool
config FREETZ_PACKAGE_OPENSSH_ssh_agent
	bool

config FREETZ_PACKAGE_OPENSSH_KEYUTILS
	bool "Build OpenSSH key utilities (ssh-keygen, ssh-keysign, ssh-keyscan)"
	select FREETZ_PACKAGE_OPENSSH
	select FREETZ_PACKAGE_OPENSSH_ssh_keygen
	select FREETZ_PACKAGE_OPENSSH_ssh_keysign
	select FREETZ_PACKAGE_OPENSSH_ssh_keyscan
	default n

config FREETZ_PACKAGE_OPENSSH_ssh_keygen
	bool
config FREETZ_PACKAGE_OPENSSH_ssh_keysign
	bool
config FREETZ_PACKAGE_OPENSSH_ssh_keyscan
	bool

config FREETZ_PACKAGE_OPENSSH_sftp
	bool "Build OpenSSH SFTP client (sftp)"
	select FREETZ_PACKAGE_OPENSSH
	default n

config FREETZ_PACKAGE_OPENSSH_sftp_server
	bool "Build OpenSSH SFTP server (sftp-server)"
	select FREETZ_PACKAGE_OPENSSH
	default n

comment "OpenSSH configuration ---"
	depends on FREETZ_PACKAGE_OPENSSH

config FREETZ_PACKAGE_OPENSSH_INTERNAL_CRYPTO
	bool "Use internal crypto algorithms only"
	depends on FREETZ_PACKAGE_OPENSSH
	default n
	help
		Disable use of OpenSSL and use internal crypto algorithms only.

		Note: enabling this option
		 - eliminates OpenSSL as OpenSSH runtime dependency on the one hand
		 - limits the available KEy eXchange algorithms to ed25519 only
		   on the other one (your client must support it)

config FREETZ_PACKAGE_OPENSSH_STATIC
	bool "Statically link OpenSSH binaries"
	depends on FREETZ_PACKAGE_OPENSSH
	default n
	help
		OpenSSH needs the following shared libraries which
		can be linked in statically by activating this switch:
		- libcrypt
		- libcrypto
		- libdl
		- libutil
		- libz

endmenu
```

## make/openssl/Config.in
```kconfig
config FREETZ_PACKAGE_OPENSSL
	bool "OpenSSL (binary only)"
	default n
	select FREETZ_LIB_libdl              if !FREETZ_PACKAGE_OPENSSL_STATIC
	select FREETZ_LIB_libcrypto          if !FREETZ_PACKAGE_OPENSSL_STATIC
	select FREETZ_LIB_libssl             if !FREETZ_PACKAGE_OPENSSL_STATIC
	select FREETZ_OPENSSL_VERSION_PROMPT
	help
		This package contains the OpenSSL command-line utility.

config FREETZ_PACKAGE_OPENSSL_TRACE
	bool "With trace output support"
	depends on FREETZ_PACKAGE_OPENSSL
	depends on FREETZ_OPENSSL_VERSION_1
	default n
	help
		Build OpenSSL binary with SSL trace support.

config FREETZ_PACKAGE_OPENSSL_STATIC
	bool "create statically linked binary"
	depends on FREETZ_PACKAGE_OPENSSL
	default n
	help
		Causes all libraries OpenSSL binary depends on to be linked in statically.
```

## make/openvpn-cgi/Config.in
```kconfig
config FREETZ_PACKAGE_OPENVPN_CGI
	depends on FREETZ_PACKAGE_OPENVPN
	depends on FREETZ_PACKAGE_OPENVPN_USE_V1_CGI
	bool
```

## make/openvpn-v2-cgi/Config.in
```kconfig
config FREETZ_PACKAGE_OPENVPN_V2_CGI
	depends on FREETZ_PACKAGE_OPENVPN
	depends on ! FREETZ_PACKAGE_OPENVPN_CGI 
	bool
	default n
```

## make/openvpn/Config.in
```kconfig
config FREETZ_PACKAGE_OPENVPN
	bool "OpenVPN 2.4.9"
	select FREETZ_BUSYBOX_BRCTL         if ! FREETZ_PACKAGE_BRIDGE_UTILS
	select FREETZ_MODULE_tun            if ! FREETZ_AVM_HAS_TUN_BUILTIN
	select FREETZ_MODULE_yf_patchkernel if FREETZ_AVM_HAS_BUGON_IN_NET_CORE
	select FREETZ_PACKAGE_OPENVPN_CGI if ! FREETZ_PACKAGE_OPENVPN_USE_V2_CGI || ! FREETZ_SHOW_ADVANCED
	default n
	help
		VPN Server

if FREETZ_PACKAGE_OPENVPN

choice
	prompt "SSL library"
	default FREETZ_PACKAGE_OPENVPN_OPENSSL

	config FREETZ_PACKAGE_OPENVPN_OPENSSL
		bool "OpenSSL"
		select FREETZ_OPENSSL_VERSION_PROMPT if FREETZ_PACKAGE_OPENVPN_STATIC
		select FREETZ_LIB_libcrypto if ! FREETZ_PACKAGE_OPENVPN_STATIC
		select FREETZ_LIB_libssl    if ! FREETZ_PACKAGE_OPENVPN_STATIC

	config FREETZ_PACKAGE_OPENVPN_MBEDTLS
		bool "mbed TLS"
		select FREETZ_LIB_libmbedcrypto if ! FREETZ_PACKAGE_OPENVPN_STATIC
		select FREETZ_LIB_libmbedtls    if ! FREETZ_PACKAGE_OPENVPN_STATIC
		select FREETZ_LIB_libmbedx509   if ! FREETZ_PACKAGE_OPENVPN_STATIC
		help
			Leads to smaller binaries, but lacks support for some openssl features.

endchoice

config FREETZ_PACKAGE_OPENVPN_FORCE_BLOWFISH
	bool "Include cipher blowfish in mbedTLS"
	depends on FREETZ_PACKAGE_OPENVPN_MBEDTLS
	select FREETZ_LIB_libmbedcrypto_WITH_BLOWFISH if FREETZ_PACKAGE_OPENVPN_MBEDTLS
	default n
	help
		Compile mbedTLS with support for OpenVPN default cipher "blowfish" (BF-CBC).
		Library/Binary size will increase approx. 7k (uncompressed).

config FREETZ_PACKAGE_OPENVPN_WITH_BLOWFISH
	bool
	depends on FREETZ_PACKAGE_OPENVPN_OPENSSL \
		|| (FREETZ_PACKAGE_OPENVPN_MBEDTLS  && FREETZ_LIB_libmbedcrypto_WITH_BLOWFISH)
	default y

config FREETZ_PACKAGE_OPENVPN_STATIC
	bool "Create statically linked binary"
	default n
	help
		Causes all libraries OpenVPN depends on to be linked in statically.

config FREETZ_PACKAGE_OPENVPN_WITH_LZO
	bool "With LZO compression"
	select FREETZ_LIB_liblzo2 if ! FREETZ_PACKAGE_OPENVPN_STATIC
	default y
	help
		LZO compression for VPN traffic

config FREETZ_PACKAGE_OPENVPN_WITH_LZ4
	bool "With LZ4 compression"
	select FREETZ_LIB_liblz4 if ! FREETZ_PACKAGE_OPENVPN_STATIC
	default n
	help
		LZ4 compression for VPN traffic

config FREETZ_PACKAGE_OPENVPN_WITH_TRAFFIC_OBFUSCATION
	bool "With traffic obfuscation"
	default n
	help
		Adds support for an additional configuration option 'scramble'
		with the following possible values:
		 * "xormask" xormask
		 * "xorptrpos"
		 * "reverse"
		 * "obfuscate" xormask

		WARNING:
		 'scramble'-option and SSLH are NOT compatible. SSLH is not
		 able to recognize OpenVPN traffic if 'scramble'-option
		 is enabled in OpenVPN config. Don't enable it if you plan
		 to use SSLH to demultiplex OpenVPN protocol.

comment "Warning: OpenVPN traffic obfuscation and SSLH are not compatible"
	depends on FREETZ_PACKAGE_OPENVPN_WITH_TRAFFIC_OBFUSCATION && FREETZ_PACKAGE_SSLH

config FREETZ_PACKAGE_OPENVPN_WITH_MGMNT
	bool "Enable Management Console"
	default n
	help
		Enables OpenVPN's Management Console for administrative Tasks.
		This feature is not configurable via Web-UI.

config FREETZ_PACKAGE_OPENVPN_ENABLE_SMALL
	bool "Optimize for size"
	default y
	help
		Enables binary optimiziation for size.
		Must be disabled to use the config option "explicit-exit-notify".

config FREETZ_PACKAGE_OPENVPN_USE_IPROUTE
	bool "Use 'ip' instead of 'ifconfig' and 'route'"
	select FREETZ_BUSYBOX_IP
	default n
	help
		Enables openvpn to use ip when setting IPs, link parameters and routes.
		This selects busybox's 'IP' applet.

config FREETZ_PACKAGE_OPENVPN_USE_V2_CGI
	bool "Use new (simple) GUI - EXPERIMENTAL"
	depends on FREETZ_SHOW_ADVANCED
	select FREETZ_PACKAGE_OPENVPN_V2_CGI
	default n
	help
		CAUTION: This option will delete configurations made with "old" GUI!
		New quite simple OpenVPN configuration interface.
		It will not generate a configuration file based on GUI settings
		but just ask for an existing configuration.

endif # FREETZ_PACKAGE_OPENVPN
```

## make/orangebox/Config.in
```kconfig
config FREETZ_PACKAGE_ORANGEBOX
	bool "Orangebox 1.05"
	depends on  FREETZ_TYPE_FON_WLAN_7140 || \
		    FREETZ_TYPE_FON_WLAN_7141 || \
		    FREETZ_TYPE_FON_WLAN_7170 || \
		    FREETZ_TYPE_SPEEDPORT_W701V || \
		    FREETZ_TYPE_CUSTOM
	default n
	help
	    Shadwo000's web interface mod

config FREETZ_PACKAGE_ORANGEBOX_TSB
	bool "tsb"
	depends on FREETZ_PACKAGE_ORANGEBOX
	default n
	help
	    TSB-LCR Button
```
