## make/ripmime/Config.in
```kconfig
config FREETZ_PACKAGE_RIPMIME
	bool "ripmime 1.2.16.21 (binary only)"
	default n
	help
		ripmime is an utility to decode and extract the parts of
		mime-formatted mails.
```

## make/rpcbind/Config.in
```kconfig
config FREETZ_PACKAGE_RPCBIND
	bool "RPCBind 1.2.5 (binary only)"
	depends on !FREETZ_TARGET_UCLIBC_SUPPORTS_rpc
	default n
	select FREETZ_PACKAGE_TCP_WRAPPERS
	select FREETZ_LIB_libtirpc
	select FREETZ_ADD_ETCNETCONFIG
	help
		The rpcbind utility is a server that converts
		RPC program numbers into universal addresses.
```

## make/rrdstats/Config.in
```kconfig
config FREETZ_PACKAGE_RRDSTATS
	bool "RRDstats for RRDtool"
	select FREETZ_PACKAGE_RRDTOOL
	select FREETZ_BUSYBOX_NICE
	select FREETZ_BUSYBOX_START_STOP_DAEMON
	default n
	help
		Lets you view graphically various stats of your Freetz Box.
		Selects BusyBox's 'nice' to save spare resources.


config FREETZ_PACKAGE_RRDSTATS_CABLEMODEM
	bool "Support for cabel modem logging"
	depends on FREETZ_PACKAGE_RRDSTATS
	default n
	select FREETZ_BUSYBOX_WGET if !FREETZ_PACKAGE_WGET
	help
		Enables the options in the Webif and
		selects (BusyBox or GNU) wget.
		Logging of frequencies, signal strength
		and SNR for these cable modems:
		 * Thomson THG (520 and 540)
		 * Cisco EPC 3212 (09.06.2010 and 25.02.2012)
		 * Arris Touchstone TM

config FREETZ_PACKAGE_RRDSTATS_CABLEMODEM_WGET
	bool "Use GNU wget"
	depends on FREETZ_PACKAGE_RRDSTATS_CABLEMODEM
	default y
	select FREETZ_PACKAGE_WGET
	help
		Selects GNU wget instead of BusyBox's.
		This is recommended since it prevents stalling
		of whole RRDstats if the modem is not reachable.


config FREETZ_PACKAGE_RRDSTATS_SEGMENTLOAD
	bool "Support for cable segment load"
	depends on FREETZ_PACKAGE_RRDSTATS
	default n
	select FREETZ_PACKAGE_DVBSNOOP
	select FREETZ_PACKAGE_DVBTUNE
	help
		Enables the options in the Webif and
		selects dvbtune & dvbsnoop.
		This is for logging the load of your
		whole cable internet segment.

config FREETZ_PACKAGE_RRDSTATS_SEGMENTLOAD_SUNDTEK
	bool "Sundtek DVB driver"
	depends on FREETZ_PACKAGE_RRDSTATS_SEGMENTLOAD
	default n
	select FREETZ_PACKAGE_SUNDTEK
	help
		Selects Sundtek DVB driver.


config FREETZ_PACKAGE_RRDSTATS_STORAGE
	bool "Support for storage devices"
	depends on FREETZ_PACKAGE_RRDSTATS
	default y
	help
		Enables the options in the Webif.
		Logging of devices (eg 'sda') or
		partitions (eg 'sda1') is possible.


config FREETZ_PACKAGE_RRDSTATS_NETWORK
	bool "Support for network interfaces"
	depends on FREETZ_PACKAGE_RRDSTATS
	default y
	help
		Enables the options in the Webif.
		Logging of real devices (eg 'eth0')
		or virtual (eg 'lan') is possible.


config FREETZ_PACKAGE_RRDSTATS_DIGITEMP
	bool "Support for DigiTemp"
	depends on FREETZ_PACKAGE_RRDSTATS
	default n
	select FREETZ_PACKAGE_DIGITEMP
	select FREETZ_BUSYBOX_UNIQ
	help
		Enables the options in the Webif and
		selects DigiTemp.
		Logging of 1-wire temperature sensors with DigiTemp.
```

## make/rrdtool/Config.in
```kconfig
config FREETZ_PACKAGE_RRDTOOL
	bool "RRDtool 1.2.27 (binary only)"
	select FREETZ_LIB_libfreetype
	select FREETZ_LIB_libpng12
	select FREETZ_LIB_libart_lgpl_2
	select FREETZ_LIB_libz
	default n
	help
		RRDtool is the OpenSource industry standard, high
		performance data logging and graphing system for 
		time series data. Use it to write your custom 
		monitoring shell scripts or create whole applications
		using its PHP bindings.
```

## make/rsync/Config.in
```kconfig
config FREETZ_PACKAGE_RSYNC
	bool "rsync 3.0.5"
	select FREETZ_LIB_libpopt
	default n
	help
		rsync is an open source utility that provides fast incremental 
		file transfer.
```

## make/rtmpdump/Config.in
```kconfig
config FREETZ_PACKAGE_RTMPDUMP
	bool "RTMPDump 2.4-git (binary only)"
	select FREETZ_PACKAGE_RTMPDUMP_rtmpdump
	help
		rtmpdump is a toolkit for RTMP streams. All forms of RTMP are supported,
		including rtmp://, rtmpt://, rtmpe://, rtmpte://, and rtmps://.

config FREETZ_PACKAGE_RTMPDUMP_WITH_SSL
	bool "with SSL support"
	depends on FREETZ_PACKAGE_RTMPDUMP
	select FREETZ_LIB_libpolarssl13
	select FREETZ_LIB_libz

config FREETZ_PACKAGE_RTMPDUMP_rtmpdump
	bool "rtmpdump"
	depends on FREETZ_PACKAGE_RTMPDUMP
	default y
	help
		RTMP streaming media client

config FREETZ_PACKAGE_RTMPDUMP_rtmpgw
	bool "rtmpgw"
	depends on FREETZ_PACKAGE_RTMPDUMP
	select FREETZ_LIB_libpthread if FREETZ_TARGET_UCLIBC_HAS_multiple_libs
	help
		RTMP streaming media gateway
```

## make/ruby-fcgi/Config.in
```kconfig
config FREETZ_PACKAGE_RUBY_FCGI
	bool "FastCGI support for RUBY"
	depends on FREETZ_PACKAGE_RUBY
	default n
	help
		FastCGI support for RUBY. This package also installs a ruby-cgi
		application which can be used by web servers to interact with
		RUBY via FastCGI

		
```

## make/ruby/Config.in
```kconfig
config FREETZ_PACKAGE_RUBY
	bool "Ruby (binary only)"
	select FREETZ_LIB_libcrypt
	select FREETZ_LIB_libdl
	select FREETZ_LIB_libm
	select FREETZ_LIB_libpthread if FREETZ_RUBY_VERSION_1_9
	select FREETZ_LIB_librt
	default n
	help
		Ruby is a dynamic, open source programming language with a focus on
		simplicity and productivity. It has an elegant syntax that is natural
		to read and easy to write.

		Ruby is a language of careful balance. Its creator, Yukihiro "matz"
		Matsumoto, blended parts of his favorite languages (Perl, Smalltalk,
		Eiffel, Ada, and Lisp) to form a new language that balanced functional
		programming with imperative programming. He has often said that he is
		"trying to make Ruby natural, not simple". Ruby is simple in appearance,
		but is very complex inside.

		http://www.ruby-lang.org/

		This package contains
		  - the Ruby interpreter,
		  - the interactive Ruby console (irb),
		  - the full Ruby API, i.e. all *.rb modules,
		  - all *.so extension libraries. These may
		    also be linked in statically or not built at all, but there is no
		    menuconfig option for it. Do this yourself according to Ruby's
		    README if you like.
		I.e. in total we have about 5.5 MB of installed files of which you may
		strip away unneeded ones from packages/ruby-1.8.6 manually as you see
		fit. Do this after "make precompiled", but before "make".

		By the way: Ruby modules are well compressible, so the full monty just
		needs about 1.3 MB inside the firmware image. So even if you are not
		working with Downloader CGI or NFS root, Ruby may well fit into your
		image along with several other packages, if you have an 8 MB box.

		ATTENTION: You should have installed the same Ruby version on your host
		in order to be able to successfully build the target version!

choice
	depends on FREETZ_PACKAGE_RUBY
	prompt "version"
	default FREETZ_RUBY_VERSION_1_8

	config FREETZ_RUBY_VERSION_1_8
		bool "ruby 1.8.7-p374"
	config FREETZ_RUBY_VERSION_1_9
		bool "ruby 1.9.3-p547 (HIGHLY EXPERIMENTAL)"
		depends on FREETZ_SHOW_EXPERT
endchoice

config FREETZ_RUBY_SHLIB_VERSION
	depends on FREETZ_PACKAGE_RUBY
	string
	default "1.8.7" if FREETZ_RUBY_VERSION_1_8
	default "1.9.1" if FREETZ_RUBY_VERSION_1_9

# Include ruby-fcgi here
source make/ruby-fcgi/Config.in
```

## make/rush/Config.in
```kconfig
config FREETZ_PACKAGE_RUSH
	bool "Rush 1.7 (binary only)"
	default n
	help
		GNU Rush is a Restricted User Shell, designed
		for sites providing limited remote access to
		their resources, such as, for example,
		savannah.gnu.org. Its main program, rush, is
		configured as a user login shell for users
		that are allowed only remote access to the
		machine. Using a flexible configuration file,
		GNU Rush gives administrator complete control
		over the command lines that users execute,
		and allows to tune the usage of system
		resources, such as virtual memory,
		CPU time, etc. on a per-user basis.
		http://puszcza.gnu.org.ua/software/rush/
```

## make/samba/Config.in
```kconfig
config FREETZ_PACKAGE_SAMBA
	bool "Samba smbd (Filesharing)"
	select FREETZ_LIB_libcrypt
	select FREETZ_LIB_libdl
	select FREETZ_LIB_libresolv
	select FREETZ_LIB_libpopt
	select FREETZ_LIB_libz        if FREETZ_SAMBA_VERSION_3_6
	select FREETZ_LIB_libiconv    if FREETZ_TARGET_UCLIBC_VERSION_0_9_28
	default n
	help
		Provides the Samba SMB server (smbd). This is what you need if you would
		like your router's file system to be accessible from Windows or from
		other UNIX/Linux machines via smbmount, smbclient, cifsmount or similar.

config FREETZ_PACKAGE_NMBD
	bool "Samba nmbd (Nameservices)"
	depends on FREETZ_PACKAGE_SAMBA
	default n
	help
		Provides the Samba NetBIOS nameserver (nmbd). This is what you need if you
		would like to see your Fritzbox in the network neighbourhood or act as a
		masterbrowser.

choice
	depends on FREETZ_PACKAGE_SAMBA
	prompt "version"
	default FREETZ_SAMBA_VERSION_3_0

	config FREETZ_SAMBA_VERSION_3_0
		bool "samba 3.0.37"
		help
			The binary with smbd and nmbd needs about 1033 kB (uncompressed).

	config FREETZ_SAMBA_VERSION_3_6
		bool "samba 3.6.3"
		help
			The binary with smbd and nmbd needs about 1732 kB (uncompressed).

endchoice

config FREETZ_PACKAGE_SAMBA_MAX_DEBUG_LEVEL
	int "Maximum level of compiled-in debug messages"
	depends on FREETZ_PACKAGE_SAMBA
	default -1
	help
		1000 - include all debug messages
		   2 - include only important messages
		  -1 - disable debug messages completely

		 Note: this option affects the size of the Samba binary.
		       The higher the debug level, the more debug output
		       is generated and the bigger the binary is.
```
