## make/sfk/Config.in
```kconfig
config FREETZ_PACKAGE_SFK
	bool "Swiss File Knife 1.7.6"
	default n
	select FREETZ_LIB_STDCXXLIB
	select FREETZ_LIB_libpthread if !FREETZ_PACKAGE_SFK_STATIC
	help
		build the freeware version of sfk, see the site
		http://stahlworks.com/dev/swiss-file-knife.html
		for further information

config FREETZ_PACKAGE_SFK_STATIC
	bool "link statically"
	default n
	depends on FREETZ_PACKAGE_SFK
	help
		create a version usable without additional DSOs
```

## make/sg3_utils/Config.in
```kconfig
config FREETZ_PACKAGE_SG3UTILS
	bool "sg3_utils (binary only)"
	depends on FREETZ_PACKAGE_SPINDOWN_CGI
	default n
	help
		The sg3_utils package contains utilities that send SCSI commands to devices.
		As well as devices on transports traditionally associated with SCSI (e.g.
		Fibre Channel (FCP), Serial Attached SCSI (SAS) and the SCSI Parallel
		Interface(SPI)) many other devices use SCSI command sets. ATAPI cd/dvd drives
		and SATA disks that connect via a translation layer or a bridge device are
		examples of devices that use SCSI command sets.

		This package is primarly used by the spindown cgi package. Note also that
		currently only sg_start is built and used, other tools may follow as needed.
```

## make/shadowsocksr/Config.in
```kconfig
config FREETZ_PACKAGE_SHADOWSOCKSR
	bool "ShadowsocksR 0.5"
	select FREETZ_LIB_libuv
	select FREETZ_LIB_libz
	select FREETZ_LIB_libpcre
        select FREETZ_LIB_libjson_c
	select FREETZ_LIB_libsodium
	select FREETZ_LIB_libmbedtls
	default n
	help
		ShadowsocksR-native is a lightweight secured SOCKS5 proxy for embedded devices and low-end boxes
```

## make/shellinabox/Config.in
```kconfig
config FREETZ_PACKAGE_SHELLINABOX
	bool "shellinabox 2.21"
	select FREETZ_LIB_libutil if !FREETZ_PACKAGE_SHELLINABOX_STATIC && !FREETZ_PACKAGE_SHELLINABOX_NONFREETZ && FREETZ_TARGET_UCLIBC_HAS_multiple_libs
	default n
	help
		Shell In A Box implements a web server that can export arbitrary
		command line tools to a web based terminal emulator.
		This emulator is accessible to any JavaScript and CSS enabled
		web browser and does not require any additional browser plugins.

config FREETZ_PACKAGE_SHELLINABOX_SSL
	depends on FREETZ_PACKAGE_SHELLINABOX
	bool "build with SSL support"
	select FREETZ_LIB_libcrypto  if ! FREETZ_PACKAGE_SHELLINABOX_STATIC
	select FREETZ_LIB_libssl     if ! FREETZ_PACKAGE_SHELLINABOX_STATIC
	default y
	help
		Building "Shell In A Box" w/o SSL will lead to a
		much smaller binary, but access is unsecure!

config FREETZ_PACKAGE_SHELLINABOX_BOXCERT
	depends on FREETZ_PACKAGE_SHELLINABOX_SSL
	depends on FREETZ_BOX_CERTIFICATE_SUPPORT_AVAILABLE
	bool "build with support for FRITZ!OS certificate"
	select FREETZ_PACKAGE_PRIVATEKEYPASSWORD
	default n
	help
		Building "Shell In A Box" with FRITZ!OS support
		enables use of existing box certificate and key.

config FREETZ_PACKAGE_SHELLINABOX_NONFREETZ
	bool "build with support for non-freetz'ed boxes"
	depends on FREETZ_PACKAGE_SHELLINABOX
	default n

config FREETZ_PACKAGE_SHELLINABOX_STATIC
	depends on FREETZ_PACKAGE_SHELLINABOX
	bool "Link statically"
	default n
	help
		Build "Shell In A Box" as a static binary.
```

## make/simpleobfs/Config.in
```kconfig
config FREETZ_PACKAGE_SIMPLEOBFS
	bool "simpleobfs 0.0.1 (binary only)"
	select FREETZ_LIB_libutil
        select FREETZ_LIB_libcrypto
        select FREETZ_LIB_libssl
        select FREETZ_LIB_libpcre
	select FREETZ_LIB_libev
	select FREETZ_LIB_libsodium
	select FREETZ_LIB_libcares
	default n
	help
		simple-obfs ...
```

## make/siproxd/Config.in
```kconfig
config FREETZ_PACKAGE_SIPROXD
	bool "siproxd 0.8.0"
	default n
	select FREETZ_LIB_libpthread
	select FREETZ_LIB_libresolv
	select FREETZ_LIB_libdl
	select FREETZ_LIB_libltdl
	select FREETZ_LIB_libosip2
	help
		Siproxd is a proxy/masquerading daemon for the SIP protocol.
		Uses static compiled-in libosip2.
		See http://siproxd.sourceforge.net

config FREETZ_PACKAGE_SIPROXD_PLUGIN_DEFAULTTARGET
	bool "include defaulttarget plugin"
	depends on FREETZ_PACKAGE_SIPROXD
	default n
	help
		include defaulttarget plugin

config FREETZ_PACKAGE_SIPROXD_PLUGIN_FIX_BOGUS_VIA
	bool "include fix_bogus_via plugin"
	depends on FREETZ_PACKAGE_SIPROXD
	default n
	help
		include fix_bogus_via plugin

config FREETZ_PACKAGE_SIPROXD_PLUGIN_LOGCALL
	bool "include logcall plugin"
	depends on FREETZ_PACKAGE_SIPROXD
	default n
	help
		include logcall plugin

config FREETZ_PACKAGE_SIPROXD_PLUGIN_SHORTDIAL
	bool "include shortdial plugin"
	depends on FREETZ_PACKAGE_SIPROXD
	default n
	help
		include shortdial plugin

config FREETZ_PACKAGE_SIPROXD_PLUGIN_STUN
	bool "include stun plugin"
	depends on FREETZ_PACKAGE_SIPROXD
	default n
	help
		include stun plugin

config FREETZ_PACKAGE_SIPROXD_PLUGIN_DEMO
	bool "include demo plugin"
	depends on FREETZ_PACKAGE_SIPROXD
	default n
	help
		include demo plugin (only for demo purposes)
```

## make/sispmctl/Config.in
```kconfig
config FREETZ_PACKAGE_SISPMCTL
	bool "sispmctl 3.1"
	depends on ! FREETZ_AVM_HAS_USB_HOST_AHCI
	select FREETZ_LIB_libusb_0
	default n
	help
		sispmctl is an application enabling the use of the GEMBIRD
		SiS-PM (sispm) USB-controlled power-outlet device under Linux.
		Note that the device is also sold under different names, i.e. as
		"IntelliPlug" in Germany.

config FREETZ_SISPMCTL_CGI
	bool "freetz specific cgi, rc script and parameter configuration"
	depends on FREETZ_PACKAGE_SISPMCTL
	default n
	help
		This option integrates freetz specific cgi for configuration
		of sispmctl and definition of start parameters for
		integrated web server. Also freetz adapted rc script with all
		required configuration files is integrated into image.
		If this option is deactivated, only sispmctl binary without
		freetz specific adaptation will be integrated into image.
		In this case user must start and handle the binary manually.

config FREETZ_SISPMCTL_WEB
	bool "enable internal web server"
	depends on FREETZ_PACKAGE_SISPMCTL
	default n
	help
		This option enables sispmctl's internal web server and
		installs the standard skin.

config FREETZ_SISPMCTL_SKIN2
	bool "install alternative SMARTPHONE skin for web interface"
	depends on FREETZ_PACKAGE_SISPMCTL
	depends on FREETZ_SISPMCTL_WEB
	default n
	help
		This option installs the third alternative skin
		(SMARTPHONE) for internal web interface
		additionaly to standard skin.
```

## make/smartmontools/Config.in
```kconfig
config FREETZ_PACKAGE_SMARTMONTOOLS
	bool "Smartmontools 7.3"
	select FREETZ_STDCXXLIB_FORCE_GNULIBSTDCXX
	select FREETZ_LIB_STDCXXLIB
	default n
	help
		Smartmontools contains utility programs (smartctl, smartd) to
		control/monitor storage systems using the Self-Monitoring, Analysis
		and Reporting Technology System (S.M.A.R.T.) built into most modern
		ATA and SCSI disks. It is derived from smartsuite.
```

## make/smusbutil/Config.in
```kconfig
config FREETZ_PACKAGE_SMUSBUTIL
	bool "smusbutil 1.1 (binary only)"
	select FREETZ_LIB_libftdi
	default n
	help
		Linux software for setting up the frequency and
		resetpolarity on WB Electronics ftdi devices.
		This utility is written and maintained by Carsten
		Sprung. WB Electronics does not currently provide
		official support for Linux, please contact the
		author directly for any support issues.
```

## make/socat/Config.in
```kconfig
config FREETZ_PACKAGE_SOCAT
	bool "socat 1.7.4.2 (binary only)"
	select FREETZ_REMOVE_SOCAT if FREETZ_AVM_HAS_SOCAT
	select FREETZ_LIB_libcrypto
	select FREETZ_LIB_libssl
	select FREETZ_LIB_libutil if FREETZ_TARGET_UCLIBC_HAS_multiple_libs
	select FREETZ_LIB_libz
	default n
	help
		socat is an extended netcat-like utility

config FREETZ_PACKAGE_SOCAT_WITHTERMIOS
	bool "enable termios in socat"
	depends on FREETZ_PACKAGE_SOCAT
	default n
	help
		Enable socat to use tty devices with termios
```

## make/spawn-fcgi/Config.in
```kconfig
config FREETZ_PACKAGE_SPAWN_FCGI
	bool "spawn-fcgi 1.6.3 (binary only)"
	default n
	help
		Spawns FastCGI processes
```

## make/spindown-cgi/Config.in
```kconfig
config DS_PACKAGE_SPINDOWN_CGI
	bool "spindown-cgi 0.2"
	default n
	select DS_PACKAGE_SG3UTILS
	help
		Choose this package if you want to spin down your attached USB disk after
		a configurable idle time period. However, it is not guaranteed to work with
		all disks.

#include sg3_utils
source make/sg3_utils/Config.in
```
