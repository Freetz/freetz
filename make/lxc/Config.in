## make/minisatip/Config.in
```kconfig
config FREETZ_PACKAGE_MINISATIP
	bool "minisatip 1.0.4 (binary only)"
	default n
	select FREETZ_LIB_libpthread     if FREETZ_TARGET_UCLIBC_HAS_multiple_libs
	select FREETZ_LIB_librt          if FREETZ_TARGET_UCLIBC_HAS_multiple_libs
	help
		Minisatip is a multi-threaded satip server version 1.2 that
		runs under Linux and it was tested with DVB-S, DVB-S2,
		DVB-T, DVB-T2, DVB-C, DVB-C2, ATSC and ISDB-T cards.

if FREETZ_PACKAGE_MINISATIP

config FREETZ_PACKAGE_MINISATIP_HTML
	bool "With html files"
	default y
	help
		Includes the document-root for the integrated web
		server in /usr/share/minisatip/html/ directory.

config FREETZ_PACKAGE_MINISATIP_LINUXDVB
	bool "Enable linux DVB"
	default y

config FREETZ_PACKAGE_MINISATIP_SATIPC
	bool "Enable SAT>IP client"
	default y

config FREETZ_PACKAGE_MINISATIP_DVBAPI
	bool "Enable DVBAPI"
	default y

config FREETZ_PACKAGE_MINISATIP_DVBAES
	bool "Enable DVB/AES"
	default y
	select FREETZ_LIB_libcrypto
	select FREETZ_LIB_libdl          if FREETZ_TARGET_UCLIBC_HAS_multiple_libs
	select FREETZ_LIB_libz

config FREETZ_PACKAGE_MINISATIP_DVBCSA
	bool "Enable DVB/CSA"
	default y
	select FREETZ_LIB_libdvbcsa

config FREETZ_PACKAGE_MINISATIP_BACKTRACE
	bool "Enable backtrace"
	default n
	depends on FREETZ_TARGET_UCLIBC_SUPPORTS_libubacktrace
	select FREETZ_LIB_libubacktrace  if FREETZ_TARGET_UCLIBC_HAS_multiple_libs

endif # FREETZ_PACKAGE_MINISATIP
```

## make/ministun/Config.in
```kconfig
config FREETZ_PACKAGE_MINISTUN
	bool "Mini STUN client 0.1 (binary only)"
	default n
	help
		Mini STUN client (code borrowed from Asterisk, source code provided by
		Vladislav Grishenko) efficiently determines the external IP by querying
		a public STUN server. Thus, this binary can optionally be used by
		Freetz's /usr/bin/get_ip as an alternative to querying a site like
		http://checkip.dyndns.org via wget.

		The uncompressed binary size is about 7 KB.
```

## make/mod/Config.in
```kconfig
config FREETZ_PACKAGE_MOD
	bool
	# cron
	select FREETZ_BUSYBOX_CROND
	select FREETZ_BUSYBOX_CRONTAB
	# webif
	select FREETZ_BUSYBOX_HTTPD
	select FREETZ_BUSYBOX_FEATURE_HTTPD_AUTH_MD5
	select FREETZ_BUSYBOX_FEATURE_HTTPD_BASIC_AUTH
	select FREETZ_BUSYBOX_FEATURE_HTTPD_CGI
	select FREETZ_BUSYBOX_FEATURE_HTTPD_CONFIG_WITH_SCRIPT_INTERPR
	select FREETZ_BUSYBOX_FEATURE_HTTPD_ENCODE_URL_STR
	# modsave
	select FREETZ_BUSYBOX_MD5SUM
	# modusers
	select FREETZ_BUSYBOX_INOTIFYD if FREETZ_SEPARATE_AVM_UCLIBC
	# telnetd
	select FREETZ_BUSYBOX_TELNETD if FREETZ_ADD_TELNETD || (FREETZ_AVM_HAS_TELNETD && !FREETZ_REMOVE_TELNETD)
	select FREETZ_BUSYBOX_FEATURE_TELNETD_STANDALONE if FREETZ_BUSYBOX_TELNETD
	default y
	help
		This package is mandatory

config FREETZ_PACKAGE_MOD_SWAPOPTIONS
	bool
	depends on FREETZ_ADD_SWAPOPTIONS
	select FREETZ_BUSYBOX_MKSWAP
	select FREETZ_BUSYBOX_SWAPOFF
	select FREETZ_BUSYBOX_SWAPON
	default n
	help
		Add swap configuration options

config FREETZ_PACKAGE_MOD_ETCSERVICES
	bool
	depends on FREETZ_ADD_ETCSERVICES
	default n
	help
		Add small /etc/services file

config FREETZ_PACKAGE_MOD_ETCNETCONFIG
	bool
	depends on FREETZ_ADD_ETCNETCONFIG
	default n
	help
		Add small /etc/netconfig file
```

## make/module-init-tools/Config.in
```kconfig
config FREETZ_PACKAGE_MODULE_INIT_TOOLS
	bool "module-init-tools 3.12 (binary only)"
	default n
	help
		The module-init-tools (m-i-t) package provides many of
		the utilities needed by Linux systems for managing loadable
		Linux Kernel Modules. This includes depmod, insmod, rmmod,
		modprobe and tools like modinfo.


if FREETZ_PACKAGE_MODULE_INIT_TOOLS

config FREETZ_PACKAGE_MODULE_INIT_TOOLS_depmod
	bool "depmod"
	default n

config FREETZ_PACKAGE_MODULE_INIT_TOOLS_insmod
	bool "insmod"
	depends on !FREETZ_AVM_HAS_KMOD
	default n

config FREETZ_PACKAGE_MODULE_INIT_TOOLS_lsmod
	depends on !FREETZ_AVM_HAS_KMOD
	bool "lsmod"
	default n

config FREETZ_PACKAGE_MODULE_INIT_TOOLS_modindex
	bool "modindex"
	default n

config FREETZ_PACKAGE_MODULE_INIT_TOOLS_modinfo
	bool "modinfo"
	default n

config FREETZ_PACKAGE_MODULE_INIT_TOOLS_modprobe
	bool "modprobe"
	depends on !FREETZ_AVM_HAS_KMOD
	default n

config FREETZ_PACKAGE_MODULE_INIT_TOOLS_rmmod
	bool "rmmod"
	depends on !FREETZ_AVM_HAS_KMOD
	default n

endif #FREETZ_PACKAGE_MODULE_INIT_TOOLS
```

## make/mosquitto/Config.in
```kconfig
config FREETZ_PACKAGE_MOSQUITTO
	bool "Mosquitto 1.6.15"
	default n
	select FREETZ_PACKAGE_MOSQUITTO_BROKER if (!FREETZ_PACKAGE_MOSQUITTO_CLIENT_PUB && !FREETZ_PACKAGE_MOSQUITTO_CLIENT_SUB)
	help
		Eclipse Mosquitto™ is an open source (EPL/EDL licensed) message broker that implements
		the MQTT protocol versions 5.0, 3.1.1 and 3.1. MQTT provides a lightweight method of
		carrying out messaging using a publish/subscribe model. This makes it suitable
		for "Internet of Things" messaging such as with low power sensors or mobile devices
		such as phones, embedded computers or microcontrollers like the Arduino.

if FREETZ_PACKAGE_MOSQUITTO

	config FREETZ_PACKAGE_MOSQUITTO_BROKER
		bool "include broker"
		select FREETZ_LIB_libdl  if FREETZ_TARGET_UCLIBC_HAS_multiple_libs
		select FREETZ_LIB_libm   if FREETZ_TARGET_UCLIBC_HAS_multiple_libs
		select FREETZ_LIB_librt  if FREETZ_TARGET_UCLIBC_HAS_multiple_libs
		default y
		help
			Adds the mosquitto broker to the image

	config FREETZ_PACKAGE_MOSQUITTO_CLIENTS
		bool "include clients"
		# libmosquitto dependencies
		select FREETZ_LIB_librt       if FREETZ_TARGET_UCLIBC_HAS_multiple_libs
		select FREETZ_LIB_libpthread  if FREETZ_TARGET_UCLIBC_HAS_multiple_libs
		default n

	if FREETZ_PACKAGE_MOSQUITTO

		config FREETZ_PACKAGE_MOSQUITTO_CLIENT_PUB
			bool "include publish client"
			default n
			help
				Adds the mosquitto publish client to the image

		config FREETZ_PACKAGE_MOSQUITTO_CLIENT_SUB
			bool "include subscribe client"
			default n
			help
				Adds the mosquitto subscribe client to the image

		config FREETZ_PACKAGE_MOSQUITTO_WITH_UUID
			bool "enable uuid support in mosquitto"
			select FREETZ_LIB_libuuid
			default y
			help
				Build using libuuid for clientid generation.

	endif # FREETZ_PACKAGE_MOSQUITTO

	comment "SSL not available, needs OpenSSL 1.0 or newer"
		depends on !FREETZ_OPENSSL_VERSION_1_MIN

	config FREETZ_PACKAGE_MOSQUITTO_WITH_SSL
		bool "build with SSL support"
		depends on FREETZ_OPENSSL_VERSION_1_MIN
		select FREETZ_LIB_libcrypto
		select FREETZ_LIB_libcrypto_WITH_EC
		select FREETZ_LIB_libssl
		default n
		help
			This option enables SSL support for mosquitto.

endif # FREETZ_PACKAGE_MOSQUITTO
```

## make/mtr/Config.in
```kconfig
config FREETZ_PACKAGE_MTR
	bool "MTR 0.80/0.95 (binary only)"
	select FREETZ_LIB_libncurses
	default n
	help
		MTR combines the functionality of the 'traceroute' and 'ping' programs
		in a single network diagnostic tool.

if FREETZ_PACKAGE_MTR

	config FREETZ_PACKAGE_MTR_VERSION_ABANDON
		bool
		default y
		depends on !FREETZ_TARGET_GCC_4_8_MIN

endif # FREETZ_PACKAGE_MTR
```

## make/nagios/Config.in
```kconfig
config FREETZ_PACKAGE_NAGIOS
	bool "nagios 2.11 (binary only)"
	select FREETZ_PACKAGE_MICROPERL
	default n
	help
		Nagios is an Open Source host, service and network monitoring program.
```

## make/nano-shell/Config.in
```kconfig
config FREETZ_PACKAGE_NANO_SHELL
	bool "Nano Shell"
	default n
	help
		Remotely execute arbitrary shell commands via URLs

		This tiny package enables both the AVM and Freetz web interfaces to
		execute user-specified commands and display their results and/or errors,
		if available.

		ATTENTION! Nano shell should only be used for debugging purposes, e.g. if
		telnetd, sshd (Dropbear) or Rudi shell are unavailable for any reason.
		This is a last resort for executing commands on a router box if anything
		else fails, but at least one of the two web interfaces (AVM, Freetz) is
		available. It is a POTENTIAL SECURITY HOLE, though, so never use it if
		your web interfaces are insecurely open to the outside world!!!

		How to use: Send a URL-encoded command appended to the corresponding CGI,
		for example
		  * http://fritz.box/cgi-bin/shell.cgi       (AVM web UI)
		  * http://speedport.ip/cgi-bin/shell.cgi    (AVM web UI)
		  * http://192.168.0.1/cgi-bin/shell.cgi     (AVM web UI)
		  * http://fritz.box:81/cgi-bin/shell.cgi    (Freetz web UI)
		  * http://speedport.ip:81/cgi-bin/shell.cgi (Freetz web UI)
		  * http://192.168.0.1:81/cgi-bin/shell.cgi  (Freetz web UI)
		or in general, whichever name or IP address applies to your environment.

		Example commands and corresponding encoded URLs:
		  * ls -l /var/tmp
		    http://fritz.box/cgi-bin/shell.cgi?ls%20-l%20%2Fvar%2Ftmp
		  * /usr/sbin/telnetd -p 2323 -l /bin/sh
		    http://fritz.box/cgi-bin/shell.cgi?%2Fusr%2Fsbin%2Ftelnetd%20-p%202323%20-l%20%2Fbin%2Fsh
		  * echo "Erster Befehl"; cat /etc/motd; echo "Dritter Befehl"
		    http://fritz.box/cgi-bin/shell.cgi?echo%20%22Erster%20Befehl%22%3B%20cat%20%2Fetc%2Fmotd%3B%20echo%20%22Dritter%20Befehl%22

		There are online URL encoders on the web, e.g.
		http://netzreport.googlepages.com/online_tool_zur_url_kodierung_de.html#kodieren

		Usability tip (tested in IE7, Opera 9.23 and Firefox 2.0.6):
		Many browsers accept unencoded (i.e. clear-text) CGI parameters, i.e.
		you can usually also write
		  * http://fritz.box/cgi-bin/shell.cgi?ls -l /var/tmp
		  * http://fritz.box/cgi-bin/shell.cgi?/usr/sbin/telnetd -p 2323 -l /bin/sh
		  * http://fritz.box/cgi-bin/shell.cgi?echo "Erster Befehl"; cat /etc/motd; echo "Dritter Befehl"
```

## make/nano/Config.in
```kconfig
config FREETZ_PACKAGE_NANO
	bool "Nano 2.2.5 text editor"
	select FREETZ_LIB_libncurses
	default n
	help
		GNU GPL'd Pico clone with more functionality.

		GNU nano is a small and friendly text editor. Besides basic text
		editing, nano offers many extra features like an interactive search
		and replace, go to line and column number, auto-indentation, feature
		toggles and filename tab completion. 

		The original goal for nano was a complete bug-for-bug compatible
		emulation of Pico, but nano's current goal is to be as compatible as
		possible while offering a superset of Pico's functionality.

		IMPORTANT NOTES:

		1.) Selecting any option besides "Tiny binary" will make the nano binary
		bigger. The range is somewhere between 142 KB and 249 KB, depending on
		the options chosen.

		2.) Please also be aware of the fact that changing any feature options
		results in an automatic rebuild of the package - just in case you were
		wondering.
		
		3.) Note that UTF8 support and spell checking is disabled by default.

menu "Nano additional features"
	depends FREETZ_PACKAGE_NANO

config FREETZ_PACKAGE_NANO_TINY
	bool "Tiny binary"
	default y
	help
		Strip whichever feature possible from the Nano binary and keep
		everything small and simple, yet powerful and easy to use.

		With this option enabled as the only one, Nano's binary has an
		approximate size of 142 KB. NOTE that deselecting this option
		already results in a 182 KB binary in size although no other
		option has been selected. This is because nano compiler option
		"--enable-tiny" also disables some larger internals like
		marking and cutting to the end of a line.

config FREETZ_PACKAGE_NANO_HELP
	bool "Online help"
	depends ! FREETZ_PACKAGE_NANO_TINY
	default n
	help
		Show a list of available keyboard commands via Ctrl-G or F1. As the
		name suggests, this is quite helpful. ;-)

		This option adds about 8.4 KB to the minimum 182 KB of Nano's non-tiny binary.

		If you are unfamiliar with Nano and Pico and have some space left
		in the firmware image, you are recommended choosing this option anyway.

config FREETZ_PACKAGE_NANO_TABCOMP
	bool "Tab completion for file names"
	depends ! FREETZ_PACKAGE_NANO_TINY
	default n
	help
		When opening or saving files, you get tab completion for directory and
		file names. Even with the file browser switched off, this is a
		powerful tool to help you save time when typing in path names.

		This option adds about 4.7 KB to the minimum 182 KB
		of Nano's non-tiny binary.

config FREETZ_PACKAGE_NANO_BROWSER
	bool "File browser"
	depends ! FREETZ_PACKAGE_NANO_TINY
	default n
	help
		Browse the directory structure in a multi-line area showing
		directories and files between which you can navigate with the
		keyboard. The Browser is invoked by pressing ^T when entering
		a file name to open/write.

		This option adds about 9.7 KB to the minimum 182 KB
		of Nano's non-tiny binary.

config FREETZ_PACKAGE_NANO_OPERATINGDIR
	bool "Set operating directory"
	depends ! FREETZ_PACKAGE_NANO_TINY
	default n
	help
		Set operating directory. Makes Nano set up something
		similar to a chroot by using the '-o' command line option.

		This option adds almost nothing to the minimum 182 KB
		of Nano's non-tiny binary.

config FREETZ_PACKAGE_NANO_JUSTIFY
	bool "Justify/unjustify functions"
	depends ! FREETZ_PACKAGE_NANO_TINY
	default n
	help
		Support for (un-)justifying paragraphs of text, e.g. program code.

		This option adds about 9.4 KB to the minimum 182 KB
		of Nano's non-tiny binary.

config FREETZ_PACKAGE_NANO_WRAPPING
	depends ! FREETZ_PACKAGE_NANO_TINY
	bool "Long line wrapping"
	default n
	help
		Enable long line wrapping. This also creates the -w command line
		option which enables long line wrapping.

		This option adds about 4.4 KB to the minimum 182 KB
		of Nano's non-tiny binary.

config FREETZ_PACKAGE_NANO_WRAPPING_ROOT
	depends FREETZ_PACKAGE_NANO_WRAPPING
	bool "Disable long line wrapping for root"
	default n
	help
		Disable long line wrapping feature if nano is run as root.

		This option adds almost nothing to the minimum 182 KB
		of Nano's non-tiny binary.

config FREETZ_PACKAGE_NANO_MULTIBUFFER
	bool "Multiple file buffers"
	default n
	help
		Edit multiple files at once and cycle through the different buffers
		via simple keyboard commands.

		This option adds about 4.4 KB to the minimum 182 KB
		of Nano's non-tiny binary.

config FREETZ_PACKAGE_NANO_NANORC
	bool "Nanorc startup file support"
	default n
	help
		Enable support for reading the nanorc file at startup. You can store
		custom settings in the nanorc file rather than having to pass command
		line options to get desired behavior.

		This option adds about 9.6 KB to the minimum 182 KB
		of Nano's non-tiny binary.

		IMPORTANT: Please read the help text of the "Coloured syntax
		highlighting" feature in order to learn how to add a '.nanorc' to your
		target system. Please also refer to the nanorc man page at
		http://www.nano-editor.org/dist/v2.2/nanorc.5.html for further
		information about available options.

config FREETZ_PACKAGE_NANO_COLOR_SYNTAX
	bool "Coloured syntax highlighting support"
	default n
	select FREETZ_PACKAGE_NANO_NANORC
	help
		Enable support for syntax coloring of files using the nanorc file.
		This enables nanorc support, but does NOT automatically copy any
		syntax files to the target system.

		This option adds about 21.4 KB plus possibly a few KB of your
		syntax files to the minimum 182 KB of Nano's non-tiny binary,
		including nanorc support.

		IMPORTANT: If you want to include any syntax definition files
		(look for *.nanorc in the nano source package (doc/systax), define
		or download your own files), you are advised to copy them somewhere
		inside root/usr/share or packages/nano-x.y.z/root/usr/share. In
		addition to the syntax files themselves you want to edit the nanorc
		file to make nano aware of your favorite settings and syntax files.

endmenu
```
