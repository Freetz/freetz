## make/lxc/Config.in
```kconfig
config FREETZ_PACKAGE_LXC
	bool "lxc (LinuX Containers)"
	depends on FREETZ_TARGET_UCLIBC_VERSION_0_9_32
	select FREETZ_LIB_libcap
	default n
	help
		LinuX Containers
```

## make/lynx/Config.in
```kconfig
config DS_PACKAGE_LYNX
	bool "Lynx 2.8.5 web browser"
	#select DS_LIB_libgcc_s
	select DS_LIB_libncurses
	default n
	help
	    Lynx text mode web browser
	    
	    Lynx is a fully-featured World Wide Web (WWW) client for users running
	    cursor-addressable, character-cell display devices (e.g., vt100
	    terminals, vt100 emulators running on PCs or Macs, or any other
	    character-cell display). It will display HTML documents containing links
	    to files on the local system, as well as files on remote systems running
	    http, gopher, ftp, wais, nntp, finger, or cso/ph/qi servers, and
	    services accessible via logins to telnet, tn3270 or rlogin accounts.
```

## make/madplay/Config.in
```kconfig
config FREETZ_PACKAGE_MADPLAY
	bool "madplay 0.15.2b (binary only)"
	select FREETZ_LIB_libz
	select FREETZ_LIB_libid3tag
	select FREETZ_LIB_libmad
	select FREETZ_LIB_libm if FREETZ_TARGET_UCLIBC_HAS_multiple_libs
	default n
	help
		MAD is a high-quality fixed-point MPEG audio decoder with
		24-bit output. The implementation is entirely new, based on
		the ISO/IEC standards, and performs especially well on
		systems without native floating-point support.
```

## make/matrixtunnel/Config.in
```kconfig
config FREETZ_PACKAGE_MATRIXTUNNEL
	bool "Matrixtunnel 0.2 (binary only)"
	select FREETZ_LIB_libmatrixssl if ! FREETZ_PACKAGE_MATRIXTUNNEL_STATIC
	select FREETZ_LIB_libpthread if ! FREETZ_PACKAGE_MATRIXTUNNEL_STATIC_FULL
	default n
	help
		SSL tunnel based on matrixssl. Matrixtunnel is a stripped down version
		of stunnel based on matrixssl library. Essentially, this package makes
		your router's websrv or httpd SSL-enabled, offering you the option of
		remote configuration via WWW or secure remote use of features like
		Rudi-Shell.

config FREETZ_PACKAGE_MATRIXTUNNEL_STATIC
	bool "Create semistatic binary (link in matrixssl library only)"
	depends on FREETZ_PACKAGE_MATRIXTUNNEL
	default n
	help
		Eliminate run-time dependency on matrixssl by linking it statically.

config FREETZ_PACKAGE_MATRIXTUNNEL_STATIC_FULL
	bool "Create completely static binary (link in all libraries)"
	depends on FREETZ_PACKAGE_MATRIXTUNNEL
	select FREETZ_PACKAGE_MATRIXTUNNEL_STATIC
	default n
	help
		Create statically linked binary.
```

## make/mc/Config.in
```kconfig
menuconfig FREETZ_PACKAGE_MC
	bool "mc (Midnight Commander) 4.8.28 (binary only)"
	select FREETZ_SHARE_terminfo
	select FREETZ_LIB_libiconv if FREETZ_TARGET_UCLIBC_0_9_28
	select FREETZ_LIB_libglib_2
	default n

if FREETZ_PACKAGE_MC

	choice
		prompt "Widget library"
		default FREETZ_PACKAGE_MC_WITH_NCURSESW

		config FREETZ_PACKAGE_MC_WITH_NCURSES
		bool "Ncurses"
		select FREETZ_LIB_libncurses

		config FREETZ_PACKAGE_MC_WITH_NCURSESW
		bool "Ncursesw"
		select FREETZ_LIB_libncursesw

		config FREETZ_PACKAGE_MC_WITH_SLANG
		bool "S-Lang"
		select FREETZ_LIB_libslang
	endchoice

	config FREETZ_PACKAGE_MC_WITH_BACKGROUND
		bool "Background file operations support"
		default n

	config FREETZ_PACKAGE_MC_WITH_CHARSET
		bool "Charset selection and conversion support"
		default n

	config FREETZ_PACKAGE_MC_WITH_INTERNAL_EDIT
		bool "Internal editor support"
		default y

	config FREETZ_PACKAGE_MC_WITH_DIFF_VIEWER
		bool "Diff-viewer support"
		default n

	config FREETZ_PACKAGE_MC_WITH_SUBSHELL
		bool "Subshell support"
		default y
		select FREETZ_LIB_libutil if FREETZ_TARGET_UCLIBC_HAS_multiple_libs
		help
			Subshell support means you can press Ctrl-O to hide the mc panels and
			have a real subshell. Both Bash (if package is installed) and BusyBox
			Ash can be used, depending which one is defined as your login shell.

			ATTENTION: You should *not* use CONFIG_FEATURE_BASH_IS_ASH in BusyBox
			or otherwise symlink /bin/bash to /bin/busybox because MC must
			differentiate handling between Ash and real Bash.

			This feature adds about 8 KB (uncompressed) to the mc binary.

	config FREETZ_PACKAGE_MC_WITH_VFS
		bool "Virtual filesystem support"
		default n

	if FREETZ_PACKAGE_MC_WITH_VFS

	config FREETZ_PACKAGE_MC_WITH_VFS_CPIO
		bool "cpio"

	config FREETZ_PACKAGE_MC_WITH_VFS_EXTFS
		bool "extfs"
		default y

	config FREETZ_PACKAGE_MC_WITH_VFS_FTP
		bool "ftp"
		default n

	config FREETZ_PACKAGE_MC_WITH_VFS_SFS
		bool "sfs"
		default n

	config FREETZ_PACKAGE_MC_WITH_VFS_TAR
		bool "tar"
		default y

# TODO
#	config FREETZ_PACKAGE_MC_WITH_VFS_FISH
#		bool "fish"
#		default n
#	config FREETZ_PACKAGE_MC_WITH_VFS_SFTP
#		bool "sftp"
#		default n
#	config FREETZ_PACKAGE_MC_WITH_VFS_SMB
#		bool "smb"
#		default n
#	config FREETZ_PACKAGE_MC_WITH_VFS_UNDELFS
#		bool "undelfs"
#		default n

	endif # FREETZ_PACKAGE_MC_WITH_VFS

	config FREETZ_PACKAGE_MC_WITH_HELP
		bool "Include online help"
		default y

	config FREETZ_PACKAGE_MC_WITH_SYNTAX
		bool "Include syntax files"
		default y

endif # FREETZ_PACKAGE_MC
```

## make/mcabber/Config.in
```kconfig
config FREETZ_PACKAGE_MCABBER
	bool "mcabber 0.9.9"
	select FREETZ_LIB_libglib_2 if ! FREETZ_PACKAGE_MCABBER_STATIC
	select FREETZ_LIB_libncurses if ! FREETZ_PACKAGE_MCABBER_STATIC
	select FREETZ_LIB_libpanel if ! FREETZ_PACKAGE_MCABBER_STATIC
	default n
	help
		mcabber is a small Jabber console client.

		http://www.lilotux.net/~mikael/mcabber/

config FREETZ_PACKAGE_MCABBER_STATIC
	bool "Link statically"
	depends on FREETZ_PACKAGE_MCABBER
	select FREETZ_SHARE_terminfo
	default n
	help
		MCABBER needs the following shared libraries which can be linked in statically
		by activating this switch:
		- libncurses
		- libglib2
		- libpanel
		- libcrypto (if ssl-support is selected)
		- libssl (if ssl-support is selected)

config FREETZ_PACKAGE_MCABBER_WITH_SSL
	bool "with SSL-Support"
	select FREETZ_LIB_libcrypto if !FREETZ_PACKAGE_MCABBER_STATIC
	select FREETZ_LIB_libssl    if !FREETZ_PACKAGE_MCABBER_STATIC
	depends on FREETZ_PACKAGE_MCABBER
	default n
	help
		enables SSL-Support for mcabber
```

## make/mdev/Config.in
```kconfig
config FREETZ_PACKAGE_MDEV
	bool "mdev 0.6.2 (unstable)"
	depends on \
		! FREETZ_HAS_AVM_UDEV && \
		( \
		  FREETZ_TYPE_7170 || \
		  FREETZ_TYPE_7240 || \
		  FREETZ_TYPE_7270 \
		)
	select FREETZ_PACKAGE_E2FSPROGS
	select FREETZ_PACKAGE_E2FSPROGS_E2FSCK
	select FREETZ_BUSYBOX_TAC
	select FREETZ_BUSYBOX_MDEV
	select FREETZ_BUSYBOX_FEATURE_MDEV_CONF
	select FREETZ_BUSYBOX_FEATURE_MDEV_RENAME
	select FREETZ_BUSYBOX_FEATURE_MDEV_RENAME_REGEXP
	select FREETZ_BUSYBOX_FEATURE_MDEV_EXEC
	select FREETZ_BUSYBOX_FEATURE_VOLUMEID
	select FREETZ_BUSYBOX_FEATURE_VOLUMEID_EXT
	select FREETZ_BUSYBOX_FEATURE_VOLUMEID_FAT
	select FREETZ_BUSYBOX_FEATURE_MOUNT_LABEL
	select FREETZ_BUSYBOX_REALPATH
	select FREETZ_BUSYBOX_USLEEP
	default n
	help
		Hotplug replacement using the busybox mdev utility. It contains a complete
		configuration and is easily extensible.
```

## make/mediatomb/Config.in
```kconfig
config FREETZ_PACKAGE_MEDIATOMB
	bool "mediatomb 0.12.1 (binary only)"
	select FREETZ_LIB_libavformat                 if !FREETZ_PACKAGE_MEDIATOMB_STATIC
	select FREETZ_LIB_libavutil                   if !FREETZ_PACKAGE_MEDIATOMB_STATIC
	select FREETZ_PACKAGE_FFMPEG
	select FREETZ_PACKAGE_FFMPEG_PATENTED
	select FREETZ_PACKAGE_FFMPEG_LIBDLNA_SUPPORT
	select FREETZ_LIB_libcurl                     if !FREETZ_PACKAGE_MEDIATOMB_STATIC
	select FREETZ_LIB_libexif                     if !FREETZ_PACKAGE_MEDIATOMB_STATIC
	select FREETZ_LIB_libexpat                    if !FREETZ_PACKAGE_MEDIATOMB_STATIC
	select FREETZ_LIB_libpthread                  if !FREETZ_PACKAGE_MEDIATOMB_STATIC && FREETZ_TARGET_UCLIBC_HAS_multiple_libs
	select FREETZ_LIB_librt                       if !FREETZ_PACKAGE_MEDIATOMB_STATIC && FREETZ_TARGET_UCLIBC_HAS_multiple_libs
	select FREETZ_LIB_libsqlite3                  if !FREETZ_PACKAGE_MEDIATOMB_STATIC
	select FREETZ_LIB_libtag                      if !FREETZ_PACKAGE_MEDIATOMB_STATIC
	select FREETZ_LIB_STDCXXLIB                   if !FREETZ_PACKAGE_MEDIATOMB_STATIC
	select FREETZ_LIB_STDCXXLIB_WITH_WCHAR
	select FREETZ_LIB_libz                        if !FREETZ_PACKAGE_MEDIATOMB_STATIC
	select FREETZ_LIB_libiconv                    if !FREETZ_PACKAGE_MEDIATOMB_STATIC && FREETZ_TARGET_UCLIBC_0_9_28
	default n
	help
		MediaTomb is an open source (GPL) UPnP MediaServer with a nice
		web user interface, it allows you to stream your digital media
		through your home network and listen to/watch it on a variety
		of UPnP compatible devices.

config FREETZ_PACKAGE_MEDIATOMB_WITH_PLAYLIST_SUPPORT
	bool "build with playlist support"
	depends on FREETZ_PACKAGE_MEDIATOMB
	select FREETZ_LIB_libjs if ! FREETZ_PACKAGE_MEDIATOMB_STATIC
	default n
	help
		Build MediaTomb with playlist support. This requires
		Mozilla JavaScript engine and increases image by about 700KB.

config FREETZ_PACKAGE_MEDIATOMB_STATIC
	bool "Link statically"
	depends on FREETZ_PACKAGE_MEDIATOMB
	default n
	help
		Activating this switch causes all libraries
		mediatomb depends on to be linked in statically.
```

## make/microperl/Config.in
```kconfig
config FREETZ_PACKAGE_MICROPERL
	bool "microperl 5.10.1 (binary only)"
	default n
	help
		Perl without operating-specific functions such as readdir.

config FREETZ_PACKAGE_MICROPERL_MODULES
	string "microperl modules"
	default ""
	depends on FREETZ_PACKAGE_MICROPERL
	help
		List of microperl modules to copy to the rootfs.
		E.g.
		warnings.pm warnings/register.pm strict.pm constant.pm vars.pm
		Exporter.pm Exporter/Heavy.pm Carp.pm Getopt/Long.pm
```

## make/mini-snmpd/Config.in
```kconfig
config FREETZ_PACKAGE_MINI_SNMPD
	bool "mini-snmpd 1.6 (binary only)"
	default n
	help
		This program is an SNMP server for "embedded systems".
		The advantage in comparison to other products is the
		low usage of system resources.
```

## make/mini_fo/Config.in
```kconfig
config FREETZ_PACKAGE_MINI_FO
	bool "mini_fo 0.3"
	select FREETZ_MODULE_mini_fo
	default n
	help
		Makes the filesystem writeable. Changes are not reboot-persistent,
		unless stored on a hard disk or on flash storage media. The way mini_fo
		is configured here creates the overlay filesystem in the router's RAM
		disk, so they definitely are *not* reboot-persistent. Nonetheless,
		mini_fo is tremendously helpful, eliminating the need for tricks like
		'mount -o bind' etc.

		Note: The mini_fo root filesystem will not be used if an NFS-root was
		mounted first (see NFS-root package). Still, both packages can be
		installed at the same time, because mini_fo is still useful if NFS-root
		is decativated.

config FREETZ_PACKAGE_MINI_FO_JFFS2
	bool "Use jffs2 for data storage (persistent) "
	depends on FREETZ_REPLACE_KERNEL
	depends on FREETZ_PACKAGE_MINI_FO
	select FREETZ_MODULE_jffs2
	default n
	help
		Enables possibility to store filesystem changes persisten to jffs2.
		When a new image is flashed the data will be lost!
```

## make/minicom/Config.in
```kconfig
config FREETZ_PACKAGE_MINICOM
	bool "minicom 2.8 (binary only)"
	select FREETZ_LIB_libncurses
	select FREETZ_LIB_libiconv if FREETZ_TARGET_UCLIBC_0_9_28
	default n
	help
		Minicom is a menu driven communications program. It emulates ANSI and
		VT102 terminals. It has a dialing directory and auto zmodem download.

		NOTE:
		Minicom will expect its configurations in "/var/tmp/flash/minicom/"
		which has to be created before the first run of the binary by
		"mkdir -p  /var/tmp/flash/minicom/".

		To save this and after any change of minicom's configurations you will
		have to write it to flash with "modsave".


if FREETZ_PACKAGE_MINICOM

	choice
		prompt "Default port"
		default FREETZ_PACKAGE_MINICOM_PORT_S0

		config FREETZ_PACKAGE_MINICOM_PORT_S0
			bool "/dev/ttyS0"
			help
				Use internal serial port /dev/ttyS0 as default port

		config FREETZ_PACKAGE_MINICOM_PORT_S1
			bool "/dev/ttyS1"
			help
				Use internal serial port /dev/ttyS0 as default port

		config FREETZ_PACKAGE_MINICOM_PORT_USB0
			bool "/dev/ttyUSB0"
			help
				Use 1st USB serial port /dev/ttyUSB0 as default port

		config FREETZ_PACKAGE_MINICOM_PORT_USB1
			bool "/dev/ttyUSB1"
			help
				Use 2nd USB serial port /dev/ttyUSB1 as default port

		config FREETZ_PACKAGE_MINICOM_PORT_USB2
			bool "/dev/ttyUSB2"
			help
				Use 3rd USB serial port /dev/ttyUSB2 as default port

	endchoice


	choice
		prompt "Default baud"
		default FREETZ_PACKAGE_MINICOM_BAUD_115200

		config FREETZ_PACKAGE_MINICOM_BAUD_300
			bool "300"

		config FREETZ_PACKAGE_MINICOM_BAUD_1200
			bool "1200"

		config FREETZ_PACKAGE_MINICOM_BAUD_2400
			bool "2400"

		config FREETZ_PACKAGE_MINICOM_BAUD_4800
			bool "4800"

		config FREETZ_PACKAGE_MINICOM_BAUD_9600
			bool "9600"

		config FREETZ_PACKAGE_MINICOM_BAUD_19200
			bool "19200"

		config FREETZ_PACKAGE_MINICOM_BAUD_38400
			bool "38400"

		config FREETZ_PACKAGE_MINICOM_BAUD_57600
			bool "57600"

		config FREETZ_PACKAGE_MINICOM_BAUD_115200
			bool "115200"

		config FREETZ_PACKAGE_MINICOM_BAUD_230400
			bool "230400"

	endchoice


	config FREETZ_PACKAGE_MINICOM_BAUD
		int
		default 300	if FREETZ_PACKAGE_MINICOM_BAUD_300
		default 1200	if FREETZ_PACKAGE_MINICOM_BAUD_1200
		default 2400	if FREETZ_PACKAGE_MINICOM_BAUD_2400
		default 4800	if FREETZ_PACKAGE_MINICOM_BAUD_4800
		default 9600	if FREETZ_PACKAGE_MINICOM_BAUD_9600
		default 19200	if FREETZ_PACKAGE_MINICOM_BAUD_19200
		default 38400	if FREETZ_PACKAGE_MINICOM_BAUD_38400
		default 57600	if FREETZ_PACKAGE_MINICOM_BAUD_57600
		default 115200	if FREETZ_PACKAGE_MINICOM_BAUD_115200
		default 230400	if FREETZ_PACKAGE_MINICOM_BAUD_230400

	config FREETZ_PACKAGE_MINICOM_PORT
		string
		default "/dev/ttyS0"	if FREETZ_PACKAGE_MINICOM_PORT_S0
		default "/dev/ttyS1"	if FREETZ_PACKAGE_MINICOM_PORT_S1
		default "/dev/ttyUSB0"	if FREETZ_PACKAGE_MINICOM_PORT_USB0
		default "/dev/ttyUSB1"	if FREETZ_PACKAGE_MINICOM_PORT_USB1
		default "/dev/ttyUSB2"	if FREETZ_PACKAGE_MINICOM_PORT_USB2

endif # FREETZ_PACKAGE_MINICOM
```

## make/minidlna/Config.in
```kconfig
config FREETZ_PACKAGE_MINIDLNA
	bool "minidlna 1.3.0"
	select FREETZ_LIB_libpthread  if !FREETZ_PACKAGE_MINIDLNA_STATIC && FREETZ_TARGET_UCLIBC_HAS_multiple_libs
	select FREETZ_LIB_libavcodec  if !FREETZ_PACKAGE_MINIDLNA_STATIC
	select FREETZ_LIB_libavformat if !FREETZ_PACKAGE_MINIDLNA_STATIC
	select FREETZ_LIB_libavutil   if !FREETZ_PACKAGE_MINIDLNA_STATIC
	select FREETZ_PACKAGE_FFMPEG
	select FREETZ_PACKAGE_FFMPEG_PATENTED
	select FREETZ_PACKAGE_FFMPEG_LIBDLNA_SUPPORT
	select FREETZ_LIB_libexif     if !FREETZ_PACKAGE_MINIDLNA_STATIC
	select FREETZ_LIB_libFLAC     if !FREETZ_PACKAGE_MINIDLNA_STATIC
	select FREETZ_LIB_libid3tag   if !FREETZ_PACKAGE_MINIDLNA_STATIC
	select FREETZ_LIB_libjpeg     if !FREETZ_PACKAGE_MINIDLNA_STATIC
	select FREETZ_LIB_libogg      if !FREETZ_PACKAGE_MINIDLNA_STATIC
	select FREETZ_LIB_libsqlite3  if !FREETZ_PACKAGE_MINIDLNA_STATIC
	select FREETZ_LIB_libvorbis   if !FREETZ_PACKAGE_MINIDLNA_STATIC
	select FREETZ_LIB_libiconv    if !FREETZ_PACKAGE_MINIDLNA_STATIC && FREETZ_TARGET_UCLIBC_0_9_28
	default n
	help
		The MiniDLNA daemon is an UPnP-A/V and DLNA service which
		serves multimedia content to compatible clients on the network.

choice
	depends on FREETZ_PACKAGE_MINIDLNA
	prompt "language"
	default FREETZ_PACKAGE_MINIDLNA_LANG_DE if FREETZ_LANG_DE
	default FREETZ_PACKAGE_MINIDLNA_LANG_EN

	config FREETZ_PACKAGE_MINIDLNA_LANG_EN
		bool "English"

	config FREETZ_PACKAGE_MINIDLNA_LANG_DE
		bool "German"
endchoice

config FREETZ_PACKAGE_MINIDLNA_STATIC
	bool "Link statically"
	depends on FREETZ_PACKAGE_MINIDLNA
	default n
	help
		Activating this switch causes all libraries
		minidlna depends on to be linked in statically.
```
