## make/callmonitor/Config.in
```kconfig
config FREETZ_PACKAGE_CALLMONITOR
	bool "Callmonitor 1.20.9-git"
	select FREETZ_BUSYBOX_BASE64
	select FREETZ_BUSYBOX_HEXDUMP
	select FREETZ_BUSYBOX_MD5SUM
	select FREETZ_BUSYBOX_NC
	select FREETZ_BUSYBOX_NC_SERVER
	select FREETZ_BUSYBOX_NC_110_COMPAT
	select FREETZ_BUSYBOX_USLEEP
	select FREETZ_BUSYBOX_UUENCODE
	default n
	help
		Callmonitor enables you to perform arbitrary actions upon incoming
		calls on your AVM Fritz!Box (e.g., to send notifications to your
		favorite set-top box, to wake up your PC, or to send you a mail when
		you have missed a call).

if FREETZ_PACKAGE_CALLMONITOR && !FREETZ_AVM_HAS_ALLCFGCONV_WITH_DECRYPTION_SUPPORT && !FREETZ_PACKAGE_DECRYPT_FRITZOS_CFG
comment "Warning: Firmware with no password decryption capability from AVM detected."
comment "Warning: Please select 'decrypt FRITZ!OS configs' package manually."
comment "          Don't forget to read its NO RESPONSIBILITY DISCLAIMER."
endif

config FREETZ_PACKAGE_CALLMONITOR_webif
	bool "Web interface"
	default y
	depends on FREETZ_PACKAGE_CALLMONITOR && (FREETZ_PACKAGE_CALLMONITOR_monitor || FREETZ_PACKAGE_CALLMONITOR_phonebook)
	help
		This options installs a number of configuration pages in Freetz's Web
		interface.

		Say YES here unless you feel comfortable configuring Callmonitor via
		text files. Which parts of the configuration pages are actually
		displayed may depend on the installed features.

comment "Web interface [disabled]"
	depends on FREETZ_PACKAGE_CALLMONITOR && ! (FREETZ_PACKAGE_CALLMONITOR_monitor || FREETZ_PACKAGE_CALLMONITOR_phonebook)

config FREETZ_PACKAGE_CALLMONITOR_actions
	bool "Actions"
	default y
	depends on FREETZ_PACKAGE_CALLMONITOR
	help
		This options installs all the actions to be used in the 'Listeners'
		rules, such as 'dboxmessage', 'mailmessage', 'config', and many more.
		These actions may be used independently of the Callmonitor daemon by
		calling them via the 'callaction' command.

		You probably want to say YES here.

config FREETZ_PACKAGE_CALLMONITOR_monitor
	bool "Monitoring daemon"
	default y
	depends on FREETZ_PACKAGE_CALLMONITOR
	help
		This options installs the heart of Callmonitor, a daemon that monitors
		incoming and outgoing call events and performs actions according to a
		set of rules. Actions range from ready-to-use notifications to
		arbitrary shell code.

		You want to say YES here if you are new to Callmonitor.

config FREETZ_PACKAGE_CALLMONITOR_phonebook
	bool "Phonebook support"
	default y
	depends on FREETZ_PACKAGE_CALLMONITOR
	select FREETZ_PACKAGE_PHONEBOOK_TOOLS
	select FREETZ_WGET
	help
		This option makes Callmonitor map phone numbers to names using several
		sources of information: reverse-lookup Web services, AVM's built-in
		phonebook and an additional text file named 'Callers'.

		Only say NO here if you are not interested in who is calling you.
```

## make/checkmaild/Config.in
```kconfig
config FREETZ_PACKAGE_CHECKMAILD
	bool "Checkmaild 0.4.7"
	default n
	help
		Checkmaild checks pop3/smtp mail accounts for new mails on a given interval.
		A configurable shell script starts the desired actions when new mails arrive.
```

## make/cifs-support/Config.in
```kconfig
config FREETZ_CIFS_SUPPORT_NEEDS_REPLACE_KERNEL
	bool
	default y if FREETZ_KERNEL_VERSION_2_6_32_60
	default n

config FREETZ_CIFS_SUPPORT_AVAILABLE
	bool
	default y if !FREETZ_CIFS_SUPPORT_NEEDS_REPLACE_KERNEL || FREETZ_REPLACE_KERNEL
	default n
```

## make/cifsmount/Config.in
```kconfig
comment "Cifsmount (not available, needs replace kernel)"
	depends on !FREETZ_CIFS_SUPPORT_AVAILABLE

config FREETZ_PACKAGE_CIFSMOUNT
	bool "Cifsmount 6.6"
	depends on FREETZ_CIFS_SUPPORT_AVAILABLE
	select FREETZ_MODULE_cifs
	default n
	help
		User space helper for mounting remote CIFS shares + CGI web interface
		for easy configuration of up to three mounts incl. (auto-) start/stop.

		CIFS is an extended version of SMB, the well-known protocol used by
		MS Windows and Samba for sharing folders, files and printers.
		Thus, cifsmount is a replacement for smbmount, having the advantage
		of being significantly smaller than smbmount. So if you want to mount
		Windows or Samba shares from your router box, this package is for you.

config FREETZ_PACKAGE_CIFSMOUNT_REMOVE_WEBIF
	bool "remove webinterface"
	depends on FREETZ_PACKAGE_CIFSMOUNT
	default n
	help
		This option removes the webinterface
```

## make/classpath/Config.in
```kconfig
config FREETZ_PACKAGE_CLASSPATH
	bool "GNU classpath 0.98 (binary only)"
	default n
	select FREETZ_LIB_libiconv if FREETZ_TARGET_UCLIBC_VERSION_0_9_28
	help
		GNU Classpath, Essential Libraries for Java, is a GNU project to create
		free core class libraries for use with virtual machines and compilers
		for the java programming language.
```
