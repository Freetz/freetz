## make/autofs/Config.in
```kconfig
comment "autofs (not available, needs replace kernel)"
	depends on FREETZ_KERNEL_VERSION_2_6_28_MAX && !FREETZ_REPLACE_KERNEL

comment "autofs (not available, no kernel sources from AVM)"
	depends on FREETZ_KERNEL_VERSION_2_6_32_MIN && !FREETZ_REPLACE_MODULE_AVAILABLE

config FREETZ_PACKAGE_AUTOFS
	bool "autofs 5.0.5"
	depends on (FREETZ_KERNEL_VERSION_2_6_28_MAX && FREETZ_REPLACE_KERNEL) \
		|| (FREETZ_KERNEL_VERSION_2_6_32_MIN && FREETZ_REPLACE_MODULE_AVAILABLE)
	select FREETZ_LIB_libdl
	select FREETZ_LIB_libpthread
	select FREETZ_MODULE_autofs4
	select FREETZ_BUSYBOX_FEATURE_MOUNT_HELPERS
	select FREETZ_BUSYBOX_FEATURE_MOUNT_LABEL
	default n
	help
		autofs is a kernel-based automounter for Linux.  It performs a job
		similar to amd(8) but relies on a small stub of kernel code instead of
		pretending to be an NFS server.  The result is simpler code, better
		reliability, and much faster operation in the common case (everything
		already mounted.)

config FREETZ_PACKAGE_AUTOFS_NFS
	bool "select nfs module"
	depends on FREETZ_PACKAGE_AUTOFS
	select FREETZ_MODULE_nfs if FREETZ_NFS_SUPPORT_AVAILABLE_AS_MODULE
	default n
	help
		select this if you want to mount NFS-shares

comment "select cifs package (not available, needs replace kernel)"
	depends on FREETZ_PACKAGE_AUTOFS && \
		!FREETZ_REPLACE_KERNEL && FREETZ_KERNEL_VERSION_2_6_28_MIN

config FREETZ_PACKAGE_AUTOFS_CIFS
	bool "select cifs package"
	depends on FREETZ_PACKAGE_AUTOFS && \
		(FREETZ_REPLACE_KERNEL || FREETZ_KERNEL_VERSION_2_6_19_MAX)
	select FREETZ_PACKAGE_CIFSMOUNT
	default n
	help
		select this if you want to mount Samba-shares

config FREETZ_PACKAGE_AUTOFS_DAVFS2
	bool "select davfs2 package"
	depends on FREETZ_PACKAGE_AUTOFS
	select FREETZ_PACKAGE_DAVFS2
	default n
	help
		select this if you want to mount WebDAV-shares

config FREETZ_PACKAGE_AUTOFS_SSHFS
	bool "select sshfs package"
	depends on FREETZ_PACKAGE_AUTOFS
	select FREETZ_PACKAGE_SSHFS_FUSE
	default n
	help
		select this if you want to mount SSHfs-shares
```

## make/avahi/Config.in
```kconfig
config FREETZ_PACKAGE_AVAHI
	bool "Avahi 0.6.31"
	select FREETZ_LIB_libdl       if FREETZ_TARGET_UCLIBC_HAS_multiple_libs
	select FREETZ_LIB_libpthread  if FREETZ_TARGET_UCLIBC_HAS_multiple_libs
	select FREETZ_LIB_libexpat
	select FREETZ_LIB_libdaemon
	select FREETZ_PACKAGE_DBUS
	select FREETZ_LIB_libdbus
	select FREETZ_LIB_libavahi_common
	select FREETZ_LIB_libavahi_core
	default n
	help
		An mDNS/DNS-SD (aka RendezVous/Bonjour/ZeroConf) implementation
		(library).  Avahi is a system which facilitates service
		discovery on a local network -- this means that you can plug
		your laptop or computer into a network and instantly be able
		to view other people who you can chat with, find printers to
		print to or find files being shared. This kind of technology
		is already found in MacOS X (branded 'Rendezvous', 'Bonjour'
		and sometimes 'ZeroConf') and is very convenient.

config FREETZ_PACKAGE_AVAHI_WITH_DNSCONFD
	bool "with Avahi Dnsconfd"
	depends on FREETZ_PACKAGE_AVAHI
	default n
	select FREETZ_LIB_libpthread  if FREETZ_TARGET_UCLIBC_HAS_multiple_libs
	select FREETZ_LIB_libdaemon
	select FREETZ_LIB_libavahi_common
	help
		This tool listens on the network for announced DNS servers
		and passes them to resolvconf so it can use them. This is
		very useful on autoconfigured IPv6 networks. Adds 4KB of
		compressed squashfs.
```

## make/avm-firewall/Config.in
```kconfig
config DS_PACKAGE_AVM_FIREWALL
	bool "AVM-firewall 2.0.3c"
	default n

	help
		Configuration front-end to AVM-firewall.
		
		This front-end is used for managing firewall rules for the AVM standard firewall.
		You can also modify the ar7.cfg file manual. But a better way is to use this GUI.
```

## make/avm-forwarding/Config.in
```kconfig
config FREETZ_PACKAGE_AVM_FORWARDING
	bool "AVM-forwarding"
	depends on FREETZ_AVM_HAS_DSLD
	depends on !FREETZ_REMOVE_DSLD
	depends on FREETZ_AVM_VERSION_06_0X_MIN && FREETZ_AVM_VERSION_06_5X_MAX
	default n
	help
		Configuration of forwardings to FB itself (open ports).
		Requires an existing forwarding in the configuration,
		e.g. HTTPS to box is allowed in the regular AVM GUI.
```

## make/avm-rules/Config.in
```kconfig
config FREETZ_PACKAGE_AVM_RULES
	bool "AVM-rules (deprecated)"
	depends on FREETZ_REAL_DEVELOPER_ONLY
	depends on FREETZ_AVM_HAS_DSLD
	depends on !FREETZ_REMOVE_DSLD
	depends on FREETZ_AVM_VERSION_06_8X_MIN
	select FREETZ_PACKAGE_AVM_PORTFW
	default n
	help
		Configuration of port forwardings to the FritzBox itself
		by using voip_forwardrules.
		Please don't use this package, but AVM-portfw!
		Warning:
		This package changes the ar7.cfg. On syntax errors AVM
		will reset the whole file to default, including default
		password and default ip. Backup you config before!
```

## make/axtlswrap/Config.in
```kconfig
config FREETZ_PACKAGE_AXTLSWRAP
	depends on FREETZ_REAL_DEVELOPER_ONLY
	bool "axTLS wrapper 2.1.3 (binary only)"
	default n
```

## make/bash/Config.in
```kconfig
config FREETZ_PACKAGE_BASH
	bool "bash 3.2.57 (binary only)"
	default n
	help
		Bash is an sh-compatible command language interpreter that
		executes commands read from the standard input or from a file.
		Bash also incorporates useful features from the Korn and C
		shells (ksh and csh).(roundabout 540K minimal and 840K full featured)

config FREETZ_PACKAGE_BASH_MINIMAL
	bool "minimal config"
	depends on FREETZ_PACKAGE_BASH
	default n
	help
		This produces a shell with minimal features, close to the
		historical Bourne shell (saves ~300KB).

config FREETZ_PACKAGE_BASH_READLINE
	bool "enable command line editing and history"
	depends on FREETZ_PACKAGE_BASH
	select FREETZ_LIB_libncurses
	select FREETZ_LIB_libreadline
	select FREETZ_LIB_libhistory
	default n
	help
		Enable command line editing and history. This feature needs ncurses and readline.

config FREETZ_PACKAGE_BASH_STATIC
	bool "Link statically"
	depends on FREETZ_PACKAGE_BASH
	default n
	help
		Causes all libraries bash depends on to be linked in statically.

config FREETZ_PATCH_BASH_LOGIN_SHELL
	bool "add bash to the list of login shells"
	depends on FREETZ_PACKAGE_BASH
	default n
	help
		Add bash to /etc/shells. This allows bash to be used as a login shell.
```

## make/bftpd/Config.in
```kconfig
config FREETZ_PACKAGE_BFTPD
	bool "Bftpd 3.3"
	default n
	help
		Small FTP Server

config FREETZ_PACKAGE_BFTPD_WITH_ZLIB
	bool "With on-the-fly compression"
	depends on FREETZ_PACKAGE_BFTPD
	select FREETZ_LIB_libz
	default n
```

## make/bfusb/Config.in
```kconfig
config FREETZ_PACKAGE_BFUSB
	bool "bfusb: AVM BlueFRITZ! USB stick support (binary only)"
	depends on FREETZ_REPLACE_MODULE_AVAILABLE
	select FREETZ_MODULE_bfusb if !FREETZ_AVM_HAS_BT_HCIBFUSB_BUILTIN
	default n
	help
		This package adds support for the
		AVM BlueFRITZ! USB stick.
```

## make/bind/Config.in
```kconfig
config FREETZ_PACKAGE_BIND
	bool "BIND 9.8.0-P4"
	default n
	help
		BIND is an implementation of the Domain Name System (DNS) protocols.
		The name BIND stands for "Berkeley Internet Name Daemon".
		You have to provide the config and needed zone files yourself.

config FREETZ_PACKAGE_BIND_NAMED
	bool "named"
	depends on FREETZ_PACKAGE_BIND
	default y
	help
		Adds named, a internet domain name server.

config FREETZ_PACKAGE_BIND_RNDC
	bool "rndc (binary only)"
	depends on FREETZ_PACKAGE_BIND
	default n
	help
		Adds the rndc name server control utility binary.

config FREETZ_PACKAGE_BIND_NSUPDATE
	bool "nsupdate (binary only)"
	depends on FREETZ_PACKAGE_BIND
	default n
	help
		Adds the nsupdate binary for manipulation dynamic Zones.

config FREETZ_PACKAGE_BIND_DIG
	bool "dig (binary only)"
	depends on FREETZ_PACKAGE_BIND
	default n
	help
		Adds the dig DNS lookup utility.
```

## make/bip/Config.in
```kconfig
config FREETZ_PACKAGE_BIP
	bool "Bip 0.8.9/0.9.0-rc4"
	default n
	help
		Bip is an IRC proxy, which means it keeps connected to your
		preferred IRC servers, can store the logs for you, and even send
		them back to your IRC client(s) upon connection. You may want to
		use bip to keep your logfiles (in a unique format and on a unique
		computer) whatever your client is, when you connect from multiple
		workstations, or when you simply want to have a playback of what
		was said while you were away.

choice
	depends on FREETZ_PACKAGE_BIP
	prompt "version"
	default FREETZ_PACKAGE_BIP_VERSION_089

	config FREETZ_PACKAGE_BIP_VERSION_089
		bool "0.8.9 - 2013"

	config FREETZ_PACKAGE_BIP_VERSION_090
		bool "0.9.0-rc4 - 2020"

endchoice

config FREETZ_PACKAGE_BIP_BIPMKPW
	bool "build password hasher for Bip"
	depends on FREETZ_PACKAGE_BIP
	default n
	help
		bipmkpw converts a password into the double-hash used by bip.
		Copy the generated output from bipmkpw into bip config file.

config FREETZ_PACKAGE_BIP_WITH_SSL
	bool "build with SSL support"
	depends on FREETZ_PACKAGE_BIP
	select FREETZ_LIB_libcrypto if !FREETZ_PACKAGE_BIP_STATIC
	select FREETZ_LIB_libssl    if !FREETZ_PACKAGE_BIP_STATIC
	default n
	help
		This option enables SSL support for bip.

config FREETZ_PACKAGE_BIP_STATIC
	bool "Link statically"
	depends on FREETZ_PACKAGE_BIP_WITH_SSL
	default n
	help
		Build bip binary with statically linked libraries.

config FREETZ_PACKAGE_BIP_WITH_OIDENTD
	bool "build with oidentd support"
	depends on FREETZ_PACKAGE_BIP
	default n
	help
		This option enables oidentd spoofing support for bip.

config FREETZ_PACKAGE_BIP_OIDENTD
	bool "select oidentd package"
	depends on FREETZ_PACKAGE_BIP_WITH_OIDENTD
	select FREETZ_PACKAGE_OIDENTD
	default n
```

## make/bird/Config.in
```kconfig
config FREETZ_PACKAGE_BIRD
	bool "Bird 1.6.4"
	default n
	help
		The BIRD Internet Routing Daemon

config FREETZ_PACKAGE_BIRD_DEBUG
	bool "Debugging code (recommended)"
	depends on FREETZ_PACKAGE_BIRD
	default y
	help
		Enables additional debugging code. This is highly recommended.
		Increases binary size by around 3 KB.

config FREETZ_PACKAGE_BIRDC
	bool "birdc"
	depends on FREETZ_PACKAGE_BIRD
	select FREETZ_LIB_libncurses
	select FREETZ_LIB_libreadline
	select FREETZ_LIB_libhistory
	default n
	help
		birdc (command-line interface for bird)
```

## make/bluez-utils/Config.in
```kconfig
config FREETZ_PACKAGE_BLUEZ_UTILS
	bool "bluez-utils 2.25 (binary only (incl. Pin-Change and NAP)"
	select FREETZ_LIB_libbluetooth
	select FREETZ_MODULE_btusb if FREETZ_KERNEL_VERSION_2_6_28_MIN
	select FREETZ_MODULE_hci_usb if FREETZ_KERNEL_VERSION_2_6_19_MAX
	select FREETZ_MODULE_bnep
	select FREETZ_MODULE_rfcomm
	#select FREETZ_PACKAGE_PPPD
	select FREETZ_BUSYBOX_BRCTL if ! FREETZ_PACKAGE_BRIDGE_UTILS
	default n
	help
		This package contains utilities for configuring bluetooth
		connections.
```

## make/box_key_password_ftpd_proxy/Config.in
```kconfig
config FREETZ_PACKAGE_BOX_KEY_PASSWORD_FTPD_PROXY
	bool "box_key_password_ftpd_proxy 0.1 (binary only)"
	depends on FREETZ_AVM_VERSION_06_2X_MIN
	default n
	help
		reveal the password for the private key file
		(/var/flash/websrv_ssl_key.pem) to be able to
		reuse it for other packages
```

## make/br2684ctl/Config.in
```kconfig
config FREETZ_PACKAGE_BR2684CTL
	bool "br2684ctl (binary only)"
	select FREETZ_LIB_libatm
	depends on FREETZ_AVM_VERSION_04_XX_MAX
	default n
	help
		ATM Ethernet bridging configuration utility
```
