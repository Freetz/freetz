## config/.gen/Config.in
```kconfig
source "config/.gen/0300--DE.in"
source "config/.gen/0300--EN.in"
source "config/.gen/0300.in"
source "config/.gen/0450--06_5X.in"
source "config/.gen/0450--06_9X.in"
source "config/.gen/0450--07_0X.in"
source "config/.gen/0450--07_1X.in"
source "config/.gen/0450.in"
source "config/.gen/0540--06_2X.in"
source "config/.gen/0540--06_5X.in"
source "config/.gen/0540--06_9X.in"
source "config/.gen/0540--07_0X.in"
source "config/.gen/0540--07_1X.in"
source "config/.gen/0540.in"
source "config/.gen/0546--06_2X.in"
source "config/.gen/0546--06_5X.in"
source "config/.gen/0546--06_9X.in"
source "config/.gen/0546--07_0X.in"
source "config/.gen/0546--07_1X.in"
source "config/.gen/0546.in"
source "config/.gen/1200.in"
source "config/.gen/1240--06_9X.in"
source "config/.gen/1240--07_0X.in"
source "config/.gen/1240--07_1X.in"
source "config/.gen/1240.in"
source "config/.gen/1260--07_0X.in"
source "config/.gen/1260--07_1X.in"
source "config/.gen/1260.in"
source "config/.gen/1750--06_2X.in"
source "config/.gen/1750--06_5X.in"
source "config/.gen/1750--07_0X.in"
source "config/.gen/1750--07_1X.in"
source "config/.gen/1750.in"
source "config/.gen/1759--06_2X.in"
source "config/.gen/1759--06_5X.in"
source "config/.gen/1759--07_0X.in"
source "config/.gen/1759--07_1X.in"
source "config/.gen/1759.in"
source "config/.gen/2170.in"
source "config/.gen/2400.in"
source "config/.gen/3000--07_0X.in"
source "config/.gen/3000--07_1X.in"
source "config/.gen/3000.in"
source "config/.gen/3020.in"
source "config/.gen/3030.in"
source "config/.gen/3130.in"
source "config/.gen/3131.in"
source "config/.gen/3170.in"
source "config/.gen/3270_V2.in"
source "config/.gen/3270_V3--DE--05_5X.in"
source "config/.gen/3270_V3--EN--05_5X.in"
source "config/.gen/3270_V3.in"
source "config/.gen/3270_V3--IT--05_5X.in"
source "config/.gen/3272--DE--06_2X.in"
source "config/.gen/3272--DE--06_5X.in"
source "config/.gen/3272--DE--06_8X.in"
source "config/.gen/3272--EN--06_2X.in"
source "config/.gen/3272--EN--06_5X.in"
source "config/.gen/3272--EN--06_8X.in"
source "config/.gen/3272.in"
source "config/.gen/3370--DE--06_2X.in"
source "config/.gen/3370--DE--06_5X.in"
source "config/.gen/3370--EN--06_2X.in"
source "config/.gen/3370--EN--06_5X.in"
source "config/.gen/3370.in"
source "config/.gen/3390--DE--06_2X.in"
source "config/.gen/3390--DE--06_5X.in"
source "config/.gen/3390--EN--06_2X.in"
source "config/.gen/3390--EN--06_5X.in"
source "config/.gen/3390.in"
source "config/.gen/3490--DE--06_2X.in"
source "config/.gen/3490--DE--06_5X.in"
source "config/.gen/3490--DE--06_8X.in"
source "config/.gen/3490--DE--07_0X.in"
source "config/.gen/3490--DE--07_1X.in"
source "config/.gen/3490--EN--06_2X.in"
source "config/.gen/3490--EN--06_5X.in"
source "config/.gen/3490--EN--06_8X.in"
source "config/.gen/3490--EN--07_0X.in"
source "config/.gen/3490--EN--07_1X.in"
source "config/.gen/3490.in"
source "config/.gen/4020--06_8X.in"
source "config/.gen/4020--07_0X.in"
source "config/.gen/4020.in"
source "config/.gen/4040--07_0X.in"
source "config/.gen/4040--07_1X.in"
source "config/.gen/4040.in"
source "config/.gen/5010.in"
source "config/.gen/5050.in"
source "config/.gen/5124--EN--XA.in"
source "config/.gen/5124--EN--XB.in"
source "config/.gen/5124.in"
source "config/.gen/5140.in"
source "config/.gen/5490.in"
source "config/.gen/5491.in"
source "config/.gen/6430.in"
source "config/.gen/6490--06_8X.in"
source "config/.gen/6490--07_0X.in"
source "config/.gen/6490--07_1X.in"
source "config/.gen/6490.in"
source "config/.gen/6590--06_8X.in"
source "config/.gen/6590--07_0X.in"
source "config/.gen/6590--07_1X.in"
source "config/.gen/6590.in"
source "config/.gen/6810--DE--06_2X.in"
source "config/.gen/6810--EN--06_2X.in"
source "config/.gen/6810.in"
source "config/.gen/6820--06_8X.in"
source "config/.gen/6820--07_0X--DE.in"
source "config/.gen/6820--07_0X--EN.in"
source "config/.gen/6820.in"
source "config/.gen/6840--DE--06_2X.in"
source "config/.gen/6840--DE--06_5X.in"
source "config/.gen/6840--DE--06_8X.in"
source "config/.gen/6840--EN--06_2X.in"
source "config/.gen/6840--EN--06_5X.in"
source "config/.gen/6840--EN--06_8X.in"
source "config/.gen/6840.in"
source "config/.gen/6842.in"
source "config/.gen/6890--06_8X.in"
source "config/.gen/6890--07_0X.in"
source "config/.gen/6890.in"
source "config/.gen/7050.in"
source "config/.gen/7112.in"
source "config/.gen/7113--DE.in"
source "config/.gen/7113--EN.in"
source "config/.gen/7113.in"
source "config/.gen/7140--A_CH.in"
source "config/.gen/7140--DE.in"
source "config/.gen/7140--EN--XA.in"
source "config/.gen/7140--EN--XB.in"
source "config/.gen/7140.in"
source "config/.gen/7141.in"
source "config/.gen/7150.in"
source "config/.gen/7170--A_CH.in"
source "config/.gen/7170--DE.in"
source "config/.gen/7170--EN--XA.in"
source "config/.gen/7170--EN--XB.in"
source "config/.gen/7170.in"
source "config/.gen/7240--05_5X.in"
source "config/.gen/7240--06_0X.in"
source "config/.gen/7240.in"
source "config/.gen/7270_V1.in"
source "config/.gen/7270_V2--DE--05_2X.in"
source "config/.gen/7270_V2--DE--05_5X.in"
source "config/.gen/7270_V2--DE--06_0X.in"
source "config/.gen/7270_V2--EN--05_2X.in"
source "config/.gen/7270_V2--EN--05_5X.in"
source "config/.gen/7270_V2.in"
source "config/.gen/7270_V3--DE--05_2X.in"
source "config/.gen/7270_V3--DE--05_5X.in"
source "config/.gen/7270_V3--DE--06_0X.in"
source "config/.gen/7270_V3--EN--05_2X.in"
source "config/.gen/7270_V3--EN--05_5X.in"
source "config/.gen/7270_V3.in"
source "config/.gen/7272--DE--06_2X.in"
source "config/.gen/7272--DE--06_5X.in"
source "config/.gen/7272--DE--06_8X.in"
source "config/.gen/7272--EN--06_2X.in"
source "config/.gen/7272--EN--06_5X.in"
source "config/.gen/7272--EN--06_8X.in"
source "config/.gen/7272.in"
source "config/.gen/7312--06_2X.in"
source "config/.gen/7312--06_5X.in"
source "config/.gen/7312.in"
source "config/.gen/7320.in"
source "config/.gen/7330_SL--06_2X.in"
source "config/.gen/7330_SL--06_5X.in"
source "config/.gen/7330_SL.in"
source "config/.gen/7330_XL--DE--06_2X.in"
source "config/.gen/7330_XL--DE--06_5X.in"
source "config/.gen/7330_XL--EN--06_2X.in"
source "config/.gen/7330_XL.in"
source "config/.gen/7340--05_2X.in"
source "config/.gen/7340--06_0X.in"
source "config/.gen/7340.in"
source "config/.gen/7360_SL--DE--06_2X.in"
source "config/.gen/7360_SL--EN--06_2X.in"
source "config/.gen/7360_SL.in"
source "config/.gen/7360_V1--DE--06_2X.in"
source "config/.gen/7360_V1--EN--06_2X.in"
source "config/.gen/7360_V1.in"
source "config/.gen/7360_V2--DE--06_2X.in"
source "config/.gen/7360_V2--DE--06_5X.in"
source "config/.gen/7360_V2--DE--06_8X.in"
source "config/.gen/7360_V2--EN--06_2X.in"
source "config/.gen/7360_V2--EN--06_5X.in"
source "config/.gen/7360_V2--EN--06_8X.in"
source "config/.gen/7360_V2.in"
source "config/.gen/7362--06_2X.in"
source "config/.gen/7362--06_5X.in"
source "config/.gen/7362--06_8X.in"
source "config/.gen/7362--07_0X.in"
source "config/.gen/7362--07_1X.in"
source "config/.gen/7362.in"
source "config/.gen/7369.in"
source "config/.gen/7390--DE--05_2X.in"
source "config/.gen/7390--DE--06_0X.in"
source "config/.gen/7390--DE--06_2X.in"
source "config/.gen/7390--DE--06_5X.in"
source "config/.gen/7390--DE--06_8X.in"
source "config/.gen/7390--EN--05_2X.in"
source "config/.gen/7390--EN--06_0X.in"
source "config/.gen/7390--EN--06_2X.in"
source "config/.gen/7390--EN--06_5X.in"
source "config/.gen/7390--EN--06_8X.in"
source "config/.gen/7390.in"
source "config/.gen/7412--06_2X.in"
source "config/.gen/7412--06_5X.in"
source "config/.gen/7412--06_8X.in"
source "config/.gen/7412.in"
source "config/.gen/7430--DE--06_2X.in"
source "config/.gen/7430--DE--06_5X.in"
source "config/.gen/7430--DE--06_8X.in"
source "config/.gen/7430--DE--07_0X.in"
source "config/.gen/7430--DE--07_1X.in"
source "config/.gen/7430--EN--06_2X.in"
source "config/.gen/7430--EN--06_5X.in"
source "config/.gen/7430--EN--06_8X.in"
source "config/.gen/7430--EN--07_0X.in"
source "config/.gen/7430--EN--07_1X.in"
source "config/.gen/7430.in"
source "config/.gen/7490--DE--06_2X.in"
source "config/.gen/7490--DE--06_5X.in"
source "config/.gen/7490--DE--06_8X.in"
source "config/.gen/7490--DE--06_9X.in"
source "config/.gen/7490--DE--07_0X.in"
source "config/.gen/7490--DE--07_1X.in"
source "config/.gen/7490--EN--06_2X.in"
source "config/.gen/7490--EN--06_5X.in"
source "config/.gen/7490--EN--06_8X.in"
source "config/.gen/7490--EN--07_0X.in"
source "config/.gen/7490--EN--07_1X.in"
source "config/.gen/7490.in"
source "config/.gen/7520.in"
source "config/.gen/7530--DE--07_0X.in"
source "config/.gen/7530--DE--07_1X.in"
source "config/.gen/7530--EN--07_0X.in"
source "config/.gen/7530--EN--07_1X.in"
source "config/.gen/7530.in"
source "config/.gen/7560--DE--06_5X.in"
source "config/.gen/7560--DE--06_8X.in"
source "config/.gen/7560--DE--06_9X.in"
source "config/.gen/7560--DE--07_0X.in"
source "config/.gen/7560--DE--07_1X.in"
source "config/.gen/7560--EN--06_8X.in"
source "config/.gen/7560--EN--07_0X.in"
source "config/.gen/7560.in"
source "config/.gen/7570.in"
source "config/.gen/7580--DE--06_5X.in"
source "config/.gen/7580--DE--06_8X.in"
source "config/.gen/7580--DE--06_9X.in"
source "config/.gen/7580--DE--07_0X.in"
source "config/.gen/7580--DE--07_1X.in"
source "config/.gen/7580.in"
source "config/.gen/7583--DE--07_1X.in"
source "config/.gen/7583--EN--07_1X.in"
source "config/.gen/7583.in"
source "config/.gen/7590--DE--06_8X.in"
source "config/.gen/7590--DE--06_9X.in"
source "config/.gen/7590--DE--07_0X.in"
source "config/.gen/7590--DE--07_1X.in"
source "config/.gen/7590--EN--06_8X.in"
source "config/.gen/7590--EN--07_0X.in"
source "config/.gen/7590--EN--07_1X.in"
source "config/.gen/7590.in"
source "config/.gen/FON--DE.in"
source "config/.gen/FON--EN--XA.in"
source "config/.gen/FON--EN--XB.in"
source "config/.gen/FON.in"
source "config/.gen/W501V.in"
source "config/.gen/WLAN--DE.in"
source "config/.gen/WLAN--EN--XA.in"
source "config/.gen/WLAN--EN--XB.in"
source "config/.gen/WLAN.in"
```

## config/Config.in
```kconfig
mainmenu "Freetz Configuration"

config FREETZ_HAVE_DOT_CONFIG
	bool
	default y

comment "Freetz revision  -----------------------------------------"
	depends on FREETZ_MENUCONFIG_REVISION
comment " $(shell,tools/freetz_revision 2>&1)"
	depends on FREETZ_MENUCONFIG_REVISION

comment "User competence ------------------------------------------"
source "config/ui/user-competence.in"

comment "Hardware/Firmware ----------------------------------------"
source "config/ui/firmware.in"

comment "Original components --------------------------------------"
source "config/ui/ipv6.in"
source "config/ui/kernel.in"
source "config/ui/avm-plugins.in"
source "config/ui/patches.in"

comment "Additional components ------------------------------------"
source "config/ui/packages.in"
source "config/ui/shared-libraries.in"
source "config/ui/modules.in"
source "config/ui/busybox.in"
source "config/ui/external.in"

comment "Mod customizations ---------------------------------------"
source "config/ui/freetz.in"

comment "Build system ---------------------------------------------"
	depends on FREETZ_SHOW_EXPERT
source "config/ui/toolchain.in"
source "config/ui/build-system.in"
source "config/ui/fwmod.in"
source "config/ui/squashfs.in"
source "config/ui/strip.in"
source "config/mod/download.in"
source "config/custom.in"

### everything below is not visible

source "config/avm/availability.in"
source "config/avm/features.in"
source "config/avm/packaging.in"
source "config/avm/signature.in"
source "config/avm/mtd.in"

#source "config/.img/Config.in"
source "config/img.in"

#source "config/.kos/Config.in"
source "config/kos.in"

source "config/avm/version.in"
source "config/avm/hardware.in"
source "config/avm/architecture.in"
source "config/avm/compiler.in"
source "config/avm/compiler-traits.in"
source "config/avm/kernel.in"
source "config/avm/uclibc.in"
source "config/avm/source.in"
source "config/mod/juis.in"
source "config/mod/kernel.in"
source "config/mod/prefix.in"
source "config/mod/mandatory.in"
```

## freetz-stable-1.1/make/bash/Config.in
```kconfig
config FREETZ_PACKAGE_BASH
	bool "bash 3.2.48 (binary only)"
	default n
	help
		Bash is an sh-compatible command language interpreter that 
		executes commands read from the standard input or from a file.
		Bash also incorporates useful features from the Korn and C 
		shells (ksh and csh).(roundabout 540K minimal and 840K full featured)

config FREETZ_PACKAGE_BASH_MINIMAL
	bool "minimal config"
	depends on FREETZ_PACKAGE_BASH
	default n
	help
		This produces a shell with minimal features, close to the
		historical Bourne shell (saves ~300KB).

config FREETZ_PACKAGE_BASH_READLINE
	bool "enable command line editing and history"
	depends on FREETZ_PACKAGE_BASH
	select FREETZ_LIB_libncurses
	select FREETZ_LIB_libreadline
	select FREETZ_LIB_libhistory
	default n
	help
		Enable command line editing and history. This feature needs ncurses and readline.
```

## freetz-stable-1.1/make/br2684ctl/Config.in
```kconfig
config FREETZ_PACKAGE_BR2684CTL
	bool "br2684ctl"
	select FREETZ_LIB_libatm
	default n
	help
		ATM Ethernet bridging configuration utility
```

## freetz-stable-1.1/make/gnu-make/Config.in
```kconfig
config FREETZ_PACKAGE_GNU_MAKE
	bool "Gnu Make 3.8.1"
	default n
	help
		Make is a tool which controls the generation of executables and
		other non-source files of a program from the program's source files.
```

## freetz-stable-1.1/make/inetd/Config.in
```kconfig
config FREETZ_PACKAGE_INETD
	bool "Inetd"
	select FREETZ_BUSYBOX_INETD
	default n
	help
		'Virtual' inetd package. Provides configuration framework for 
		inetd. Requires a compatible inetd binary. (at the moment, only
		busybox inetd is supported)
```

## freetz-stable-1.1/make/mtr/Config.in
```kconfig
config FREETZ_PACKAGE_MTR
	bool "mtr 0.69"
	select FREETZ_LIB_libresolv
	select FREETZ_LIB_libncurses
	default n
	help
		mtr combines the functionality of the 'traceroute' and 'ping' programs
		in a single network diagnostic tool.
```

## freetz-stable-1.1/make/nfs-utils/Config.in
```kconfig
config FREETZ_PACKAGE_NFS_UTILS
	bool "nfs-utils 1.1.3 (binary only)"
	default n
	select FREETZ_PACKAGE_TCP_WRAPPERS
	select FREETZ_MODULE_nfsd if FREETZ_KERNEL_VERSION_2_6_13_1
	help
		Linux NFS utility package
```

## freetz-stable-1.1/make/pptpd/Config.in
```kconfig
config FREETZ_PACKAGE_PPTPD
	bool "pptpd 1.3.4"
	depends on FREETZ_REPLACE_KERNEL
	select FREETZ_PACKAGE_PPPD
	select FREETZ_LIB_libutil
	default n
	help
		Poptop is an open source implementation of a PPTP server.
		Running under x86 or embedded Motorola ColdFire architectures
		Poptop provides full interoperability with the Microsoft PPTP
		VPN client.
```

## freetz-stable-1.1/make/xrelayd/Config.in
```kconfig
config FREETZ_PACKAGE_XRELAYD
	bool "Xrelayd 0.2.1pre2 (binary only)"
	select FREETZ_LIB_libxyssl
	default n
	help
		SSL tunnel based on XySSL. Xrelayd is a stripped down version of
		stunnel based on XySSL library. Essentially, this package makes your
		router's websrv or httpd SSL-enabled, offering you the option of remote
		configuration via WWW or secure remote use of features like Rudi-Shell.

		This package will eventually replace Matrixtunnel, even though the
		XySSL library is somewhat bigger than MatrixSSL. Its command line
		interface is identical to Matrixtunnel's, so switching should be easy
		for all users.
```
