## make/acme/Config.in
```kconfig
config FREETZ_PACKAGE_ACME
	bool "ACME.sh 2.85 (letsencrypt)"
	select FREETZ_PACKAGE_OPENSSL
	select FREETZ_PACKAGE_WGET if !FREETZ_PACKAGE_CURL
	select FREETZ_PACKAGE_WGET_WITH_SSL if !FREETZ_PACKAGE_CURL
	select FREETZ_PACKAGE_CA_BUNDLE
	default n
	help
		A pure Unix shell script implementing ACME client protocol.

if FREETZ_PACKAGE_ACME

config FREETZ_PACKAGE_ACME_deploy
	bool "deploy"
	default y

config FREETZ_PACKAGE_ACME_dnsapi
	bool "dnsapi"
	default y

config FREETZ_PACKAGE_ACME_notify
	bool "notify"
	default y

config FREETZ_PACKAGE_ACME_SOCAT
	bool "Select socat"
	select FREETZ_PACKAGE_SOCAT
	default n
	help
		Needed only for standalone mode.

endif # FREETZ_PACKAGE_ACME
```

## make/adaway/Config.in
```kconfig
config FREETZ_PACKAGE_ADAWAY
	bool "AdAway"
	default n
	select FREETZ_BUSYBOX_MD5SUM
	select FREETZ_PACKAGE_CURL
	select FREETZ_PACKAGE_DNSMASQ
	help
		Ads get blocked by resolving corresponding domain name
		queries via dnsmasq to 127.0.0.1.
		Ad domains are periodically downloaded and updated
		from several providers.
		
		Size: about 13 kB (uncompressed)
```

## make/aiccu/Config.in
```kconfig
config FREETZ_PACKAGE_AICCU
	bool "aiccu - Automatic IPv6 Connectivity Client Utility"
	depends on FREETZ_TARGET_IPV6_SUPPORT
	select FREETZ_MODULE_sit if FREETZ_KERNEL_VERSION_2_6_19 && ! FREETZ_HAS_AVM_IPV6
	select FREETZ_LIB_libpthread
	select FREETZ_BUSYBOX_IP
	select FREETZ_BUSYBOX_FEATURE_IP_ADDRESS
	select FREETZ_BUSYBOX_FEATURE_IP_LINK
	select FREETZ_BUSYBOX_FEATURE_IP_ROUTE
	select FREETZ_BUSYBOX_FEATURE_IP_TUNNEL
	default n
	help
		AICCU (Automatic IPv6 Connectivity Client Utility) makes it easy for users to
		get IPv6 connectivity. After having requested an account, tunnel and optionally
		a subnet, AICCU can be used to automatically configure the tunnel.

		AICCU supports TIC (Tunnel Information & Control protocol), which it uses for
		retrieving the tunnel configuration information, AYIYA, which allows tunnels to
		be created even behind firewalls and NAT's.

		For more details see <http://www.sixxs.net/tools/aiccu/>.

		NOTE: Freetz builds its aiccu package without GnuTLS support!
		(See make/aiccu/patches/100-disable-gnutls.patch)
```

## make/apache/Config.in
```kconfig
config FREETZ_PACKAGE_APACHE
	bool "Apache HTTP Server 1.3.42 (binary only)"
	select FREETZ_LIB_libcrypt if ! FREETZ_PACKAGE_APACHE_STATIC
	select FREETZ_LIB_libdl    if ! FREETZ_PACKAGE_APACHE_STATIC
	select FREETZ_LIB_libm     if ! FREETZ_PACKAGE_APACHE_STATIC
	default n
	help
		The old version of Apache httpd server
		 - no longer maintained
		 - has been declared "end of life"
		 - may contain security holes, which will never be fixed

config FREETZ_PACKAGE_APACHE_COMPILEINMODS
	bool "Compile in modules instead of building loadable modules"
	depends on FREETZ_PACKAGE_APACHE
	default n
	help
		Causes all apache modules to be linked directly into the main binary.

config FREETZ_PACKAGE_APACHE_STATIC
	bool "Create statically linked binary"
	depends on FREETZ_PACKAGE_APACHE
	default n
	help
		Causes all libraries apache depends on to be linked in statically.
```

## make/apache2/Config.in
```kconfig
config FREETZ_PACKAGE_APACHE2
    bool "Apache HTTP Server 2.2.21"
    select FREETZ_LIB_libapr          if ! FREETZ_PACKAGE_APACHE2_STATIC
    select FREETZ_LIB_libapr_WITH_DSO
    select FREETZ_LIB_libaprutil      if ! FREETZ_PACKAGE_APACHE2_STATIC
    select FREETZ_LIB_libpcre         if ! FREETZ_PACKAGE_APACHE2_STATIC
    select FREETZ_LIB_libz            if ! FREETZ_PACKAGE_APACHE2_STATIC
    default n
    help
        The Apache httpd server

config FREETZ_PACKAGE_APACHE2_COMPILEINMODS
    bool "Compile modules in instead of building loadable modules"
    depends on FREETZ_PACKAGE_APACHE2
    default n
    help
        Causes all apache modules to be linked directly into the main binary.

config FREETZ_PACKAGE_APACHE2_STATIC
    bool "Create statically linked binary"
    depends on FREETZ_PACKAGE_APACHE2
    default n
    help
        Causes all libraries apache depends on to be linked in statically.
```

## make/asterisk-chan-capi/Config.in
```kconfig
config FREETZ_PACKAGE_ASTERISK_CHAN_CAPI
	bool "chan_capi module"
	depends on FREETZ_PACKAGE_ASTERISK
	select FREETZ_LIB_libpthread
	select FREETZ_LIB_libcapi20
	default n
	help
		Common ISDN API 2.0 module for asterisk
```

## make/asterisk-chan-dongle/Config.in
```kconfig
config FREETZ_PACKAGE_ASTERISK_CHAN_DONGLE
	bool "chan_dongle: Channel driver for Huawei UMTS 3G dongle"
	depends on FREETZ_PACKAGE_ASTERISK
	select FREETZ_LIB_libiconv if FREETZ_TARGET_UCLIBC_0_9_28
	default n
	help
		Asterisk channel driver for Huawei UMTS 3G dongle
```

## make/asterisk-chan-sccp/Config.in
```kconfig
config FREETZ_PACKAGE_ASTERISK_CHAN_SCCP
	bool "chan_sccp: SCCP channel provider for asterisk"
	depends on FREETZ_PACKAGE_ASTERISK
	select FREETZ_LIB_libdl       if FREETZ_TARGET_UCLIBC_HAS_multiple_libs
	select FREETZ_LIB_libpthread  if FREETZ_TARGET_UCLIBC_HAS_multiple_libs
	default n
	help
		SCCP channel provider for asterisk. It delivers extended functionality
		for SCCP phones over chan_skinny delivered by asterisk by default.
```

## make/asterisk-gui/Config.in
```kconfig
config FREETZ_PACKAGE_ASTERISK_GUI
#	bool "Asterisk GUI 2.1.0-rc1"
	bool
	depends on FREETZ_PACKAGE_ASTERISK
	default n
	help
		Asterisk GUI is a framework for the creation of graphical interfaces for configuring Asterisk.

		Please read https://wiki.asterisk.org/wiki/display/AST/Asterisk+GUI for configuration instructions.
```

## make/asterisk/Config.in
```kconfig
config FREETZ_PACKAGE_ASTERISK
	bool "Asterisk 11.25.3 - EXPERIMENTAL"
	select FREETZ_LIB_libdl       if FREETZ_TARGET_UCLIBC_HAS_multiple_libs
	select FREETZ_LIB_libm        if FREETZ_TARGET_UCLIBC_HAS_multiple_libs
	select FREETZ_LIB_libpthread  if FREETZ_TARGET_UCLIBC_HAS_multiple_libs
	select FREETZ_LIB_libcrypto
	select FREETZ_LIB_libncurses
	select FREETZ_LIB_libsqlite3
	select FREETZ_LIB_libssl
	default n
	help
		Asterisk is an open source framework for building communications applications.

config FREETZ_PACKAGE_ASTERISK_LOWMEMORY
	depends on FREETZ_PACKAGE_ASTERISK
#	bool "optimize asterisk for low-memory usage"
	bool
	default n
	help
		Warning: this feature is known to cause problems with some modules (e.g. chan_sip).
		Please try disabling it if you experience problems like segmentation faults.

config FREETZ_PACKAGE_ASTERISK_WITH_BACKTRACE
	depends on FREETZ_PACKAGE_ASTERISK && FREETZ_TARGET_UCLIBC_SUPPORTS_libubacktrace
	bool "enable backtrace support"
	select FREETZ_LIB_libubacktrace if FREETZ_TARGET_UCLIBC_HAS_multiple_libs
	default n

config FREETZ_PACKAGE_ASTERISK_DEBUG
	depends on FREETZ_PACKAGE_ASTERISK
	bool "add debug information (read help please!)"
	default n
	help
		Causes compiler to disable optimizations and to add debug information
		to the asterisk binary and modules. Debug information might help
		tracking down different run-time problems.

		Note1:
		  The resulting asterisk binary is huge! It doesn't make any sense to
		  activate this option on boxes with less than 64MB RAM. It won't run.

		Note2:
		  Don't forget to disable stripping under "Strip options/Strip leftover
		  unstripped binaries/libraries". Otherwise all debug information will
		  be stripped at the "modifying firmware"-step.

		Note3:
		  Use "ulimit -c unlimited" to disable core-file size limit.

config FREETZ_PACKAGE_ASTERISK_EMBED_MODULES
	bool "embed selected modules (non 3rd-party modules only)"
	depends on FREETZ_PACKAGE_ASTERISK
	default n

config FREETZ_PACKAGE_ASTERISK_STATIC
	bool
# doesn't work yet
#	bool "Link statically"
	depends on FREETZ_PACKAGE_ASTERISK && FREETZ_PACKAGE_ASTERISK_EMBED_MODULES
	default n

source "make/asterisk-gui/Config.in"

menu "Asterisk modules"
	depends on FREETZ_PACKAGE_ASTERISK
	source "make/asterisk/Config.in.generated"
endmenu

menu "Asterisk 3rd-party modules"
	depends on FREETZ_PACKAGE_ASTERISK && !FREETZ_PACKAGE_ASTERISK_STATIC
	source "make/asterisk-chan-capi/Config.in"
	source "make/asterisk-chan-dongle/Config.in"
	source "make/asterisk-chan-sccp/Config.in"
endmenu
```

## make/authorized-keys/Config.in
```kconfig
comment "authorized_keys (needs Dropbear or OpenSSH)"
	depends on !(FREETZ_PACKAGE_DROPBEAR || FREETZ_PACKAGE_OPENSSH)

config FREETZ_PACKAGE_AUTHORIZED_KEYS
	bool "authorized_keys: Frontend for SSH keys"
	depends on FREETZ_PACKAGE_DROPBEAR || FREETZ_PACKAGE_OPENSSH
	default n
	help
		This frontend allows the management of the authorized_keys file
		used by either Dropbear or OpenSSH to allow a key-based authentication.
		The key-based authentication is much more secure than password-based
		authentication.
```
