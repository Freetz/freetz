## kernel/Config.in
```kconfig
config FREETZ_MODULES_ALL
	bool "All Modules"
	depends on FREETZ_REPLACE_KERNEL
	default n

menu "crypto"

config FREETZ_MODULE_crypto_algapi
	bool "crypto_algapi.ko"
	depends on FREETZ_KERNEL_VERSION_2_6_19_2
	default n

config FREETZ_MODULE_aes
	bool "aes.ko"
	depends on FREETZ_KERNEL_VERSION_2_6_13_1
	default n

config FREETZ_MODULE_arc4
	bool "arc4.ko"
	select FREETZ_MODULE_crypto_algapi if FREETZ_KERNEL_VERSION_2_6_19_2 
	default n

config FREETZ_MODULE_blkcipher
	bool "blkcipher.ko"
	depends on FREETZ_KERNEL_VERSION_2_6_19_2
	default n

config FREETZ_MODULE_cbc
	bool "cbc.ko"
	depends on FREETZ_KERNEL_VERSION_2_6_19_2
	select FREETZ_MODULE_crypto_algapi
	select FREETZ_MODULE_blkcipher
	default n

config FREETZ_MODULE_cryptomgr
	bool "cryptomgr.ko"
	select FREETZ_MODULE_crypto_algapi
	depends on FREETZ_KERNEL_VERSION_2_6_19_2
	default n

config FREETZ_MODULE_sha1
	bool "sha1.ko"
	select FREETZ_MODULE_crypto_algapi if FREETZ_KERNEL_VERSION_2_6_19_2 
	default n

config FREETZ_MODULE_sha256
	bool "sha256.ko"
	select FREETZ_MODULE_crypto_algapi if FREETZ_KERNEL_VERSION_2_6_19_2 
	default n

endmenu

menu "drivers"

config FREETZ_MODULE_loop
	bool "loop.ko"
	default n

config FREETZ_MODULE_nbd
	bool "nbd.ko"
	default n

config FREETZ_MODULE_cdrom
	bool "cdrom.ko"
	default n

config FREETZ_MODULE_capiconn
	bool "capiconn.ko"
	default n

config FREETZ_MODULE_nand
	bool "nand.ko"
	default n

config FREETZ_MODULE_ohio_nand
	bool "ohio_nand.ko"
	default n

config FREETZ_MODULE_dummy
	bool "dummy.ko"
	default n

config FREETZ_MODULE_ppp_async
	bool "ppp_async.ko"
	select FREETZ_MODULE_ppp_generic
	select FREETZ_MODULE_crc_ccitt
	default n

config FREETZ_MODULE_ppp_deflate
	bool "ppp_deflate.ko"
	select FREETZ_MODULE_ppp_generic
	default n

config FREETZ_MODULE_ppp_generic
	bool "ppp_generic.ko"
	select FREETZ_MODULE_slhc
	default n

config FREETZ_MODULE_pppoe
	bool "pppoe.ko"
	select FREETZ_MODULE_ppp_generic
	select FREETZ_MODULE_pppox
	default n

config FREETZ_MODULE_pppox
	bool "pppox.ko"
	select FREETZ_MODULE_ppp_generic
	default n

config FREETZ_MODULE_ppp_mppe_mppc
	bool "ppp_mppe_mppc.ko"
	select FREETZ_MODULE_ppp_generic
	default n

config FREETZ_MODULE_scsi_mod
	bool "scsi_mod.ko"
	default n

config FREETZ_MODULE_sd_mod
	bool "sd_mod.ko"
	select FREETZ_MODULE_scsi_mod
	default n

config FREETZ_MODULE_sg
	bool "sg.ko"
	select FREETZ_MODULE_scsi_mod
	default n

config FREETZ_MODULE_sr_mod
	bool "sr_mod.ko"
	select FREETZ_MODULE_scsi_mod
	select FREETZ_MODULE_cdrom
	default n

config FREETZ_MODULE_slhc
	bool "slhc.ko"
	default n

config FREETZ_MODULE_musb_hdrc
	bool "musb_hdrc.ko"
	depends on FREETZ_KERNEL_VERSION_2_6_19_2
	default n

config FREETZ_MODULE_usblp
	bool "usblp.ko"
	select FREETZ_MODULE_usbcore
	default n

config FREETZ_MODULE_usb_storage
	bool "usb-storage.ko"
	select FREETZ_MODULE_scsi_mod
	select FREETZ_MODULE_usbcore
	default n

config FREETZ_MODULE_usbmon
	bool "usbmon.ko"
	default n

config FREETZ_MODULE_usbcore
	bool "usbcore.ko"
	default n

config FREETZ_MODULE_usbip
	bool "usbip.ko"
	select FREETZ_MODULE_usbip_common_mod
	select FREETZ_MODULE_usbcore
	default n

config FREETZ_MODULE_usbip_common_mod
	bool "usbip_common_mod.ko"
	default n

config FREETZ_MODULE_usbserial
	bool "usbserial.ko"
	default n

config FREETZ_MODULE_ipaq
	bool "ipaq.ko"
	select FREETZ_MODULE_usbserial
	default n

config FREETZ_MODULE_pl2303
	bool "pl2303.ko"
	select FREETZ_MODULE_usbserial
	default n
	
config FREETZ_MODULE_ftdi_sio
	bool "ftdi_sio.ko"
	select FREETZ_MODULE_usbserial
	default n

config FREETZ_MODULE_hci_usb
	bool "hci_usb.ko"
	select FREETZ_MODULE_usbcore
	select FREETZ_MODULE_bluetooth
	default n

config FREETZ_MODULE_bfusb
	bool "bfusb.ko"
	select FREETZ_MODULE_usbcore
	select FREETZ_MODULE_bluetooth
	select FREETZ_MODULE_firmware_class
	default n

config FREETZ_MODULE_firmware_class
	bool "firmware_class.ko"
	default n

config FREETZ_MODULE_dm_mod
	bool "dm-mod.ko"
	default n

config FREETZ_MODULE_dm_crypt
	bool "dm-crypt.ko"
	select FREETZ_MODULE_dm_mod
	default n

endmenu

menu "fs"


config FREETZ_MODULE_cifs
	bool "cifs.ko"   
	default n 

config FREETZ_MODULE_coda
	bool "coda.ko"   
	default n 

config FREETZ_MODULE_ext3
	bool "ext3.ko"
	select FREETZ_MODULE_jbd
	select FREETZ_MODULE_mbcache
	default n

config FREETZ_MODULE_ext2
	bool "ext2.ko"
	select FREETZ_MODULE_mbcache
	default n

config FREETZ_MODULE_fat
	bool "fat.ko"
	default n

config FREETZ_MODULE_hfs
        bool "hfs.ko"
        default n

config FREETZ_MODULE_hfsplus
        bool "hfsplus.ko"
	select FREETZ_MODULE_nls_utf8
        default n

config FREETZ_MODULE_fuse
	bool "fuse.ko"
	default n

config FREETZ_MODULE_jbd
	bool "jbd.ko"
	default n

config FREETZ_MODULE_lockd
	bool "lockd.ko"
	select FREETZ_MODULE_sunrpc
	default n

config FREETZ_MODULE_mini_fo
	bool "mini_fo.ko"
	default n

config FREETZ_MODULE_minix
	bool "minix.ko"
	default n

config FREETZ_MODULE_nfsd
	bool "nfsd.ko"
	select FREETZ_MODULE_lockd
	select FREETZ_MODULE_exportfs
	default n
	
config FREETZ_MODULE_exportfs
	bool "exportfs.ko"
	default n

config FREETZ_MODULE_nfs
	bool "nfs.ko"
	select FREETZ_MODULE_lockd
	default n

config FREETZ_MODULE_nls_cp437
	bool "nls_cp437.ko"
	default n

config FREETZ_MODULE_nls_cp852
	bool "nls_cp852.ko"
	default n

config FREETZ_MODULE_nls_iso8859_15
	bool "nls_iso8859-15.ko"
	default n

config FREETZ_MODULE_nls_iso8859_1
	bool "nls_iso8859-1.ko"
	default n

config FREETZ_MODULE_nls_utf8
	bool "nls_utf8.ko"
	default n

config FREETZ_MODULE_ntfs
	bool "ntfs.ko"
	default n

config FREETZ_MODULE_reiserfs
	bool "reiserfs.ko"
	default n

config FREETZ_MODULE_smbfs
	bool "smbfs.ko"
	default n

config FREETZ_MODULE_udf
	bool "udf.ko"
	default n

config FREETZ_MODULE_unionfs
	bool "unionfs.ko"
	default n

config FREETZ_MODULE_vfat
	bool "vfat.ko"
	select FREETZ_MODULE_fat
	default n
	
config FREETZ_MODULE_msdods
	bool "msdos.ko"
	default n
	
config FREETZ_MODULE_jffs2
	bool "jffs2.ko"
	default n

config FREETZ_MODULE_mbcache
	bool "mbcache.ko"
	default n

endmenu

menu "lib"

config FREETZ_MODULE_crc_ccitt
	bool "crc_ccitt.ko"
	default n
endmenu

menu "net"

config FREETZ_MODULE_bluetooth
	bool "bluetooth.ko"
	default n

config FREETZ_MODULE_bnep
	bool "bnep.ko"
	select FREETZ_MODULE_l2cap
	default n

config FREETZ_MODULE_ipv6
	bool "ipv6.ko"
	depends on FREETZ_TARGET_IPV6_SUPPORT
	default n
    help
		This is complemental support for the IP version 6.
		You will still be able to do traditional IPv4 networking as well.

		For general information about IPv6, see
		<http://playground.sun.com/pub/ipng/html/ipng-main.html>.
		For Linux IPv6 development information, see <http://www.linux-ipv6.org>.
		For specific information about IPv6 under Linux, read the HOWTO at
		<http://www.bieringer.de/linux/IPv6/>.

config FREETZ_MODULE_sit
	bool "sit.ko"
	depends on FREETZ_KERNEL_VERSION_2_6_19_2
	depends on FREETZ_MODULE_ipv6
	default n

config FREETZ_MODULE_l2cap
	bool "l2cap.ko"
	select FREETZ_MODULE_bluetooth
	default n
	
config FREETZ_MODULE_rfcomm
	bool "rfcomm.ko"
	select FREETZ_MODULE_l2cap
	default n
	
config FREETZ_MODULE_sunrpc
	bool "sunrpc.ko"
	default n

endmenu
```

## make/Config.in
```kconfig
comment "*** not all packages support selected language ***"
	depends on ! FREETZ_LANG_DE

config FREETZ_SELECTED_LANG_ONLY
	bool "Packages supporting selected language only"
	depends on ! FREETZ_LANG_DE
	default n
	help
		Show only packages supporting the selected language. Packages not
		supporting your selected language can be installed, but they will be in
		default language (usually German).

menu "Debug helpers"
source make/gdb/Config.in
source make/inotify-tools/Config.in
source make/ldd/Config.in
source make/lsof/Config.in
source make/ltrace/Config.in
source make/nano-shell/Config.in
source make/pciutils/Config.in
source make/strace/Config.in
#intentionally commented out as nobody wants to include it in the image
#source make/target-tester/Config.in
source make/usbutils/Config.in
endmenu

menu "Standard packages"
source make/aiccu/Config.in
source make/bftpd/Config.in
source make/bird/Config.in
source make/bridge-utils/Config.in
source make/callmonitor/Config.in
source make/checkmaild/Config.in
source make/cifsmount/Config.in
source make/cpmaccfg/Config.in
source make/curl/Config.in
source make/deco/Config.in
source make/dns2tcp/Config.in
source make/dnsmasq/Config.in
source make/dropbear/Config.in
source make/espeak/Config.in
source make/fortune/Config.in
source make/fuse/Config.in
source make/haserl/Config.in
source make/inetd/Config.in
source make/knock/Config.in
source make/mc/Config.in
source make/mtr/Config.in
source make/nano/Config.in
source make/netcat/Config.in
source make/nc6/Config.in
source make/netsnmp/Config.in
source make/nfs-utils/Config.in
source make/ntfs/Config.in
source make/openntpd/Config.in
source make/openvpn/Config.in
source make/php/Config.in
source make/pingtunnel/Config.in
source make/portmap/Config.in

comment "Point-to-Point (not available, no sources by AVM)"
	depends on !FREETZ_REPLACE_KERNEL_AVAILABLE

comment "Point-to-Point (not available, needs replace kernel)"
	depends on FREETZ_KERNEL_VERSION_2_6_28 && !FREETZ_REPLACE_KERNEL

menu "Point-to-Point"
	depends on (FREETZ_REPLACE_KERNEL_AVAILABLE && !FREETZ_KERNEL_VERSION_2_6_28) || \
		FREETZ_REPLACE_KERNEL
source make/pppd/Config.in
source make/pptp/Config.in
source make/pptpd/Config.in
endmenu

source make/privoxy/Config.in
source make/radvd/Config.in
source make/rcapid/Config.in
source make/samba/Config.in
source make/screen/Config.in
source make/stunnel/Config.in
source make/tcpdump/Config.in
source make/tinyproxy/Config.in
source make/tor/Config.in
source make/transmission/Config.in
source make/vnstat/Config.in
source make/vpnc/Config.in
source make/vsftpd/Config.in
source make/xmail/Config.in
endmenu

menu "Testing"
source make/apache/Config.in
source make/apache2/Config.in
source make/autofs/Config.in
source make/avahi/Config.in
source make/bash/Config.in
source make/bfusb/Config.in
source make/bind/Config.in
source make/bip/Config.in
source make/bittwist/Config.in
source make/bluez-utils/Config.in
source make/br2684ctl/Config.in
source make/ccid/Config.in
source make/classpath/Config.in
source make/comgt/Config.in
source make/cryptsetup/Config.in
source make/ctorrent/Config.in
source make/dante/Config.in
source make/davfs2/Config.in
source make/dbus/Config.in
source make/debootstrap/Config.in
source make/digitemp/Config.in
source make/dosfstools/Config.in
source make/dtach/Config.in
source make/dvbsnoop/Config.in
source make/dvbstream/Config.in
source make/dvbtune/Config.in
source make/e2fsprogs/Config.in
source make/emailrelay/Config.in
source make/empty/Config.in
source make/ffmpeg/Config.in
source make/fowsr/Config.in
source make/fstyp/Config.in
source make/ghostscript-fonts/Config.in
source make/git/Config.in
source make/gntpsend/Config.in
source make/gnu-make/Config.in
source make/gnutls/Config.in
source make/gocr/Config.in
source make/haproxy/Config.in
source make/hd-idle/Config.in
source make/hol/Config.in
source make/html2text/Config.in
source make/htop/Config.in
source make/htpdate/Config.in
source make/httpry/Config.in
source make/httptunnel/Config.in
source make/ifstat/Config.in
source make/iftop/Config.in
source make/igmpproxy/Config.in
source make/imagemagick/Config.in
source make/inadyn-mt/Config.in
source make/inadyn-opendns/Config.in
source make/iodine/Config.in
source make/iptraf/Config.in
source make/iputils/Config.in
source make/irssi/Config.in
source make/jamvm/Config.in
source make/js/Config.in
source make/lftp/Config.in
source make/lighttpd/Config.in
source make/lynx/Config.in
source make/lua/Config.in
source make/madplay/Config.in
source make/matrixtunnel/Config.in
source make/mcabber/Config.in
source make/mediatomb/Config.in
source make/microperl/Config.in
source make/mini-snmpd/Config.in
source make/minicom/Config.in
source make/minidlna/Config.in
source make/module-init-tools/Config.in
source make/nagios/Config.in
source make/ncftp/Config.in
source make/netatalk/Config.in
source make/netpbm/Config.in
source make/noip/Config.in
source make/ndas/Config.in
source make/nfsroot/Config.in
source make/ngircd/Config.in
source make/nmap/Config.in
source make/obexftp/Config.in
source make/oidentd/Config.in
source make/openconnect/Config.in
source make/opendd/Config.in
source make/openssh/Config.in
source make/openssl/Config.in
source make/owfs/Config.in
source make/pcsc-lite/Config.in
source make/polipo/Config.in
source make/pyload/Config.in
source make/python/Config.in
menu "Python 3rd-party modules"
	depends on FREETZ_PACKAGE_PYTHON
	source make/python-bjoern/Config.in
	source make/python-imaging-library/Config.in
	source make/python-pycrypto/Config.in
	source make/python-pycurl/Config.in
	source make/python-pyopenssl/Config.in
	source make/python-pyrrd/Config.in
	source make/python-pyserial/Config.in
endmenu
source make/quagga/Config.in
source make/ripmime/Config.in
source make/rrdtool/Config.in
source make/rsync/Config.in
source make/rtmpdump/Config.in
source make/ruby/Config.in
source make/rush/Config.in
source make/sablevm-sdk/Config.in
source make/ser2net/Config.in
source make/shellinabox/Config.in
source make/siproxd/Config.in
source make/sispmctl/Config.in
source make/slang/Config.in
source make/slurm/Config.in
source make/smartmontools/Config.in
source make/smstools3/Config.in
source make/smusbutil/Config.in
source make/socat/Config.in
source make/spawn-fcgi/Config.in
source make/sqlite/Config.in
source make/sshfs-fuse/Config.in
source make/sslh/Config.in
source make/streamripper/Config.in
source make/subversion/Config.in
source make/sundtek/Config.in
source make/synce-dccm/Config.in
source make/synce-serial/Config.in
source make/tcp_wrappers/Config.in
source make/tcpproxy/Config.in
source make/tesseract/Config.in
source make/tiff/Config.in
source make/tinc/Config.in
source make/tree/Config.in
source make/trickle/Config.in
source make/tmux/Config.in
source make/udpxy/Config.in
source make/umurmur/Config.in
source make/unfs3/Config.in
source make/unrar/Config.in
source make/usbip/Config.in
source make/usbroot/Config.in
source make/util-linux-ng/Config.in
source make/vim/Config.in
source make/vtun/Config.in
source make/wget/Config.in
source make/wol/Config.in
source make/wput/Config.in
source make/xpdf/Config.in
source make/xrelayd/Config.in
source make/xsltproc/Config.in
endmenu

menu "Web interfaces"
source make/authorized-keys/Config.in
source make/avm-firewall/Config.in
source make/cpmaccfg-cgi/Config.in
source make/dnsd-cgi/Config.in
source make/downloader/Config.in
source make/nfsd-cgi/Config.in
source make/onlinechanged-cgi/Config.in
source make/phpxmail/Config.in
source make/ppp-cgi/Config.in
source make/rrdstats/Config.in
source make/spindown-cgi/Config.in
source make/syslogd-cgi/Config.in
source make/transmission-cgi/Config.in
source make/vnstat-cgi/Config.in
source make/wol-cgi/Config.in
endmenu

menu "Unstable packages"
	visible if FREETZ_SHOW_EXPERT
source make/collectd/Config.in
source make/dtmfbox/Config.in
source make/dtmfbox-cgi/Config.in
source make/gw6/Config.in
source make/hp-utils/Config.in
source make/hplip/Config.in
source make/iptables/Config.in
source make/mdev/Config.in
source make/mini_fo/Config.in
source make/sane-backends/Config.in
source make/squid/Config.in
source make/truecrypt/Config.in
source make/virtualip-cgi/Config.in
source make/zabbix/Config.in
endmenu

# mandatory packages
source make/mod/Config.in
source make/modcgi/Config.in
```
