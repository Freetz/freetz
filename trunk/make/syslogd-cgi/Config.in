## trunk/make/syslogd-cgi/Config.in
```kconfig
config DS_PACKAGE_SYSLOGD_CGI
	bool "Syslogd CGI 0.2.2"
	depends on DS_LANG_DE || ! DS_SELECTED_LANG_ONLY
	default n
	help
	    Configuration frontend to syslogd
```
